## multimedia/lvgl/lvgl/Kconfig
```kconfig
# Kconfig file for package lvgl
menuconfig PKG_USING_LVGL
    bool "lvgl (offical): powerful and easy-to-use embedded GUI library"
    default n

if PKG_USING_LVGL

    config PKG_LVGL_PATH
        string
        default "/packages/multimedia/lvgl/lvgl"

    choice
        prompt "Version"
        default PKG_USING_LVGL_LATEST_VERSION
        help
            Select the package version

        config PKG_USING_LVGL_LATEST_VERSION
            bool "latest"
    endchoice
          
    config PKG_LVGL_VER
       string
       default "latest"    if PKG_USING_LVGL_LATEST_VERSION

endif
```

## multimedia/mcurses/Kconfig
```kconfig
# Kconfig file for package mcurses
menuconfig PKG_USING_MCURSES
    bool "mcurses: micro ncurses library"
    default n

if PKG_USING_MCURSES

    config PKG_MCURSES_PATH
        string
        default "/packages/multimedia/mcurses"

    config MCURSES_USING_SIMPLE
        bool "mcurses: simple demo"
        help
            mcurses: simple demo
        default n

    config MCURSES_USING_BOX
        bool "mcurses: box animation demo"
        help
            mcurses: box animation demo
        default n

    config MCURSES_USING_SCREEN
        bool "mcurses: screen animation demo"
        help
            mcurses: screen animation demo
        default n

    config MCURSES_USING_TEMPERATURE
        bool "mcurses: temperature monitor demo"
        help
            mcurses: temperature monitor demo
        default n

    config MCURSES_USING_KEY_TEST
        bool "mcurses: key input demo"
        help
            mcurses: key input demo
        default n

    config MCURSES_USING_TOWER
        bool "mcurses: towers of hanoi animation demo"
        help
            mcurses: towers of hanoi animation demo
        default n

    config MCURSES_USING_NUMBER_EDITOR
        bool "mcurses: number editor demo"
        help
            mcurses: number editor demo
        default n

    config MCURSES_USING_HEX_EDITOR
        bool "mcurses: hex editor demo"
        help
            mcurses: hex editor demo
        default n

    choice
        prompt "Version"
        default PKG_USING_MCURSES_LATEST_VERSION
        help
            Select the package version

        config PKG_USING_MCURSES_LATEST_VERSION
            bool "latest"
    endchoice

    config PKG_MCURSES_VER
       string
       default "latest"    if PKG_USING_MCURSES_LATEST_VERSION
endif
```

## multimedia/mp3player/Kconfig
```kconfig
# Kconfig file for package mp3player
menuconfig PKG_USING_MP3PLAYER
    bool "mp3player:a simple mp3 format music player"
    select RT_USING_AUDIO
    select PKG_USING_HELIX
    select PKG_USING_OPTPARSE
    default n

if PKG_USING_MP3PLAYER

    config PKG_MP3PLAYER_PATH
        string
        default "/packages/multimedia/mp3player"

    config MP3_SOUND_DEVICE_NAME
        string "The play device name"
        default "sound0"
    config MP3_INPUT_BUFFER_SIZE
        int "mp3 input buffer size"
        default 2048
    config MP3_OUTPUT_BUFFER_SIZE
        int "mp3 output buffer size"
        default 4608
    config MP3_PLAYER_VOLUME_DEFAULT
        int "mp3 player default volume"
        default 30

    choice
        prompt "Version"
        default PKG_USING_MP3PLAYER_LATEST_VERSION
        help
            Select the package version

        config PKG_USING_MP3PLAYER_V100
            bool "v1.0.0"

        config PKG_USING_MP3PLAYER_LATEST_VERSION
            bool "latest"
    endchoice

    config PKG_MP3PLAYER_VER
       string
       default "v1.0.0"    if PKG_USING_MP3PLAYER_V100
       default "latest"    if PKG_USING_MP3PLAYER_LATEST_VERSION


endif
```

## multimedia/mupdf/Kconfig
```kconfig
# Kconfig file for package mupdf
menuconfig PKG_USING_MUPDF
    bool "mupdf: a lightweight PDF, XPS, and E-book viewer"
    default n

if PKG_USING_MUPDF

    config PKG_MUPDF_PATH
        string
        default "/packages/multimedia/mupdf"

    choice
        prompt "version"
        help
            Select the mupdf version

        config PKG_USING_MUPDF_V120
            bool "v1.2.0"

        config PKG_USING_MUPDF_LATEST_VERSION
            bool "latest"
    endchoice

    if PKG_USING_MUPDF_V120
        config PKG_MUPDF_VER
        string
        default "v1.2.0"
    endif

    if PKG_USING_MUPDF_LATEST_VERSION
       config PKG_MUPDF_VER
       string
       default "latest"
    endif

endif
```

## multimedia/nes_simulator/Kconfig
```kconfig
# Kconfig file for package nes
menuconfig PKG_USING_NES_SIMULATOR
    bool "The nes simulator implemented in C."
    default n

if PKG_USING_NES_SIMULATOR

    config PKG_NES_SIMULATOR_PATH
        string
        default "/packages/multimedia/nes_simulator"

    choice
        prompt "PKG_NES_LOG_LEVEL"
        default PKG_NES_LOG_LEVEL_INFO
        help
            Select NES LOG LEVEL

        config PKG_NES_LOG_LEVEL_NONE
            bool "LOG_LEVEL_NONE"

        config PKG_NES_LOG_LEVEL_ERROR
            bool "LOG_LEVEL_ERROR"

        config PKG_NES_LOG_LEVEL_WARN
            bool "LOG_LEVEL_WARN"

        config PKG_NES_LOG_LEVEL_INFO
            bool "LOG_LEVEL_INFO"

        config PKG_NES_LOG_LEVEL_DEBUG
            bool "LOG_LEVEL_DEBUG"
    endchoice

    choice
        prompt "PKG_NES_COLOR_DEPTH"
        default PKG_NES_COLOR_DEPTH_32
        help
            Select NES COLOR DEPTH, 16:rgb565, 32:rgb8888

        config PKG_NES_COLOR_DEPTH_16
            bool "COLOR_DEPTH_16"

        config PKG_NES_COLOR_DEPTH_32
            bool "COLOR_DEPTH_32"
    endchoice

    if PKG_NES_COLOR_DEPTH_16
        config PKG_NES_COLOR_SWAP
            bool "Enable Color Swap"
            default y
    endif

    config PKG_NES_ENABLE_SOUND
        bool "Enable Sound"
        default n
        help
        config nes to enable sound.

    config PKG_NES_USE_FS
        select RT_USING_DFS      if RT_VER_NUM < 0x40100
        select RT_USING_LIBC     if RT_VER_NUM < 0x40100
        select RT_USING_POSIX_FS if RT_VER_NUM >= 0x40100
        bool "Enable File System"
        default y
        help
        config nes to use file system to load rom files.

    config PKG_NES_FRAME_SKIP
        int "Frame Skip"
        range 0 5
        default 0

    choice
        prompt "Version"
        default PKG_USING_NES_SIMULATOR_LATEST_VERSION
        help
            Select the package version

        config PKG_USING_NES_SIMULATOR_V003
            bool "v0.0.4"

        config PKG_USING_NES_SIMULATOR_LATEST_VERSION
            bool "latest"
    endchoice

    config PKG_NES_SIMULATOR_VER
       string
       default "v0.0.4"    if PKG_USING_NES_SIMULATOR_V003
       default "latest"    if PKG_USING_NES_SIMULATOR_LATEST_VERSION

endif
```

## multimedia/openmv/Kconfig
```kconfig
menuconfig PKG_USING_OPENMV
    bool "Openmv: Open-Source Machine Vision"
    default n

if PKG_USING_OPENMV

    config PKG_OPENMV_PATH
        string
        default "/packages/multimedia/openmv"

    choice
        prompt "version"
        help
            Select the openmv version

        config PKG_USING_OPENMV_V100
            bool "v1.0.0"

        config PKG_USING_OPENMV_LATEST_VERSION
            bool "latest"
    endchoice

    if PKG_USING_OPENMV_V100
        config PKG_OPENMV_VER
        string
        default "v1.0.0"
    endif

    if PKG_USING_OPENMV_LATEST_VERSION
       config PKG_OPENMV_VER
       string
       default "latest"
    endif

endif
```

## multimedia/persimmon/Kconfig
```kconfig
menuconfig PKG_USING_PERSIMMON
    bool "Persimmon UI: An Embedded GUI component with sliding and animated effects"
    select PKG_USING_GUIENGINE
    select PKG_USING_FASTLZ
    depends on ARCH_ARM_CORTEX_M4 || ARCH_ARM_CORTEX_M7 || ARCH_ARM_CORTEX_A || ARCH_MIPS_XBURST || ARCH_ARM_ARM9
    default n
    help
        An Embedded GUI component with sliding and animated effects running on RT-Thread

if PKG_USING_PERSIMMON

    config PKG_PERSIMMON_PATH
        string
        default "/packages/multimedia/persimmon"

    choice
        prompt "Version"
        help
            Select the Persimmon UI version
        default PKG_USING_PERSIMMON_LATEST_VERSION

        config PKG_USING_PERSIMMON_V100
            bool "v1.0.0"

        config PKG_USING_PERSIMMON_V110
            bool "v1.1.0"

        config PKG_USING_PERSIMMON_LATEST_VERSION
            bool "latest"
    endchoice

    config PKG_PERSIMMON_VER
        string
        default "v1.0.0" if PKG_USING_PERSIMMON_V100
        default "v1.1.0" if PKG_USING_PERSIMMON_V110
        default "latest" if PKG_USING_PERSIMMON_LATEST_VERSION

    config RT_USING_PERSIMMON_EXAMPLE
        bool "Persimmon Examples"
        default n
        help
            Basic examples for persimmon
endif
```

## multimedia/qrcode/Kconfig
```kconfig
# Kconfig file for package qrcode
menuconfig PKG_USING_QRCODE
    bool "qrcode: A simple library for generating QR codes in C"
    default n

if PKG_USING_QRCODE

    config PKG_QRCODE_PATH
        string
        default "/packages/multimedia/qrcode"

    config PKG_QRCODE_SAMPLE
        bool "Enable qrcode sample"
        default n

    choice
        prompt "Version"
        default PKG_USING_QRCODE_LATEST_VERSION
        help
            Select the package version

        config PKG_USING_QRCODE_V100
            bool "v1.0.0"

        config PKG_USING_QRCODE_LATEST_VERSION
            bool "latest"
    endchoice

    config PKG_QRCODE_VER
       string
       default "v1.0.0"    if PKG_USING_QRCODE_V100
       default "latest"    if PKG_USING_QRCODE_LATEST_VERSION

endif
```

## multimedia/termbox/Kconfig
```kconfig
# Kconfig file for package termbox
menuconfig PKG_USING_TERMBOX
    bool "termbox: library for writing text-based user interfaces"
    select RT_USING_POSIX_FS
    select RT_USING_POSIX_POLL
    select RT_USING_POSIX_STDIO
    select RT_USING_POSIX_TERMIOS
    default n
    depends on RT_VER_NUM > 0x40100

if PKG_USING_TERMBOX

    config PKG_TERMBOX_PATH
        string
        default "/packages/multimedia/termbox"

    config TERMBOX_USING_DEMOS
        bool "Enable demos"
        default n

    config TERMBOX_USING_CPP_DEMOS
        bool "Enable cpp demos"
        depends on TERMBOX_USING_DEMOS
        select RT_USING_CPLUSPLUS
        default n

    choice
        prompt "Version"
        default PKG_USING_TERMBOX_LATEST_VERSION
        help
            Select the package version

        config PKG_USING_TERMBOX_LATEST_VERSION
            bool "latest"
    endchoice

    config PKG_TERMBOX_VER
       string
       default "latest"    if PKG_USING_TERMBOX_LATEST_VERSION

endif
```
