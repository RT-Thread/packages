## tools/SEGGER_RTT/Kconfig
```kconfig
# Kconfig file for package SEGGER_RTT
menuconfig PKG_USING_SEGGER_RTT
    bool "SEGGER_RTT:the RTT of segger jlink instead of uart of console"
    default n

if PKG_USING_SEGGER_RTT

choice
    prompt "Console type"
    default SEGGER_RTT_ENABLE
    help
        Select the transport type

    config SEGGER_RTT_ENABLE
        bool "Jlink SEGGER RTT support"

    config SWO_ENABLE
        bool "ARM CORTEX M SWO support"

endchoice

config SEGGER_RTT_MAX_NUM_UP_BUFFERS
    int "SEGGER_RTT_MAX_NUM_UP_BUFFERS"
    depends on SEGGER_RTT_ENABLE
    help
       Max. number of up-buffers (T->H) available on this target    (Default: 3)
    default 3
config SEGGER_RTT_MAX_NUM_DOWN_BUFFERS
    int "SEGGER_RTT_MAX_NUM_DOWN_BUFFERS"
    depends on SEGGER_RTT_ENABLE
    help
       Max. number of down-buffers (H->T) available on this target  (Default: 3)
    default 3

config BUFFER_SIZE_UP
    int "BUFFER_SIZE_UP"
    depends on SEGGER_RTT_ENABLE
    help
        Size of the buffer for terminal output of target, up to host (Default: 1k)
    default 1024
config BUFFER_SIZE_DOWN
    int "BUFFER_SIZE_DOWN"
    depends on SEGGER_RTT_ENABLE
    help
        Size of the buffer for terminal input to target from host (Usually keyboard input) (Default: 16)
    default 16
config SEGGER_RTT_PRINTF_BUFFER_SIZE
    int "SEGGER_RTT_PRINTF_BUFFER_SIZE"
    depends on SEGGER_RTT_ENABLE
    help
       Size of buffer for RTT printf to bulk-send chars via RTT  
    default 64
    
config RTT_DEFAULT_BUFFER_INDEX
    int "RTT_DEFAULT_BUFFER_INDEX"
    depends on SEGGER_RTT_ENABLE
    default 0
    
config RTT_DEFAULT_TERMINAL_INDEX
    int "RTT_DEFAULT_TERMINAL_INDEX"
    depends on SEGGER_RTT_ENABLE
    default 0



config SWO_PORT_NUMBER
    int "SWO port number"
    depends on SWO_ENABLE
    default 0


config PKG_SEGGER_RTT_PATH
    string
    default "/packages/tools/SEGGER_RTT"

    choice
        prompt "Version"
        default PKG_USING_SEGGER_RTT_LATEST_VERSION
        help
            Select the package version

        config PKG_USING_SEGGER_RTT_V100
            bool "v1.0.0"

        config PKG_USING_SEGGER_RTT_V110
            bool "v1.1.0"

        config PKG_USING_SEGGER_RTT_LATEST_VERSION
            bool "latest"
    endchoice

    config PKG_SEGGER_RTT_VER
       string
       default "v1.0.0"    if PKG_USING_SEGGER_RTT_V100
       default "v1.1.0"    if PKG_USING_SEGGER_RTT_V110
       default "latest"    if PKG_USING_SEGGER_RTT_LATEST_VERSION

endif
```

## tools/SystemView/Kconfig
```kconfig
menuconfig PKG_USING_SYSTEMVIEW
    bool "SystemView: A Segger utility for analysis and trace the RTOS"
    default n
    select RT_USING_HOOK
    select RT_USING_HOOKLIST

if PKG_USING_SYSTEMVIEW

    config PKG_SYSTEMVIEW_PATH
        string
        default "/packages/tools/SystemView"

    config PKG_SYSVIEW_APP_NAME
        string "App name"
        default "RT-Thread Trace"
        ---help---
            The application name to be displayed in SystemViewer UI

    config PKG_SYSVIEW_DEVICE_NAME
        string "Device name"
        default "Cortex-M"
        ---help---
            The target device name

    config PKG_SYSVIEW_TIMESTAMP_FREQ
        int "Timestap freq"
        default 0
        ---help---
            Frequency of the timestamp. Must match SEGGER_SYSVIEW_Conf.h. 0: using SystemCoreClock

    config PKG_SYSVIEW_CPU_FREQ
        int "cpu freq"
        default 0
        ---help---
            System Frequency. SystemcoreClock is used in most CMSIS compatible projects. 0: using SystemCoreClock

    config PKG_SYSVIEW_RAM_BASE
        hex "RAM base"
        default 0x20000000
        ---help---
            The lowest RAM address used for IDs (pointers)

    config PKG_SYSVIEW_EVENTID_OFFSET
        int "Event ID offset"
        default 32

    config PKG_SYSVIEW_USE_CYCCNT_TIMESTAMP
        bool "Using the Cortex-M cycle counter as SystemView timestamp"
        default y
        ---help---
            "Using the Cortex-M cycle counter as SystemView timestamp"

    config PKG_SYSVIEW_SYSDESC0
        string "System description 0"
        default "I#15=SysTick"
        ---help---
            format is "I#%num%=%name%, ..." number is IRQ number, name is IRQ name

    config PKG_SYSVIEW_SYSDESC1
        string "System description 1"
        default ""
        ---help---
            format is "I#%num%=%name%, ..." number is IRQ number, name is IRQ name

    config PKG_SYSVIEW_SYSDESC2
        string "System description 2"
        default ""
        ---help---
            format is "I#%num%=%name%, ..." number is IRQ number, name is IRQ name

menu "Segger RTT configuration"
    config PKG_SEGGER_RTT_MAX_NUM_UP_BUFFERS
        int "Max num of up buffer"
        default 3
        ---help---
            Max. number of up-buffers (T->H) available on this target

    config PKG_SEGGER_RTT_MAX_NUM_DOWN_BUFFERS
        int "Max num of dowm buffer"
        default 3
        ---help---
            Max. number of down-buffers (H->T) available on this target

    config PKG_SEGGER_RTT_BUFFER_SIZE_UP
        int "buffer size up"
        default 1024
        ---help---
            Size of the buffer for terminal output of target, up to host

    config PKG_SEGGER_RTT_BUFFER_SIZE_DOWN
        int "buffer size down"
        default 16
        ---help---
            Size of the buffer for terminal input to target from host (Usually keyboard input)

    config PKG_SEGGER_RTT_PRINTF_BUFFER_SIZE
        int "Segger RTT printf buffer size"
        default 64
        ---help---
            Size of buffer for RTT printf to bulk-send chars via RTT

    config PKG_SEGGER_RTT_AS_SERIAL_DEVICE
        bool "Use Segger RTT channel 0 as RT-Thread Serial Device"
        default y

    if PKG_SEGGER_RTT_AS_SERIAL_DEVICE
        config PKG_SERIAL_DEVICE_NAME
            string "Segger-RTT Serial Device Name"
            default "segger"
    endif

    choice
        prompt "Mode for pre-initialized terminal channel"
        default PKG_SEGGER_RTT_MODE_ENABLE_NO_BLOCK_SKIP
        ---help---
            Select the Mode for pre-initialized terminal channel (buffer 0)
        config PKG_SEGGER_RTT_MODE_ENABLE_NO_BLOCK_SKIP
            bool "No block skip"
            ---help---
                Skip. Do not block, output nothing.
        config PKG_SEGGER_RTT_MODE_ENABLE_NO_BLOCK_TRIM
            bool "No block trim"
            ---help---
                Trim: Do not block, output as much as fits.
        config PKG_SEGGER_RTT_MODE_ENABLE_BLOCK_IF_FIFO_FULL
            bool "block if fifo full"
            ---help---
                Block: Wait until there is space in the buffer
    endchoice

    config PKG_SEGGER_RTT_MAX_INTERRUPT_PRIORITY
        hex "Max Interrupt priority"
        default 0x20
        ---help---
            Target is not allowed to perform other RTT operations while string still has not been stored completely.
            Otherwise we would probably end up with a mixed string in the buffer.
            If using  RTT from within interrupts, multiple tasks or multi processors, define the SEGGER_RTT_LOCK() and SEGGER_RTT_UNLOCK() function here.
            SEGGER_RTT_MAX_INTERRUPT_PRIORITY can be used in the sample lock routines on Cortex-M3/4.
            Make sure to mask all interrupts which can send RTT data, i.e. generate SystemView events, or cause task switches.
            When high-priority interrupts must not be masked while sending RTT data, SEGGER_RTT_MAX_INTERRUPT_PRIORITY needs to be adjusted accordingly.
            (Higher priority = lower priority number)


    config PKG_SEGGER_RTT_USE_RTT_ASM
        bool "Use RTT ASM"
        default 64
        ---help---
            n:disable, y:Use assembler version of SEGGER_RTT.c

    config PKG_SEGGER_RTT_MEMCPY_USE_BYTELOOP
        bool "memcpy use byte-loop"
        default n
        ---help---
            n: Use memcpy/SEGGER_RTT_MEMCPY, y: Use a simple byte-loop
endmenu

menu "SystemView buffer configuration"
    config PKG_SEGGER_SYSVIEW_RTT_BUFFER_SIZE
        int "RTT buffer size"
        default 1024
        ---help---
            Number of bytes that SystemView uses for the buffer

    config PKG_SEGGER_SYSVIEW_RTT_CHANNEL
        int "RTT channel"
        default 1
        ---help---
            The RTT channel that SystemView will use. 0: Auto selection

    config PKG_SEGGER_SYSVIEW_USE_STATIC_BUFFER
        bool "Use static buffer"
        default y
        ---help---
            Use a static buffer to generate events instead of a buffer on the stack

    config PKG_SEGGER_SYSVIEW_POST_MORTEM_MODE
        bool "Enable post mortem analysis mode"
        default n
        ---help---
            n: disable, y: Enable post mortem analysis mode"

endmenu

menu "SystemView Id configuration"
    config PKG_SEGGER_SYSVIEW_ID_BASE
        hex "ID Base"
        default 0x10000000
        ---help---
            Default value for the lowest Id reported by the application. Can be overridden by the application via SEGGER_SYSVIEW_SetRAMBase(). (i.e. 0x20000000 when all Ids are an address in this RAM)
    config PKG_SEGGER_SYSVIEW_ID_SHIFT
        int "ID Shift"
        default 2
        ---help---
            Number of bits to shift the Id to save bandwidth. (i.e. 2 when Ids are 4 byte aligned)
endmenu

    choice
        prompt "Version"
        help
            Select the this package version

        config PKG_USING_SYSTEMVIEW_LATEST_VERSION
            bool "latest"

        config PKG_USING_SYSTEMVIEW_252A
            bool "v2.52a"

    endchoice

    config PKG_SYSTEMVIEW_VER
        string
        default "v2.52a" if PKG_USING_SYSTEMVIEW_252A
        default "latest" if PKG_USING_SYSTEMVIEW_LATEST_VERSION

endif
```

## tools/UrlEncode/Kconfig
```kconfig
# Kconfig file for package UrlEncode
menuconfig PKG_USING_URLENCODE
    bool "UrlEncode: a simple tool to Encode/Decode Url"
    default n

if PKG_USING_URLENCODE

    config PKG_URLENCODE_PATH
        string
        default "/packages/tools/UrlEncode"

    config URLENCODE_USING_SAMPLES
        bool "use urlencode example."
        default y

    choice
        prompt "Version"
        default PKG_USING_URLENCODE_LATEST_VERSION
        help
            Select the package version

        config PKG_USING_URLENCODE_V100
            bool "v1.0.0"

        config PKG_USING_URLENCODE_LATEST_VERSION
            bool "latest"
    endchoice

    config PKG_URLENCODE_VER
       string
       default "v1.0.0"    if PKG_USING_URLENCODE_V100
       default "latest"    if PKG_USING_URLENCODE_LATEST_VERSION

endif
```

## tools/Virtual-Terminal/Kconfig
```kconfig
# Kconfig file for package Virtual-Terminal
menuconfig PKG_USING_VIRTUAL_TERMINAL
    bool "Virtual-Terminal: High-speed virtual terminal"
    default n

if PKG_USING_VIRTUAL_TERMINAL

    config PKG_VIRTUAL_TERMINAL_PATH
        string
        default "/packages/tools/Virtual-Terminal"

    choice
        prompt "Version"
        help
            Select the package version

        config PKG_USING_VIRTUAL_TERMINAL_V100
            bool "v1.0.0"

        config PKG_USING_VIRTUAL_TERMINAL_LATEST_VERSION
            bool "latest"
    endchoice

    config PKG_VIRTUAL_TERMINAL_VER
       string
       default "v1.0.0"    if PKG_USING_VIRTUAL_TERMINAL_V100
       default "latest"    if PKG_USING_VIRTUAL_TERMINAL_LATEST_VERSION

endif
```

## tools/adbd/Kconfig
```kconfig
# Kconfig file for package adbd
menuconfig PKG_USING_ADBD
    bool "ADBD: Android Debug Bridge daemon implementation in RT-Thread"
    select RT_USING_DFS
    select RT_USING_LIBC
    select RT_USING_POSIX
    default n

if PKG_USING_ADBD
    config ADB_TR_TCPIP_ENABLE
        bool "Using TCPIP transfer"
        select RT_USING_SAL
        select SAL_USING_POSIX
        default y

    config ADB_TR_USB_ENABLE
        bool "Using USB transfer"
        select RT_USING_USB_DEVICE
        default n

    config ADB_TR_STACK_SIZE
        int "Set transfer thread stack size"
        default 1280

    config ADB_SERVICE_SHELL_ENABLE
        bool "Enable Shell service"
        default n

    config ADB_SERVICE_FILE_ENABLE
        bool "Enable File service"
        default n

    if ADB_SERVICE_FILE_ENABLE
        config ADB_FILESYNC_STACK_SIZE
            int "Set file service thread stack size"
            default 2304
            
        config ADB_FILESYNC_RECV_TIMEOUT
            int "Set file service receive timeout(ms)"
            default 2000
    endif

    config ADB_EXTERNAL_MOD_ENABLE
            bool "Enable external MOD"
            default n

    if ADB_EXTERNAL_MOD_ENABLE
        config ADB_FILESYNC_MOD_ENABLE
            bool "Enable File SYNC Mod"
            select ADB_SERVICE_FILE_ENABLE
            select PKG_USING_CJSON
            select PKG_USING_TINYCRYPT
            select TINY_CRYPT_MD5
            default n

        menuconfig ADB_FILELIST_MOD_ENABLE
            bool "Enable File LIST Mod"
            select ADB_SERVICE_FILE_ENABLE
            select PKG_USING_CJSON
            default n

        if ADB_FILELIST_MOD_ENABLE
            config ADB_FILELIST_FULL_PATH
                bool "Using full path"
                default n

            config ADB_FILELIST_SUP_MD5
                bool "Enable file MD5"
                select PKG_USING_TINYCRYPT
                select TINY_CRYPT_MD5
                default n

            config ADB_FILELIST_SUP_DEV
                bool "Enable Device ID"
                default n

            config ADB_FILELIST_SUP_INO
                bool "Enable node info"
                default n

            config ADB_FILELIST_SUP_MODE
                bool "Enable file type"
                default y

            config ADB_FILELIST_SUP_NLINK
                bool "Enable link num"
                default n

            config ADB_FILELIST_SUP_UID
                bool "Enable user ID"
                default n

            config ADB_FILELIST_SUP_GID
                bool "Enable group ID"
                default n

            config ADB_FILELIST_SUP_RDEV
                bool "Enable device type"
                default n

            config ADB_FILELIST_SUP_SIZE
                bool "Enable file size"
                default y

            config ADB_FILELIST_SUP_BLKSIZE
                bool "Enable block size"
                default n

            config ADB_FILELIST_SUP_BLOCKS
                bool "Enable block num"
                default n

            config ADB_FILELIST_SUP_ATIME
                bool "Enable access time"
                default n

            config ADB_FILELIST_SUP_MTIME
                bool "Enable modify time"
                default n

            config ADB_FILELIST_SUP_CTIME
                bool "Enable change time"
                default n
        endif
    endif

    config ADB_USING_SSDP
        bool "Enable ADB service discovery"
        select PKG_USING_LSSDP
        default n

    config PKG_ADBD_PATH
        string
        default "/packages/tools/adbd"

    choice
        prompt "Version"
        default PKG_USING_ADBD_LATEST_VERSION
        help
            Select the package version

        config PKG_USING_ADBD_V111
            bool "v1.1.1"

        config PKG_USING_ADBD_V110
            bool "v1.1.0"

        config PKG_USING_ADBD_LATEST_VERSION
            bool "latest"
    endchoice

    config PKG_ADBD_VER
       string
       default "v1.1.1"    if PKG_USING_ADBD_V111
       default "v1.1.0"    if PKG_USING_ADBD_V110
       default "latest"    if PKG_USING_ADBD_LATEST_VERSION

endif
```
