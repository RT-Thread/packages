## system/r-rhealstone/Kconfig
```kconfig
# Kconfig file for package r-rhealstone
menuconfig PKG_USING_R_RHEALSTONE
    bool "r-rhealstone: A cross platform real-time system benchmark testing framework"
    default n

if PKG_USING_R_RHEALSTONE

    config PKG_R_RHEALSTONE_PATH
        string
        default "/packages/system/r-rhealstone"

    config PKG_USING_R_RHEALSTONE_TASK_SWITCH
        bool "r-rhealstone: task switching time"
        default y

    config PKG_USING_R_RHEALSTONE_TASK_PREEMPT
        bool "r-rhealstone: task preemption time"
        default n

    config PKG_USING_R_RHEALSTONE_SEMAPHORE_SHUFFLE
        bool "r-rhealstone: semaphore shuffling time"
        default n

    config PKG_USING_R_RHEALSTONE_MESSAGE_LATENCY
        bool "r-rhealstone: intertask message latency"
        default n

    config PKG_USING_R_RHEALSTONE_INTERRUPT_LATENCY
        bool "r-rhealstone: interrupt latency time"
        default n

    config PKG_USING_R_RHEALSTONE_DEADLOCK_BREAK
        bool "r-rhealstone: deadlock breaking time"
        default n

    choice
        prompt "Version"
        default PKG_USING_R_RHEALSTONE_LATEST_VERSION
        help
            Select the package version

        config PKG_USING_R_RHEALSTONE_LATEST_VERSION
            bool "latest"
    endchoice

    config PKG_R_RHEALSTONE_VER
       string
       default "latest"    if PKG_USING_R_RHEALSTONE_LATEST_VERSION

endif
```

## system/ramdisk/Kconfig
```kconfig
# Kconfig file for package ramdisk
menuconfig PKG_USING_RAMDISK
    bool "ramdisk: A RAM memory block device."
    default n

if PKG_USING_RAMDISK

    config PKG_RAMDISK_PATH
        string
        default "/packages/system/ramdisk"

    choice
        prompt "Version"
        default PKG_USING_RAMDISK_LATEST_VERSION
        help
            Select the package version

        config PKG_USING_RAMDISK_V010
            bool "v0.1.0"

        config PKG_USING_RAMDISK_LATEST_VERSION
            bool "latest"
    endchoice

    config PKG_RAMDISK_VER
       string
       default "v0.1.0"    if PKG_USING_RAMDISK_V010
       default "latest"    if PKG_USING_RAMDISK_LATEST_VERSION

endif
```

## system/reb/Kconfig
```kconfig
# Kconfig file for package reb
menuconfig PKG_USING_REB
    bool "reb: Event broker component based on publish subscribe"
    select PKG_USING_RTP
    default n

if PKG_USING_REB

    config PKG_REB_PATH
        string
        default "/packages/system/reb"

    config PKG_USING_REB_EXAMPLE
        bool "reb example"
        default n

    choice
        prompt "Version"
        default PKG_USING_REB_LATEST_VERSION
        help
            Select the package version

        config PKG_USING_REB_LATEST_VERSION
            bool "latest"
    endchoice

    config PKG_REB_VER
       string
       default "latest"    if PKG_USING_REB_LATEST_VERSION

endif
```
