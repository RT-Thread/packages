## arduino/sensors/Adafruit-VL53L0X/Kconfig
```kconfig
# Kconfig file for package Adafruit-VL53L0X
menuconfig PKG_USING_ARDUINO_ADAFRUIT_VL53L0X
    bool "Adafruit VL53L0X: Time of Flight Distance Sensor"
    select PKG_USING_RTDUINO
    select RTDUINO_USING_WIRE
    default n

if PKG_USING_ARDUINO_ADAFRUIT_VL53L0X

    config PKG_ARDUINO_ADAFRUIT_VL53L0X_PATH
        string
        default "/packages/arduino/sensors/Adafruit-VL53L0X"

    choice
        prompt "Version"
        default PKG_USING_ARDUINO_ADAFRUIT_VL53L0X_LATEST_VERSION
        help
            Select the package version

        config PKG_USING_ARDUINO_ADAFRUIT_VL53L0X_LATEST_VERSION
            bool "latest"
    endchoice

    config PKG_ARDUINO_ADAFRUIT_VL53L0X_VER
       string
       default "latest"    if PKG_USING_ARDUINO_ADAFRUIT_VL53L0X_LATEST_VERSION

endif
```

## arduino/sensors/Adafruit-VL53L1X/Kconfig
```kconfig
# Kconfig file for package Adafruit-VL53L1X
menuconfig PKG_USING_ARDUINO_ADAFRUIT_VL53L1X
    bool "Adafruit VL53L0X Time of Flight Distance Sensor."
    select PKG_USING_RTDUINO
    select RTDUINO_USING_WIRE
    default n

if PKG_USING_ARDUINO_ADAFRUIT_VL53L1X

    config PKG_ARDUINO_ADAFRUIT_VL53L1X_PATH
        string
        default "/packages/arduino/sensors/Adafruit-VL53L1X"

    choice
        prompt "Version"
        default PKG_USING_ARDUINO_ADAFRUIT_VL53L1X_LATEST_VERSION
        help
            Select the package version

        config PKG_USING_ARDUINO_ADAFRUIT_VL53L1X_LATEST_VERSION
            bool "latest"
    endchoice

    config PKG_ARDUINO_ADAFRUIT_VL53L1X_VER
       string
       default "latest"    if PKG_USING_ARDUINO_ADAFRUIT_VL53L1X_LATEST_VERSION

endif
```

## arduino/sensors/Adafruit-VL6180X/Kconfig
```kconfig
# Kconfig file for package Adafruit-VL6180X
menuconfig PKG_USING_ARDUINO_ADAFRUIT_VL6180X
    bool "Adafruit VL6180X: Time of Flight Distance Sensor."
    select PKG_USING_RTDUINO
    select RTDUINO_USING_WIRE
    select PKG_USING_ARDUINO_ADAFRUIT_BUSIO
    default n

if PKG_USING_ARDUINO_ADAFRUIT_VL6180X

    config PKG_ARDUINO_ADAFRUIT_VL6180X_PATH
        string
        default "/packages/arduino/sensors/Adafruit-VL6180X"

    choice
        prompt "Version"
        default PKG_USING_ARDUINO_ADAFRUIT_VL6180X_LATEST_VERSION
        help
            Select the package version

        config PKG_USING_ARDUINO_ADAFRUIT_VL6180X_LATEST_VERSION
            bool "latest"
    endchoice

    config PKG_ARDUINO_ADAFRUIT_VL6180X_VER
       string
       default "latest"    if PKG_USING_ARDUINO_ADAFRUIT_VL6180X_LATEST_VERSION

endif
```

## arduino/sensors/Adafruit_AHTX0/Kconfig
```kconfig
# Kconfig file for package Adafruit_AHTX0
menuconfig PKG_USING_ARDUINO_ADAFRUIT_AHTX0
    bool "Adafruit AHTX0 (AHT10 & AHT20): Humidity and Temperature Sensor"
    select PKG_USING_RTDUINO
    select PKG_USING_ARDUINO_ADAFRUIT_SENSOR
    select PKG_USING_ARDUINO_ADAFRUIT_BUSIO
    default n

if PKG_USING_ARDUINO_ADAFRUIT_AHTX0

    config PKG_ARDUINO_ADAFRUIT_AHTX0_PATH
        string
        default "/packages/arduino/sensors/Adafruit_AHTX0"

    choice
        prompt "Version"
        default PKG_USING_ARDUINO_ADAFRUIT_AHTX0_LATEST_VERSION
        help
            Select the package version

        config PKG_USING_ARDUINO_ADAFRUIT_AHTX0_LATEST_VERSION
            bool "latest"
    endchoice

    config PKG_ARDUINO_ADAFRUIT_AHTX0_VER
       string
       default "latest"    if PKG_USING_ARDUINO_ADAFRUIT_AHTX0_LATEST_VERSION

endif
```

## arduino/sensors/Adafruit_BusIO/Kconfig
```kconfig
# Kconfig file for package Adafruit_BusIO
menuconfig PKG_USING_ARDUINO_ADAFRUIT_BUSIO
    bool "Adafruit BusIO"
    select PKG_USING_RTDUINO
    default n

if PKG_USING_ARDUINO_ADAFRUIT_BUSIO

    config PKG_ARDUINO_ADAFRUIT_BUSIO_PATH
        string
        default "/packages/arduino/sensors/Adafruit_BusIO"

    choice
        prompt "Version"
        default PKG_USING_ARDUINO_ADAFRUIT_BUSIO_LATEST_VERSION
        help
            Select the package version

        config PKG_USING_ARDUINO_ADAFRUIT_BUSIO_LATEST_VERSION
            bool "latest"
    endchoice

    config PKG_ARDUINO_ADAFRUIT_BUSIO_VER
       string
       default "latest"    if PKG_USING_ARDUINO_ADAFRUIT_BUSIO_LATEST_VERSION

endif
```

## arduino/sensors/CapacitiveSensor/Kconfig
```kconfig
# Kconfig file for package CapacitiveSensor
menuconfig PKG_USING_ARDUINO_CAPACITIVESENSOR
    bool "Capacitive Sensor: detect touch or proximity"
    select PKG_USING_RTDUINO
    default n

if PKG_USING_ARDUINO_CAPACITIVESENSOR

    config PKG_ARDUINO_CAPACITIVESENSOR_PATH
        string
        default "/packages/arduino/sensors/CapacitiveSensor"

    choice
        prompt "Version"
        default PKG_USING_ARDUINO_CAPACITIVESENSOR_LATEST_VERSION
        help
            Select the package version

        config PKG_USING_ARDUINO_CAPACITIVESENSOR_LATEST_VERSION
            bool "latest"
    endchoice

    config PKG_ARDUINO_CAPACITIVESENSOR_VER
       string
       default "latest"    if PKG_USING_ARDUINO_CAPACITIVESENSOR_LATEST_VERSION

endif
```

## arduino/sensors/DHT-sensor/Kconfig
```kconfig
# Kconfig file for package DHT-sensor
menuconfig PKG_USING_ARDUINO_DHT_SENSOR
    bool "DHT sensor: Arduino library for DHT11, DHT22, etc Temp & Humidity Sensors"
    select PKG_USING_RTDUINO
    select PKG_USING_ARDUINO_ADAFRUIT_SENSOR
    default n

if PKG_USING_ARDUINO_DHT_SENSOR

    config PKG_ARDUINO_DHT_SENSOR_PATH
        string
        default "/packages/arduino/sensors/DHT-sensor"

    choice
        prompt "Version"
        default PKG_USING_ARDUINO_DHT_SENSOR_LATEST_VERSION
        help
            Select the package version

        config PKG_USING_ARDUINO_DHT_SENSOR_LATEST_VERSION
            bool "latest"
    endchoice

    config PKG_ARDUINO_DHT_SENSOR_VER
       string
       default "latest"    if PKG_USING_ARDUINO_DHT_SENSOR_LATEST_VERSION

endif
```

## arduino/sensors/Jarzebski-MPU6050/Kconfig
```kconfig
# Kconfig file for package Jarzebski-MPU6050
menuconfig PKG_USING_ARDUINO_JARZEBSKI_MPU6050
    bool "Jarzebski MPU6050 6-DoF Accel and Gyro Sensor Driver"
    select PKG_USING_RTDUINO
    default n

if PKG_USING_ARDUINO_JARZEBSKI_MPU6050

    config PKG_ARDUINO_JARZEBSKI_MPU6050_PATH
        string
        default "/packages/arduino/sensors/Jarzebski-MPU6050"

    choice
        prompt "Version"
        default PKG_USING_ARDUINO_JARZEBSKI_MPU6050_LATEST_VERSION
        help
            Select the package version

        config PKG_USING_ARDUINO_JARZEBSKI_MPU6050_LATEST_VERSION
            bool "latest"
    endchoice

    config PKG_ARDUINO_JARZEBSKI_MPU6050_VER
       string
       default "latest"    if PKG_USING_ARDUINO_JARZEBSKI_MPU6050_LATEST_VERSION

endif
```

## arduino/sensors/Kconfig
```kconfig
menu "Sensors"

rsource "sensor-device-drivers/Kconfig"
rsource "Adafruit-Sensor/Kconfig"
rsource "Adafruit-SensorLab/Kconfig"
rsource "Adafruit-ADXL375/Kconfig"
rsource "Adafruit-VL53L0X/Kconfig"
rsource "Adafruit-VL53L1X/Kconfig"
rsource "Adafruit-VL6180X/Kconfig"
rsource "Adafruit-MAX31855/Kconfig"
rsource "Adafruit-MAX31865/Kconfig"
rsource "Adafruit-MAX31856/Kconfig"
rsource "Adafruit-MAX6675/Kconfig"
rsource "Adafruit-MLX90614/Kconfig"
rsource "Adafruit-LSM9DS1/Kconfig"
rsource "Adafruit-AHTX0/Kconfig"
rsource "Adafruit-LSM9DS0/Kconfig"
rsource "Adafruit-BMP280/Kconfig"
rsource "Adafruit-ADT7410/Kconfig"
rsource "Adafruit-BMP085/Kconfig"
rsource "Adafruit-BME680/Kconfig"
rsource "Adafruit-MCP9808/Kconfig"
rsource "Adafruit-MCP4728/Kconfig"
rsource "Adafruit-INA219/Kconfig"
rsource "Adafruit-LTR390/Kconfig"
rsource "Adafruit-ADXL345/Kconfig"
rsource "Adafruit-DHT/Kconfig"
rsource "Adafruit-MCP9600/Kconfig"
rsource "Adafruit-LSM6DS/Kconfig"
rsource "Adafruit-BNO055/Kconfig"
rsource "Adafruit-MAX1704X/Kconfig"
rsource "Adafruit-MMC56x3/Kconfig"
rsource "Adafruit-MLX90393/Kconfig"
rsource "Adafruit-MLX90395/Kconfig"
rsource "Adafruit-ICM20X/Kconfig"
rsource "Adafruit-DPS310/Kconfig"
rsource "Adafruit-HTS221/Kconfig"
rsource "Adafruit-SHT4X/Kconfig"
rsource "Adafruit-SHT31/Kconfig"
rsource "Adafruit-ADXL343/Kconfig"
rsource "Adafruit-BME280/Kconfig"
rsource "Adafruit-AS726x/Kconfig"
rsource "Adafruit-AMG88xx/Kconfig"
rsource "Adafruit-AM2320/Kconfig"
rsource "Adafruit-AM2315/Kconfig"
rsource "Adafruit-LTR329-LTR303/Kconfig"
rsource "Adafruit-BMP085-Unified/Kconfig"
rsource "Adafruit-BMP183/Kconfig"
rsource "Adafruit-BMP183-Unified/Kconfig"
rsource "Adafruit-BMP3XX/Kconfig"
rsource "Adafruit-MS8607/Kconfig"
rsource "Adafruit-LIS3MDL/Kconfig"
rsource "Adafruit-MLX90640/Kconfig"
rsource "Adafruit-MMA8451/Kconfig"
rsource "Adafruit-MSA301/Kconfig"
rsource "Adafruit-MPL115A2/Kconfig"
rsource "Adafruit-BNO08x/Kconfig"
rsource "Adafruit-BNO08x-RVC/Kconfig"
rsource "Adafruit-LIS2MDL/Kconfig"
rsource "Adafruit-LSM303DLH-Mag/Kconfig"
rsource "Adafruit-LC709203F/Kconfig"
rsource "Adafruit-CAP1188/Kconfig"
rsource "Adafruit-CCS811/Kconfig"
rsource "Adafruit-NAU7802/Kconfig"
rsource "Adafruit-LIS331/Kconfig"
rsource "Adafruit-LPS2X/Kconfig"
rsource "Adafruit-LPS35HW/Kconfig"
rsource "Adafruit-LSM303-Accel/Kconfig"
rsource "Adafruit-LIS3DH/Kconfig"
rsource "Adafruit-PCF8591/Kconfig"
rsource "Adafruit-MPL3115A2/Kconfig"
rsource "Adafruit-MPR121/Kconfig"
rsource "Adafruit-MPRLS/Kconfig"
rsource "Adafruit-MPU6050/Kconfig"
rsource "Adafruit-PCT2075/Kconfig"
rsource "Adafruit-PM25AQI/Kconfig"
rsource "Adafruit-EMC2101/Kconfig"
rsource "Adafruit-FXAS21002C/Kconfig"
rsource "Adafruit-SCD30/Kconfig"
rsource "Adafruit-FXOS8700/Kconfig"
rsource "Adafruit-HMC5883-Unified/Kconfig"
rsource "Adafruit-SGP30/Kconfig"
rsource "Adafruit-TMP006/Kconfig"
rsource "Adafruit-TLA202x/Kconfig"
rsource "Adafruit-TCS34725/Kconfig"
rsource "Adafruit-Si7021/Kconfig"
rsource "Adafruit-SI1145/Kconfig"
rsource "Adafruit-SGP40/Kconfig"
rsource "Adafruit-SHTC3/Kconfig"
rsource "Adafruit-HDC1000/Kconfig"
rsource "Adafruit-HTU21DF/Kconfig"
rsource "Adafruit-AS7341/Kconfig"
rsource "Adafruit-HTU31D/Kconfig"
rsource "Adafruit-INA260/Kconfig"
rsource "Adafruit-TMP007-Library/Kconfig"
rsource "Adafruit-L3GD20/Kconfig"
rsource "Adafruit-TMP117/Kconfig"
rsource "Adafruit-TSC2007/Kconfig"
rsource "Adafruit-TSL2561/Kconfig"
rsource "Adafruit-TSL2591-Library/Kconfig"
rsource "Adafruit-VCNL4040/Kconfig"
rsource "Adafruit-VEML6070/Kconfig"
rsource "Adafruit-VEML6075/Kconfig"
rsource "Adafruit-VEML7700/Kconfig"
rsource "Seeed-LIS3DHTR/Kconfig"
rsource "Seeed-DHT/Kconfig"
rsource "Seeed-ADXL335/Kconfig"
rsource "Seeed-ADXL345/Kconfig"
rsource "Seeed-BME280/Kconfig"
rsource "Seeed-BMP280/Kconfig"
rsource "Seeed-H3LIS331DL/Kconfig"
rsource "Seeed-MMA7660/Kconfig"
rsource "Seeed-TSL2561/Kconfig"
rsource "Seeed-PAJ7620/Kconfig"
rsource "Seeed-VL53L0X/Kconfig"
rsource "Seeed-ITG3200/Kconfig"
rsource "Seeed-SHT31/Kconfig"
rsource "Seeed-HP20x/Kconfig"
rsource "Seeed-DRV2605L/Kconfig"
rsource "Seeed-BBM150/Kconfig"
rsource "Seeed-HMC5883L/Kconfig"
rsource "Seeed-LSM303DLH/Kconfig"
rsource "Seeed-TCS3414CS/Kconfig"
rsource "Seeed-MP503/Kconfig"
rsource "Seeed-BMP085/Kconfig"
rsource "Seeed-HighTemp/Kconfig"
rsource "Seeed-VEML6070/Kconfig"
rsource "Seeed-Si1145/Kconfig"
rsource "Seeed-SHT35/Kconfig"
rsource "Seeed-AT42QT1070/Kconfig"
rsource "Seeed-LSM6DS3/Kconfig"
rsource "Seeed-HDC1000/Kconfig"
rsource "Seeed-HM3301/Kconfig"
rsource "Seeed-MCP9600/Kconfig"
rsource "Seeed-LTC2941/Kconfig"
rsource "Seeed-LDC1612/Kconfig"
rsource "CapacitiveSensor/Kconfig"
rsource "Jarzebski-MPU6050/Kconfig"

endmenu
```

## arduino/sensors/QMC5883L/Kconfig
```kconfig
# Kconfig file for package QMC5883L
menuconfig PKG_USING_ARDUINO_QMC5883L
    bool "QMC5883L: three-axis magnetometer sensor for electronic compass applications"
    select PKG_USING_RTDUINO
    default n

if PKG_USING_ARDUINO_QMC5883L

    config PKG_USING_ARDUINO_QMC5883L_PATH
        string
        default "/packages/arduino/sensors/QMC5883L"

    choice
        prompt "Version"
        default PKG_USING_ARDUINO_QMC5883L_LATEST_VERSION
        help
            Select the package version

        config PKG_USING_ARDUINO_QMC5883L_LATEST_VERSION
            bool "latest"
    endchoice

    config PKG_USING_ARDUINO_QMC5883L_VER
       string
       default "latest"    if PKG_USING_ARDUINO_QMC5883L_LATEST_VERSION

endif
```

## arduino/sensors/SC7A20/Kconfig
```kconfig
# Kconfig file for package SC7A20
menuconfig PKG_USING_ARDUINO_SC7A20
    bool "SC7A20: Three-axis accelerometer sensor"
    select PKG_USING_RTDUINO
    default n

if PKG_USING_ARDUINO_SC7A20

    config PKG_USING_ARDUINO_SC7A20_PATH
        string
        default "/packages/arduino/sensors/SC7A20"

    choice
        prompt "Version"
        default PKG_USING_ARDUINO_SC7A20_LATEST_VERSION
        help
            Select the package version

        config PKG_USING_ARDUINO_SC7A20_LATEST_VERSION
            bool "latest"
    endchoice

    config PKG_USING_ARDUINO_SC7A20_VER
       string
       default "latest"    if PKG_USING_ARDUINO_SC7A20_LATEST_VERSION

endif
```

## arduino/sensors/Seeed-24GHz-Radar/Kconfig
```kconfig
# Kconfig file for package Seeed-24GHz-Radar
menuconfig PKG_USING_ARDUINO_SEEED_24GHZ_RADAR
    bool "Seeed Radar Sensor: 24GHz mmWave module"
    select PKG_USING_RTDUINO
    default n

if PKG_USING_ARDUINO_SEEED_24GHZ_RADAR

    config PKG_ARDUINO_SEEED_24GHZ_RADAR_PATH
        string
        default "/packages/arduino/sensors/Seeed-24GHz-Radar"

    choice
        prompt "Version"
        default PKG_USING_ARDUINO_SEEED_24GHZ_RADAR_LATEST_VERSION
        help
            Select the package version

        config PKG_USING_ARDUINO_SEEED_24GHZ_RADAR_LATEST_VERSION
            bool "latest"
    endchoice

    config PKG_ARDUINO_SEEED_24GHZ_RADAR_VER
       string
       default "latest"    if PKG_USING_ARDUINO_SEEED_24GHZ_RADAR_LATEST_VERSION

endif
```

## arduino/sensors/Seeed-3-Axis-Digital-Gyro/Kconfig
```kconfig
# Kconfig file for package Seeed-3-Axis-Digital-Gyro
menuconfig PKG_USING_SEEED_3_AXIS_DIGITAL_GYRO
    bool "Seeed 3-Axis-Digital-Gyro: 3-Axis-Digital-Gyro Sensor"
    default n

if PKG_USING_SEEED_3_AXIS_DIGITAL_GYRO

    config PKG_SEEED_3_AXIS_DIGITAL_GYRO_PATH
        string
        default "/packages/peripherals/sensors/Seeed-3-Axis-Digital-Gyro"

    choice
        prompt "Version"
        default PKG_USING_SEEED_3_AXIS_DIGITAL_GYRO_LATEST_VERSION
        help
            Select the package version

        config PKG_USING_SEEED_3_AXIS_DIGITAL_GYRO_LATEST_VERSION
            bool "latest"
    endchoice

    config PKG_SEEED_3_AXIS_DIGITAL_GYRO_VER
       string
       default "latest"    if PKG_USING_SEEED_3_AXIS_DIGITAL_GYRO_LATEST_VERSION

endif
```

## arduino/sensors/Seeed-ADXL335/Kconfig
```kconfig
# Kconfig file for package Seeed-ADXL335
menuconfig PKG_USING_ARDUINO_SEEED_ADXL335
    bool "Seeed ADXL335: complete 3-axis accelerometer"
    select PKG_USING_RTDUINO
    default n

if PKG_USING_ARDUINO_SEEED_ADXL335

    config PKG_ARDUINO_SEEED_ADXL335_PATH
        string
        default "/packages/arduino/sensors/Seeed-ADXL335"

    choice
        prompt "Version"
        default PKG_USING_ARDUINO_SEEED_ADXL335_LATEST_VERSION
        help
            Select the package version

        config PKG_USING_ARDUINO_SEEED_ADXL335_LATEST_VERSION
            bool "latest"
    endchoice

    config PKG_ARDUINO_SEEED_ADXL335_VER
       string
       default "latest"    if PKG_USING_ARDUINO_SEEED_ADXL335_LATEST_VERSION

endif
```
