## arduino/sensors/Adafruit-PM25AQI/Kconfig
```kconfig
# Kconfig file for package Adafruit-PM25AQI
menuconfig PKG_USING_ARDUINO_ADAFRUIT_PM25AQI
    bool "Adafruit PM25AQI: PM2.5 Air Quality sensor"
    select PKG_USING_RTDUINO
    select RTDUINO_USING_WIRE
    select PKG_USING_ARDUINO_ADAFRUIT_BUSIO
    default n

if PKG_USING_ARDUINO_ADAFRUIT_PM25AQI

    config PKG_ARDUINO_ADAFRUIT_PM25AQI_PATH
        string
        default "/packages/arduino/sensors/Adafruit-PM25AQI"

    choice
        prompt "Version"
        default PKG_USING_ARDUINO_ADAFRUIT_PM25AQI_LATEST_VERSION
        help
            Select the package version

        config PKG_USING_ARDUINO_ADAFRUIT_PM25AQI_LATEST_VERSION
            bool "latest"
    endchoice

    config PKG_ARDUINO_ADAFRUIT_PM25AQI_VER
       string
       default "latest"    if PKG_USING_ARDUINO_ADAFRUIT_PM25AQI_LATEST_VERSION

endif
```

## arduino/sensors/Adafruit-SCD30/Kconfig
```kconfig
# Kconfig file for package Adafruit-SCD30
menuconfig PKG_USING_ARDUINO_ADAFRUIT_SCD30
    bool "Adafruit SCD30: CO2, Temperature, and Humidity Sensor"
    select PKG_USING_RTDUINO
    select RTDUINO_USING_WIRE
    select PKG_USING_ARDUINO_ADAFRUIT_SENSOR
    select PKG_USING_ARDUINO_ADAFRUIT_BUSIO
    default n

if PKG_USING_ARDUINO_ADAFRUIT_SCD30

    config PKG_ARDUINO_ADAFRUIT_SCD30_PATH
        string
        default "/packages/arduino/sensors/Adafruit-SCD30"

    choice
        prompt "Version"
        default PKG_USING_ARDUINO_ADAFRUIT_SCD30_LATEST_VERSION
        help
            Select the package version

        config PKG_USING_ARDUINO_ADAFRUIT_SCD30_LATEST_VERSION
            bool "latest"
    endchoice

    config PKG_ARDUINO_ADAFRUIT_SCD30_VER
       string
       default "latest"    if PKG_USING_ARDUINO_ADAFRUIT_SCD30_LATEST_VERSION

endif
```

## arduino/sensors/Adafruit-SGP30/Kconfig
```kconfig
# Kconfig file for package Adafruit-SGP30
menuconfig PKG_USING_ARDUINO_ADAFRUIT_SGP30
    bool "Adafruit SGP30: Air Quality Sensor"
    select PKG_USING_RTDUINO
    select RTDUINO_USING_WIRE
    select PKG_USING_ARDUINO_ADAFRUIT_BUSIO
    default n

if PKG_USING_ARDUINO_ADAFRUIT_SGP30

    config PKG_ARDUINO_ADAFRUIT_SGP30_PATH
        string
        default "/packages/arduino/sensors/Adafruit-SGP30"

    choice
        prompt "Version"
        default PKG_USING_ARDUINO_ADAFRUIT_SGP30_LATEST_VERSION
        help
            Select the package version

        config PKG_USING_ARDUINO_ADAFRUIT_SGP30_LATEST_VERSION
            bool "latest"
    endchoice

    config PKG_ARDUINO_ADAFRUIT_SGP30_VER
       string
       default "latest"    if PKG_USING_ARDUINO_ADAFRUIT_SGP30_LATEST_VERSION

endif
```

## arduino/sensors/Adafruit-SGP40/Kconfig
```kconfig
# Kconfig file for package Adafruit-SGP40
menuconfig PKG_USING_ARDUINO_ADAFRUIT_SGP40
    bool "Adafruit SGP40: Gas/Air Quality I2C Sensor"
    select PKG_USING_RTDUINO
    select RTDUINO_USING_WIRE
    select PKG_USING_ARDUINO_ADAFRUIT_BUSIO
    default n

if PKG_USING_ARDUINO_ADAFRUIT_SGP40

    config PKG_ARDUINO_ADAFRUIT_SGP40_PATH
        string
        default "/packages/arduino/sensors/Adafruit-SGP40"

    choice
        prompt "Version"
        default PKG_USING_ARDUINO_ADAFRUIT_SGP40_LATEST_VERSION
        help
            Select the package version

        config PKG_USING_ARDUINO_ADAFRUIT_SGP40_LATEST_VERSION
            bool "latest"
    endchoice

    config PKG_ARDUINO_ADAFRUIT_SGP40_VER
       string
       default "latest"    if PKG_USING_ARDUINO_ADAFRUIT_SGP40_LATEST_VERSION

endif
```

## arduino/sensors/Adafruit-SHT31/Kconfig
```kconfig
# Kconfig file for package Adafruit-SHT31
menuconfig PKG_USING_ARDUINO_ADAFRUIT_SHT31
    bool "Adafruit SHT31: Temperature and Humidity Sensor"
    select PKG_USING_RTDUINO
    select RTDUINO_USING_WIRE
    select PKG_USING_ARDUINO_ADAFRUIT_BUSIO
    default n

if PKG_USING_ARDUINO_ADAFRUIT_SHT31

    config PKG_ARDUINO_ADAFRUIT_SHT31_PATH
        string
        default "/packages/arduino/sensors/Adafruit-SHT31"

    choice
        prompt "Version"
        default PKG_USING_ARDUINO_ADAFRUIT_SHT31_LATEST_VERSION
        help
            Select the package version

        config PKG_USING_ARDUINO_ADAFRUIT_SHT31_LATEST_VERSION
            bool "latest"
    endchoice

    config PKG_ARDUINO_ADAFRUIT_SHT31_VER
       string
       default "latest"    if PKG_USING_ARDUINO_ADAFRUIT_SHT31_LATEST_VERSION

endif
```

## arduino/sensors/Adafruit-SHT4X/Kconfig
```kconfig
# Kconfig file for package Adafruit-SHT4X
menuconfig PKG_USING_ARDUINO_ADAFRUIT_SHT4X
    bool "Adafruit SHT4X: temperature & humidity sensor"
    select PKG_USING_RTDUINO
    select RTDUINO_USING_WIRE
    select PKG_USING_ARDUINO_ADAFRUIT_SENSOR
    select PKG_USING_ARDUINO_ADAFRUIT_BUSIO
    default n

if PKG_USING_ARDUINO_ADAFRUIT_SHT4X

    config PKG_ARDUINO_ADAFRUIT_SHT4X_PATH
        string
        default "/packages/arduino/sensors/Adafruit-SHT4X"

    choice
        prompt "Version"
        default PKG_USING_ARDUINO_ADAFRUIT_SHT4X_LATEST_VERSION
        help
            Select the package version

        config PKG_USING_ARDUINO_ADAFRUIT_SHT4X_LATEST_VERSION
            bool "latest"
    endchoice

    config PKG_ARDUINO_ADAFRUIT_SHT4X_VER
       string
       default "latest"    if PKG_USING_ARDUINO_ADAFRUIT_SHT4X_LATEST_VERSION

endif
```

## arduino/sensors/Adafruit-SHTC3/Kconfig
```kconfig
# Kconfig file for package Adafruit-SHTC3
menuconfig PKG_USING_ARDUINO_ADAFRUIT_SHTC3
    bool "Adafruit-SHTC3: Temperature and Humidity Sensor"
    select PKG_USING_RTDUINO
    select RTDUINO_USING_WIRE
    select PKG_USING_ARDUINO_ADAFRUIT_SENSOR
    select PKG_USING_ARDUINO_ADAFRUIT_BUSIO
    default n

if PKG_USING_ARDUINO_ADAFRUIT_SHTC3

    config PKG_ARDUINO_ADAFRUIT_SHTC3_PATH
        string
        default "/packages/arduino/sensors/Adafruit-SHTC3"

    choice
        prompt "Version"
        default PKG_USING_ARDUINO_ADAFRUIT_SHTC3_LATEST_VERSION
        help
            Select the package version

        config PKG_USING_ARDUINO_ADAFRUIT_SHTC3_LATEST_VERSION
            bool "latest"
    endchoice

    config PKG_ARDUINO_ADAFRUIT_SHTC3_VER
       string
       default "latest"    if PKG_USING_ARDUINO_ADAFRUIT_SHTC3_LATEST_VERSION

endif
```

## arduino/sensors/Adafruit-SI1145/Kconfig
```kconfig
# Kconfig file for package Adafruit-SI1145
menuconfig PKG_USING_ARDUINO_ADAFRUIT_SI1145
    bool "Adafruit Si1145: UV/IR/Visible Light Sensor"
    select PKG_USING_RTDUINO
    select RTDUINO_USING_WIRE
    select PKG_USING_ARDUINO_ADAFRUIT_BUSIO
    default n

if PKG_USING_ARDUINO_ADAFRUIT_SI1145

    config PKG_ARDUINO_ADAFRUIT_SI1145_PATH
        string
        default "/packages/arduino/sensors/Adafruit-SI1145"

    choice
        prompt "Version"
        default PKG_USING_ARDUINO_ADAFRUIT_SI1145_LATEST_VERSION
        help
            Select the package version

        config PKG_USING_ARDUINO_ADAFRUIT_SI1145_LATEST_VERSION
            bool "latest"
    endchoice

    config PKG_ARDUINO_ADAFRUIT_SI1145_VER
       string
       default "latest"    if PKG_USING_ARDUINO_ADAFRUIT_SI1145_LATEST_VERSION

endif
```

## arduino/sensors/Adafruit-Sensor-Calibration/Kconfig
```kconfig
# Kconfig file for package Adafruit-Sensor-Calibration
menuconfig PKG_USING_ARDUINO_ADAFRUIT_SENSOR_CALIBRATION
    bool "Adafruit-Sensor-Calibration: Adafruit Unified Sensor Calibration Framework"
    select PKG_USING_RTDUINO
    select PKG_USING_ARDUINO_ADAFRUIT_SENSOR 
    default n

if PKG_USING_ARDUINO_ADAFRUIT_SENSOR_CALIBRATION

    config PKG_ARDUINO_ADAFRUIT_SENSOR_CALIBRATION_PATH
        string
        default "/packages/arduino/sensors/Adafruit-Sensor-Calibration"

    choice
        prompt "Version"
        default PKG_USING_ARDUINO_ADAFRUIT_SENSOR_CALIBRATION_LATEST_VERSION
        help
            Select the package version

        config PKG_USING_ARDUINO_ADAFRUIT_SENSOR_CALIBRATION_LATEST_VERSION
            bool "latest"
    endchoice

    config PKG_ARDUINO_ADAFRUIT_SENSOR_CALIBRATION_VER
       string
       default "latest"    if PKG_USING_ARDUINO_ADAFRUIT_SENSOR_CALIBRATION_LATEST_VERSION

endif
```

## arduino/sensors/Adafruit-Sensor/Kconfig
```kconfig
# Kconfig file for package Adafruit_Sensor
menuconfig PKG_USING_ARDUINO_ADAFRUIT_SENSOR
    bool "Adafruit Unified Sensor Framework"
    select PKG_USING_RTDUINO
    default n

if PKG_USING_ARDUINO_ADAFRUIT_SENSOR

    config PKG_ARDUINO_ADAFRUIT_SENSOR_PATH
        string
        default "/packages/arduino/sensors/Adafruit-Sensor"

    choice
        prompt "Version"
        default PKG_USING_ARDUINO_ADAFRUIT_SENSOR_LATEST_VERSION
        help
            Select the package version

        config PKG_USING_ARDUINO_ADAFRUIT_SENSOR_LATEST_VERSION
            bool "latest"
    endchoice

    config PKG_ARDUINO_ADAFRUIT_SENSOR_VER
       string
       default "latest"    if PKG_USING_ARDUINO_ADAFRUIT_SENSOR_LATEST_VERSION

endif
```

## arduino/sensors/Adafruit-SensorLab/Kconfig
```kconfig
# Kconfig file for package Adafruit-SensorLab
menuconfig PKG_USING_ARDUINO_ADAFRUIT_SENSORLAB
    bool "Adafruit-SensorLab: scientific sensor readings/fusions/manipulations drivers"
    select PKG_USING_RTDUINO
    select PKG_USING_ARDUINO_ADAFRUIT_SENSOR
    default n

if PKG_USING_ARDUINO_ADAFRUIT_SENSORLAB

    config PKG_ARDUINO_ADAFRUIT_SENSORLAB_PATH
        string
        default "/packages/arduino/sensors/Adafruit-SensorLab"

    choice
        prompt "Version"
        default PKG_USING_ARDUINO_ADAFRUIT_SENSORLAB_LATEST_VERSION
        help
            Select the package version

        config PKG_USING_ARDUINO_ADAFRUIT_SENSORLAB_LATEST_VERSION
            bool "latest"
    endchoice

    config PKG_ARDUINO_ADAFRUIT_SENSORLAB_VER
       string
       default "latest"    if PKG_USING_ARDUINO_ADAFRUIT_SENSORLAB_LATEST_VERSION

endif
```

## arduino/sensors/Adafruit-Si7021/Kconfig
```kconfig
# Kconfig file for package Adafruit-Si7021
menuconfig PKG_USING_ARDUINO_ADAFRUIT_SI7021
    bool "Adafruit-Si7021: Temperature And Humidity Sensor"
    select PKG_USING_RTDUINO
    select RTDUINO_USING_WIRE
    select PKG_USING_ARDUINO_ADAFRUIT_BUSIO
    default n

if PKG_USING_ARDUINO_ADAFRUIT_SI7021

    config PKG_ARDUINO_ADAFRUIT_SI7021_PATH
        string
        default "/packages/arduino/sensors/Adafruit-Si7021"

    choice
        prompt "Version"
        default PKG_USING_ARDUINO_ADAFRUIT_SI7021_LATEST_VERSION
        help
            Select the package version

        config PKG_USING_ARDUINO_ADAFRUIT_SI7021_LATEST_VERSION
            bool "latest"
    endchoice

    config PKG_ARDUINO_ADAFRUIT_SI7021_VER
       string
       default "latest"    if PKG_USING_ARDUINO_ADAFRUIT_SI7021_LATEST_VERSION

endif
```

## arduino/sensors/Adafruit-TCS34725/Kconfig
```kconfig
# Kconfig file for package Adafruit-TCS34725
menuconfig PKG_USING_ARDUINO_ADAFRUIT_TCS34725
    bool "Adafruit-TCS34725: RGB Color Sensor"
    select PKG_USING_RTDUINO
    select RTDUINO_USING_WIRE
    select PKG_USING_ARDUINO_ADAFRUIT_BUSIO
    default n

if PKG_USING_ARDUINO_ADAFRUIT_TCS34725

    config PKG_ARDUINO_ADAFRUIT_TCS34725_PATH
        string
        default "/packages/arduino/sensors/Adafruit-TCS34725"

    choice
        prompt "Version"
        default PKG_USING_ARDUINO_ADAFRUIT_TCS34725_LATEST_VERSION
        help
            Select the package version

        config PKG_USING_ARDUINO_ADAFRUIT_TCS34725_LATEST_VERSION
            bool "latest"
    endchoice

    config PKG_ARDUINO_ADAFRUIT_TCS34725_VER
       string
       default "latest"    if PKG_USING_ARDUINO_ADAFRUIT_TCS34725_LATEST_VERSION

endif
```

## arduino/sensors/Adafruit-TLA202x/Kconfig
```kconfig
# Kconfig file for package Adafruit-TLA202x
menuconfig PKG_USING_ARDUINO_ADAFRUIT_TLA202X
    bool "Adafruit TLA202x: ADCs sensor"
    select PKG_USING_RTDUINO
    select RTDUINO_USING_WIRE
    select PKG_USING_ARDUINO_ADAFRUIT_SENSOR
    select PKG_USING_ARDUINO_ADAFRUIT_BUSIO
    default n

if PKG_USING_ARDUINO_ADAFRUIT_TLA202X

    config PKG_ARDUINO_ADAFRUIT_TLA202X_PATH
        string
        default "/packages/arduino/sensors/Adafruit-TLA202x"

    choice
        prompt "Version"
        default PKG_USING_ARDUINO_ADAFRUIT_TLA202X_LATEST_VERSION
        help
            Select the package version

        config PKG_USING_ARDUINO_ADAFRUIT_TLA202X_LATEST_VERSION
            bool "latest"
    endchoice

    config PKG_ARDUINO_ADAFRUIT_TLA202X_VER
       string
       default "latest"    if PKG_USING_ARDUINO_ADAFRUIT_TLA202X_LATEST_VERSION

endif
```

## arduino/sensors/Adafruit-TMP006/Kconfig
```kconfig
# Kconfig file for package Adafruit-TMP006
menuconfig PKG_USING_ARDUINO_ADAFRUIT_TMP006
    bool "Adafruit-TMP006: IR Thermopile Library"
    select PKG_USING_RTDUINO
    select RTDUINO_USING_WIRE
    select PKG_USING_ARDUINO_ADAFRUIT_SENSOR
    default n

if PKG_USING_ARDUINO_ADAFRUIT_TMP006

    config PKG_ARDUINO_ADAFRUIT_TMP006_PATH
        string
        default "/packages/arduino/sensors/Adafruit-TMP006"

    choice
        prompt "Version"
        default PKG_USING_ARDUINO_ADAFRUIT_TMP006_LATEST_VERSION
        help
            Select the package version

        config PKG_USING_ARDUINO_ADAFRUIT_TMP006_LATEST_VERSION
            bool "latest"
    endchoice

    config PKG_ARDUINO_ADAFRUIT_TMP006_VER
       string
       default "latest"    if PKG_USING_ARDUINO_ADAFRUIT_TMP006_LATEST_VERSION

endif
```

## arduino/sensors/Adafruit-TMP007-Library/Kconfig
```kconfig
# Kconfig file for package Adafruit-TMP007-Library
menuconfig PKG_USING_ARDUINO_ADAFRUIT_TMP007_LIBRARY
    bool "Adafruit TMP007: Contact-less Infrared Thermopile Sensor"
    select PKG_USING_RTDUINO
    select RTDUINO_USING_WIRE
    select PKG_USING_ARDUINO_ADAFRUIT_SENSOR
    select PKG_USING_ARDUINO_ADAFRUIT_BUSIO
    default n

if PKG_USING_ARDUINO_ADAFRUIT_TMP007_LIBRARY

    config PKG_ARDUINO_ADAFRUIT_TMP007_LIBRARY_PATH
        string
        default "/packages/arduino/sensors/Adafruit-TMP007-Library"

    choice
        prompt "Version"
        default PKG_USING_ARDUINO_ADAFRUIT_TMP007_LIBRARY_LATEST_VERSION
        help
            Select the package version

        config PKG_USING_ARDUINO_ADAFRUIT_TMP007_LIBRARY_LATEST_VERSION
            bool "latest"
    endchoice

    config PKG_ARDUINO_ADAFRUIT_TMP007_LIBRARY_VER
       string
       default "latest"    if PKG_USING_ARDUINO_ADAFRUIT_TMP007_LIBRARY_LATEST_VERSION

endif
```

## arduino/sensors/Adafruit-TMP117/Kconfig
```kconfig
# Kconfig file for package Adafruit-TMP117
menuconfig PKG_USING_ARDUINO_ADAFRUIT_TMP117
    bool "Adafruit TMP117: High Precision Digital Temperature Sensor"
    select PKG_USING_RTDUINO
    select RTDUINO_USING_WIRE
    select PKG_USING_ARDUINO_ADAFRUIT_SENSOR
    select PKG_USING_ARDUINO_ADAFRUIT_BUSIO
    default n

if PKG_USING_ARDUINO_ADAFRUIT_TMP117

    config PKG_ARDUINO_ADAFRUIT_TMP117_PATH
        string
        default "/packages/arduino/sensors/Adafruit-TMP117"

    choice
        prompt "Version"
        default PKG_USING_ARDUINO_ADAFRUIT_TMP117_LATEST_VERSION
        help
            Select the package version

        config PKG_USING_ARDUINO_ADAFRUIT_TMP117_LATEST_VERSION
            bool "latest"
    endchoice

    config PKG_ARDUINO_ADAFRUIT_TMP117_VER
       string
       default "latest"    if PKG_USING_ARDUINO_ADAFRUIT_TMP117_LATEST_VERSION

endif
```
