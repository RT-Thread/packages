## iot/netutils/Kconfig
```kconfig
menuconfig PKG_USING_NETUTILS
    bool "netutils: Networking utilities for RT-Thread"
    default n

if PKG_USING_NETUTILS

    config PKG_NETUTILS_PATH
        string
        default "/packages/iot/netutils"

    config PKG_NETUTILS_PING
        bool "Enable Ping utility"
        depends on (!RT_USING_NETDEV && RT_USING_LWIP)
        select RT_LWIP_ICMP
        select RT_LWIP_RAW
        default n

    if PKG_NETUTILS_VER_NUM < 0x10200
        config PKG_NETUTILS_TFTP
            bool "Enable TFTP(Trivial File Transfer Protocol) server"
            default n
            depends on RT_USING_LWIP
        if PKG_NETUTILS_TFTP
            config NETUTILS_TFTP_PORT
                int "TFTP server port"
                range 0 65535
                default 69
        endif
    endif

    if PKG_NETUTILS_VER_NUM >= 0x10200
        config PKG_NETUTILS_TFTP
            bool "Enable TFTP(Trivial File Transfer Protocol) server"
            select RT_USING_LIBC            if RT_VER_NUM < 0x40100
            select RT_USING_SAL             if RT_VER_NUM < 0x40100
            select SAL_USING_POSIX          if RT_VER_NUM < 0x40100
            select RT_USING_POSIX_FS        if RT_VER_NUM >= 0x40100
            select RT_USING_POSIX_SOCKET    if RT_VER_NUM >= 0x40100
            default n
    endif

    config PKG_NETUTILS_IPERF
        bool "Enable iperf-liked network performance tool"
        select RT_USING_LIBC            if RT_VER_NUM < 0x40100
        select RT_USING_SAL             if RT_VER_NUM < 0x40100
        select SAL_USING_POSIX          if RT_VER_NUM < 0x40100
        select RT_USING_POSIX_FS        if RT_VER_NUM >= 0x40100
        select RT_USING_POSIX_SOCKET    if RT_VER_NUM >= 0x40100
        default n

    config IPERF_THREAD_STACK_SIZE
        int "the stack size of iperf thread"
        depends on PKG_NETUTILS_IPERF
        range 2048 65536
        default 16384 if ARCH_CPU_64BIT
        default 2048

    config PKG_NETUTILS_NETIO
        bool "Enable NetIO network throughput performance tool"
        default n
        depends on RT_USING_LWIP

    config PKG_NETUTILS_NTP
        bool "Enable NTP(Network Time Protocol) client"
        select RT_USING_SAL
        default n

    if PKG_NETUTILS_NTP
        config NTP_USING_AUTO_SYNC
            bool "Enable NTP to synchronize RTC automatically"
            depends on PKG_NETUTILS_VER_NUM > 0x10200
            select RT_USING_SYSTEM_WORKQUEUE
            default y

        if NTP_USING_AUTO_SYNC
            config NTP_AUTO_SYNC_FIRST_DELAY
                int "NTP first sync delay time(second) for network connect"
                default 30

            config NTP_AUTO_SYNC_PERIOD
                int "NTP auto sync period(second)"
                default 3600
        endif

        config NETUTILS_NTP_TIMEZONE
            int "Timezone for calculate local time"
            depends on PKG_NETUTILS_VER_NUM <= 0x10200
            range -12 12
            default 8

        config NETUTILS_NTP_HOSTNAME
            string "NTP server name1"
            default "cn.ntp.org.cn"

        config NETUTILS_NTP_HOSTNAME2
            string "NTP server name2"
            default "ntp.rt-thread.org"

        config NETUTILS_NTP_HOSTNAME3
            string "NTP server name3"
            default "edu.ntp.org.cn"
    endif

    config PKG_NETUTILS_TELNET
        bool "Enable Telnet server"
        default n

    config PKG_NETUTILS_TCPDUMP
        bool "Enable tcpdump tool"
        depends on RT_USING_LWIP
        select PKG_USING_OPTPARSE
        select RT_USING_DFS      if RT_VER_NUM < 0x40100
        select RT_USING_POSIX_FS if RT_VER_NUM >= 0x40100
        help
            Select the tcpdump tool

    if PKG_NETUTILS_TCPDUMP
        config PKG_NETUTILS_TCPDUMP_PRINT
            bool "Enable tcpdump pcap data to print on the console"
            default n
            help
                Enable tcpdump pcap data to print on the console

        config PKG_NETUTILS_TCPDUMP_DBG
            bool "Enable tcpdump debug log output"
            default y
    endif

    choice
        prompt "Version"
        help
            Select the netutils version

        config PKG_USING_NETUTILS_LATEST_VERSION
            bool "latest"

        config PKG_USING_NETUTILS_V133
            bool "v1.3.3"
            depends on RT_VER_NUM >= 0x40100

        config PKG_USING_NETUTILS_V132
            bool "v1.3.2"
            depends on RT_VER_NUM < 0x40100

        config PKG_USING_NETUTILS_V131
            bool "v1.3.1"
            depends on RT_VER_NUM < 0x40100

        config PKG_USING_NETUTILS_V130
            bool "v1.3.0"
            depends on RT_VER_NUM < 0x40100

        config PKG_USING_NETUTILS_V120
            bool "v1.2.0"
            depends on RT_VER_NUM < 0x40004

        config PKG_USING_NETUTILS_V110
            bool "v1.1.0"
            depends on RT_VER_NUM < 0x40004

        config PKG_USING_NETUTILS_V100
            bool "v1.0.0"
            depends on RT_VER_NUM < 0x40004

    endchoice

    config PKG_NETUTILS_VER
        string
        default "v1.3.3" if PKG_USING_NETUTILS_V133
        default "v1.3.2" if PKG_USING_NETUTILS_V132
        default "v1.3.1" if PKG_USING_NETUTILS_V131
        default "v1.3.0" if PKG_USING_NETUTILS_V130
        default "v1.2.0" if PKG_USING_NETUTILS_V120
        default "v1.1.0" if PKG_USING_NETUTILS_V110
        default "v1.0.0" if PKG_USING_NETUTILS_V100
        default "latest" if PKG_USING_NETUTILS_LATEST_VERSION

    config PKG_NETUTILS_VER_NUM
        hex
        default 0x99999    if PKG_USING_NETUTILS_LATEST_VERSION
        default 0x10303    if PKG_USING_NETUTILS_V133
        default 0x10302    if PKG_USING_NETUTILS_V132
        default 0x10301    if PKG_USING_NETUTILS_V131
        default 0x10300    if PKG_USING_NETUTILS_V130
        default 0x10200    if PKG_USING_NETUTILS_V120
        default 0x10100    if PKG_USING_NETUTILS_V110
        default 0x10000    if PKG_USING_NETUTILS_V100

endif
```

## iot/nmealib/Kconfig
```kconfig
# Kconfig file for package nmealib
menuconfig PKG_USING_NMEALIB
    bool "nmealib: A NMEA Library for RT-Thread."
    default n

if PKG_USING_NMEALIB

    config PKG_NMEALIB_PATH
        string
        default "/packages/iot/nmealib"

    config PKG_USING_NMEALIB_EXAMPLES
        bool "Enable nmealib uart sample"
        default n
        if PKG_USING_NMEALIB_EXAMPLES
            config NMEALIB_UART_PORT
            string  "uart name e.g. uart3"
            default "uart3"
            config NMEALIB_UART_BAUDRATE
            int "uart baudrate used by sample"
            default 9600
        endif

    config NMEALIB_DEBUG
        bool "Enable nmealib trace and error"
        default n

    choice
        prompt "Version"
        default PKG_USING_NMEALIB_LATEST_VERSION
        help
            Select the package version

        config PKG_USING_NMEALIB_V100
            bool "v1.0.0"

        config PKG_USING_NMEALIB_LATEST_VERSION
            bool "latest"
    endchoice

    config PKG_NMEALIB_VER
       string
       default "v1.0.0"    if PKG_USING_NMEALIB_V100
       default "latest"    if PKG_USING_NMEALIB_LATEST_VERSION

endif
```

## iot/nopoll/Kconfig
```kconfig
menuconfig PKG_USING_NOPOLL
    bool "nopoll: A OpenSource WebSocket implementation (RFC 6455) in ansi C"
    select RT_USING_LWIP
    select PKG_USING_TINYCRYPT
    select TINY_CRYPT_SHA1
    default n

    help
        nopoll package in ansi C for websocket

if PKG_USING_NOPOLL

    config PKG_USING_NOPOLL_EXAMPLE
    bool "Enable nopoll example"
    default y

    config PKG_NOPOLL_PATH
        string
        default "/packages/iot/nopoll"

    choice
        prompt "version"
        help
            Select the nopoll version

        config PKG_USING_NOPOLL_LATEST_VERSION
            bool "latest"

        config PKG_USING_NOPOLL_V100
            bool "v1.0.0"
    endchoice

    if PKG_USING_NOPOLL_V100
       config PKG_NOPOLL_VER
       string
       default "v1.0.0"
    endif

    if PKG_USING_NOPOLL_LATEST_VERSION
       config PKG_NOPOLL_VER
       string
       default "latest"
    endif

endif
```

## iot/onenet/Kconfig
```kconfig
# Kconfig file for package onenet
config PKG_USING_ONENET
    bool "OneNET : China Mobile OneNet cloud SDK for RT-Thread"
    default n
    select PKG_USING_CJSON
    select PKG_USING_WEBCLIENT

if PKG_USING_ONENET

    config PKG_ONENET_PATH
        string
        default "/packages/iot/onenet"
        
    config PKG_USING_ONENET_SAMPLE
        bool "Enable OneNET sample"
        default n
    
    config ONENET_USING_MQTT
        bool "Enable support MQTT protocol"
        default y
        select PKG_USING_PAHOMQTT
        
    if ONENET_USING_MQTT
        config ONENET_MQTT_SUBTOPIC
            string "mqtt subtopic"
            default "/test_topic"
    endif

    config ONENET_INFO_DEVID
        string "device id"
        default "29573339"
        
    config ONENET_INFO_APIKEY
        string "api key"
        default "a2gVVf1hggZfuATkNogulHK1V=s="
        
    config ONENET_INFO_PROID
        string "product id"
        default "131494"
        
    config ONENET_INFO_AUTH
        string "auth info"
        default "EF4016D6658466CA3E3606"
    
    choice
        prompt "onenet version"
        help
            Select the onenet version
            
        config PKG_USING_ONENET_V010
            bool "v0.1.0"
            
        config PKG_USING_ONENET_LATEST_VERSION
            bool "latest_version"
            
    endchoice
    
    if PKG_USING_ONENET_V010
        config PKG_ONENET_VER
        string
        default "v0.1.0"
    endif
   
    if PKG_USING_ONENET_LATEST_VERSION
       config PKG_ONENET_VER
       string
       default "latest_version"    
    endif

endif
```

## iot/onnx-backend/Kconfig
```kconfig
# Kconfig file for package onnx-backend
menuconfig PKG_USING_ONNX_BACKEND
    select RT_USING_LIBC
    select PKG_USING_ONNX_PARSER
    bool "onnx-backend: Open Neural Network Exchange backend on RT-Thread"
    default n

if PKG_USING_ONNX_BACKEND
    config PKG_ONNX_BACKEND_PATH
        string
        default "/packages/iot/onnx-backend"

    config ONNX_BACKEND_USING_MNIST_EXAMPLE
        bool "onnx-backend example: build mnist model and set weights mannually"
        help
            onnx-backend example: build model and set weights mannually
        default n

    config ONNX_BACKEND_USING_MNIST_SMALL_EXAMPLE
        bool "onnx-backend example: build model and load weights from file"
        help
            onnx-backend example: build model and load weights from file
        default n

    config ONNX_BACKEND_USING_MNIST_MODEL_EXAMPLE
        bool "onnx-backend example: load model and weights from file"
        help
            onnx-backend example: load model and weights from file
        default n

    choice
        prompt "Version"
        default PKG_USING_ONNX_BACKEND_LATEST_VERSION
        help
            Select the package version
        config PKG_USING_ONNX_BACKEND_V100
            bool "v1.0.0"
        config PKG_USING_ONNX_BACKEND_LATEST_VERSION
            bool "latest"
    endchoice

    config PKG_ONNX_BACKEND_VER
       string
       default "v1.0.0"    if PKG_USING_ONNX_BACKEND_V100
       default "latest"    if PKG_USING_ONNX_BACKEND_LATEST_VERSION

    config PKG_ONNX_BACKEND_VER_NUM
        hex
        default 0x10000 if PKG_USING_ONNX_BACKEND_V100
        default 0x99999 if PKG_USING_ONNX_BACKEND_LATEST_VERSION

endif
```

## iot/onnx-parser/Kconfig
```kconfig
# Kconfig file for package onnx-parser
menuconfig PKG_USING_ONNX_PARSER
    select PKG_USING_PROTOBUF_C
    select RT_USING_LIBC
    bool "onnx-parser: Open Neural Network Exchange model parser on RT-Thread"
    default n

if PKG_USING_ONNX_PARSER
    config PKG_ONNX_PARSER_PATH
        string
        default "/packages/iot/onnx-parser"

    config ONNX_PARSER_USING_RAM_EXAMPLE
        bool "onnx-parser example: decode onnx model in RAM"
        help
            onnx-parser example: decode in RAM
        default n

    config ONNX_PARSER_USING_EXAMPLE
        bool "onnx-parser example: decode onnx model from file"
        help
            onnx-parser example: decode from file
        default n

    choice
        prompt "Version"
        default PKG_USING_ONNX_PARSER_LATEST_VERSION
        help
            Select the package version

        config PKG_USING_ONNX_PARSER_LATEST_VERSION
            bool "latest"
    endchoice

    config PKG_ONNX_PARSER_VER
       string
       default "latest"    if PKG_USING_ONNX_PARSER_LATEST_VERSION

    config PKG_ONNX_PARSER_VER_NUM
        hex
        default 0x99999 if PKG_USING_ONNX_PARSER_LATEST_VERSION

endif
```
