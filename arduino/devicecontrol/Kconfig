## arduino/projects/RTduino-SensorFusion-Shield/Kconfig
```kconfig
# Kconfig file for package RTduino-SensorFusion-Shield
menuconfig PKG_USING_ARDUINO_RTDUINO_SENSORFUSION_SHIELD
    bool "RTduino SensorFusion Shield Driver Library"
    select PKG_USING_RTDUINO
    default n

if PKG_USING_ARDUINO_RTDUINO_SENSORFUSION_SHIELD

    config PKG_ARDUINO_RTDUINO_SENSORFUSION_SHIELD_DEMO
        bool "Enable RTduino SensorFusion Shield Demos"
        default n

        if PKG_ARDUINO_RTDUINO_SENSORFUSION_SHIELD_DEMO
            config PKG_RTDUINO_SENSORFUSION_SHIELD_BMP280_DEMO
                bool "Enable RTduino SensorFusion Shield Demos With BMP280"
                select PKG_USING_ARDUINO_ADAFRUIT_BMP280
                default n

            config PKG_RTDUINO_SENSORFUSION_SHIELD_SHT31_DEMO
                bool "Enable RTduino SensorFusion Shield Demos With SHT31"
                select PKG_USING_ARDUINO_ADAFRUIT_SHT31
                default n

            config PKG_RTDUINO_SENSORFUSION_SHIELD_AHT20_DEMO
                bool "Enable RTduino SensorFusion Shield Demos With AHT20"
                select PKG_USING_ARDUINO_ADAFRUIT_AHTX0
                default n

            config PKG_RTDUINO_SENSORFUSION_SHIELD_SSD1306_DEMO
                bool "Enable RTduino SensorFusion Shield Demos With SSD1306"
                select PKG_USING_ARDUINO_ADAFRUIT_SSD1306
                default n

            config PKG_RTDUINO_SENSORFUSION_SHIELD_ADXL345_DEMO
                bool "Enable RTduino SensorFusion Shield Demos With ADXL345"
                default n

            config PKG_RTDUINO_SENSORFUSION_SHIELD_QMC5883L_DEMO
                bool "Enable RTduino SensorFusion Shield Demos With QMC5883L"
                default n

            config PKG_RTDUINO_SENSORFUSION_SHIELD_SC7A20_DEMO
                bool "Enable RTduino SensorFusion Shield Demos With SC7A20"
                default n
        endif

    config PKG_ARDUINO_RTDUINO_SENSORFUSION_SHIELD_PATH
        string
        default "/packages/arduino/projects/RTduino-SensorFusion-Shield"

    choice
        prompt "Version"
        help
            Select the package version

        config PKG_USING_ARDUINO_RTDUINO_SENSORFUSION_SHIELD_LATEST_VERSION
            bool "latest"
    endchoice

    config PKG_ARDUINO_RTDUINO_SENSORFUSION_SHIELD_VER
       string
       default "latest"    if PKG_USING_ARDUINO_RTDUINO_SENSORFUSION_SHIELD_LATEST_VERSION

endif
```

## arduino/projects/UltrasoundRadar/Kconfig
```kconfig
# Kconfig file for package UltrasoundRadar
menuconfig PKG_USING_ARDUINO_ULTRASOUND_RADAR
    bool "UltrasoundRadar: Arduino ultrasound radar project"
    select PKG_USING_RTDUINO
    default n

if PKG_USING_ARDUINO_ULTRASOUND_RADAR

    config PKG_ARDUINO_ULTRASOUND_RADAR_PATH
        string
        default "/packages/arduino/projects/UltrasoundRadar"

    choice
        prompt "Version"
        default PKG_USING_ARDUINO_ULTRASOUND_RADAR_LATEST_VERSION
        help
            Select the package version

        config PKG_USING_ARDUINO_ULTRASOUND_RADAR_LATEST_VERSION
            bool "latest"
    endchoice

    config PKG_ARDUINO_ULTRASOUND_RADAR_VER
       string
       default "latest"    if PKG_USING_ARDUINO_ULTRASOUND_RADAR_LATEST_VERSION

endif
```

## arduino/projects/matlab-support-package/Kconfig
```kconfig
# Kconfig file for package matlab-support-package
menuconfig PKG_USING_ARDUINO_MATLAB_SUPPORT
    bool "MATLAB/Simulink Support Package for RTduino Hardware"
    select PKG_USING_RTDUINO
    select RTDUINO_NO_SETUP_LOOP
    default n

if PKG_USING_ARDUINO_MATLAB_SUPPORT

    config PKG_ARDUINO_MATLAB_SUPPORT_PATH
        string
        default "/packages/arduino/projects/matlab-support-package"

        choice MATLAB_SUPPORT_USING_SERIAL
            prompt "Select serial to connect to MATLAB"
            default MATLAB_SUPPORT_USING_CONSOLE_SERIAL

            config MATLAB_SUPPORT_USING_CONSOLE_SERIAL
                bool "Serial (Console Serial)"
                select RTDUINO_USING_SHELL_CMD
                select RTDUINO_CMD_USING_SERIAL
                select RTDUINO_CMD_SERIAL_USING_FOCUSON

            config MATLAB_SUPPORT_USING_SERIAL2
                bool "Serial2"

            config MATLAB_SUPPORT_USING_SERIAL3
                bool "Serial3"

            config MATLAB_SUPPORT_USING_SERIALUSB
                bool "SerialUSB"
                select RTDUINO_USING_USBSERIAL
        endchoice

    choice
        prompt "Version"
        default PKG_USING_ARDUINO_MATLAB_SUPPORT_LATEST_VERSION
        help
            Select the package version

        config PKG_USING_ARDUINO_MATLAB_SUPPORT_LATEST_VERSION
            bool "latest"
    endchoice

    config PKG_ARDUINO_MATLAB_SUPPORT_VER
       string
       default "latest"    if PKG_USING_ARDUINO_MATLAB_SUPPORT_LATEST_VERSION

endif
```

## arduino/projects/sketch-loader-demo/Kconfig
```kconfig
# Kconfig file for package sketch-loader-demo
menuconfig PKG_USING_ARDUINO_SKETCH_LOADER_DEMO
    bool "RTduino sketch loader demo"
    default n

if PKG_USING_ARDUINO_SKETCH_LOADER_DEMO

    config PKG_ARDUINO_SKETCH_LOADER_DEMO_PATH
        string
        default "/packages/arduino/projects/sketch-loader-demo"

    choice
        prompt "Version"
        help
            Select the package version

        config PKG_USING_ARDUINO_SKETCH_LOADER_DEMO_LATEST_VERSION
            bool "latest"
    endchoice

    config PKG_ARDUINO_SKETCH_LOADER_DEMO_VER
       string
       default "latest"    if PKG_USING_ARDUINO_SKETCH_LOADER_DEMO_LATEST_VERSION

endif
```

## arduino/sensors/AT24C256/Kconfig
```kconfig
# Kconfig file for package AT24C256
menuconfig PKG_USING_ARDUINO_AT24C256
    bool "AT24C256: EEPROM chip, for non-volatile storage data"
    select PKG_USING_RTDUINO
    default n

if PKG_USING_ARDUINO_AT24C256

    config PKG_USING_ARDUINO_AT24C256_PATH
        string
        default "/packages/arduino/sensors/AT24C256"

    choice
        prompt "Version"
        default PKG_USING_ARDUINO_AT24C256_LATEST_VERSION
        help
            Select the package version

        config PKG_USING_ARDUINO_AT24C256_LATEST_VERSION
            bool "latest"
    endchoice

    config PKG_USING_ARDUINO_AT24C256_VER
       string
       default "latest"    if PKG_USING_ARDUINO_AT24C256_LATEST_VERSION

endif
```

## arduino/sensors/Adafruit-ADT7410/Kconfig
```kconfig
# Kconfig file for package Adafruit-ADT7410
menuconfig PKG_USING_ARDUINO_ADAFRUIT_ADT7410
    bool "Adafruit ADT7410: Precision I2C Temperature sensor library"
    select PKG_USING_RTDUINO
    select RTDUINO_USING_WIRE
    select PKG_USING_ARDUINO_ADAFRUIT_SENSOR
    select PKG_USING_ARDUINO_ADAFRUIT_BUSIO
    default n

if PKG_USING_ARDUINO_ADAFRUIT_ADT7410

    config PKG_ARDUINO_ADAFRUIT_ADT7410_PATH
        string
        default "/packages/arduino/sensors/Adafruit-ADT7410"

    choice
        prompt "Version"
        default PKG_USING_ARDUINO_ADAFRUIT_ADT7410_LATEST_VERSION
        help
            Select the package version

        config PKG_USING_ARDUINO_ADAFRUIT_ADT7410_LATEST_VERSION
            bool "latest"
    endchoice

    config PKG_ARDUINO_ADAFRUIT_ADT7410_VER
       string
       default "latest"    if PKG_USING_ARDUINO_ADAFRUIT_ADT7410_LATEST_VERSION

endif
```

## arduino/sensors/Adafruit-ADXL343/Kconfig
```kconfig
# Kconfig file for package Adafruit-ADXL343
menuconfig PKG_USING_ARDUINO_ADAFRUIT_ADXL343
    bool "Adafruit ADXL343: digital accelerometer (+/-2/4/8/16g) that supports both SPI and I2C mode"
    select PKG_USING_RTDUINO
    select RTDUINO_USING_WIRE
    select RTDUINO_USING_SPI
    select PKG_USING_ARDUINO_ADAFRUIT_SENSOR
    select PKG_USING_ARDUINO_ADAFRUIT_BUSIO
    default n

if PKG_USING_ARDUINO_ADAFRUIT_ADXL343

    config PKG_ARDUINO_ADAFRUIT_ADXL343_PATH
        string
        default "/packages/arduino/sensors/Adafruit-ADXL343"

    choice
        prompt "Version"
        default PKG_USING_ARDUINO_ADAFRUIT_ADXL343_LATEST_VERSION
        help
            Select the package version

        config PKG_USING_ARDUINO_ADAFRUIT_ADXL343_LATEST_VERSION
            bool "latest"
    endchoice

    config PKG_ARDUINO_ADAFRUIT_ADXL343_VER
       string
       default "latest"    if PKG_USING_ARDUINO_ADAFRUIT_ADXL343_LATEST_VERSION

endif
```
