## peripherals/sensors/bmi160_bmx160/Kconfig
```kconfig
# Kconfig file for package bmi160/bmx160
menuconfig PKG_USING_BMI160_BMX160
    bool "BMI160/BMX160: Digital 6-axis and Digital 9-axis sensor"
    default n

if PKG_USING_BMI160_BMX160
    config PKG_BMI160_BMX160_PATH
        string
        default "/packages/peripherals/sensors/bmi160_bmx160"

    config BMI160_USING_ACCE
        bool "Enable BMI160 / BMX160 accelerometer"
        default n

    config BMI160_USING_GYRO
        bool "Enable BMI160 / BMX160 gyroscope"
        default n

    config BMX160_USING_MAG
        bool "Enable BMX160 magnetometer"
        default n
        
    config PKG_BMI160_BMX160_USING_SENSOR_V1
        bool "Enable sensor_v1 divce framework"
        select RT_USING_SENSOR
        default n

    choice
        prompt "Version"
        default PKG_USING_BMI160_BMX160_LATEST_VERSION
        help
            Select the package version

        config PKG_USING_BMI160_BMX160_V001
            bool "v0.0.1"

        config PKG_USING_BMI160_BMX160_LATEST_VERSION
            bool "latest"
    endchoice

    config PKG_BMI160_BMX160_VER
        string
        default "latest"    if PKG_USING_BMI160_BMX160_LATEST_VERSION
endif
```

## peripherals/sensors/bmp180/Kconfig
```kconfig
# Kconfig file for package bmp180
menuconfig PKG_USING_BMP180
    bool "BMP180 sensor driver package, support: barometric, temperature."
    default n

if PKG_USING_BMP180

    config PKG_BMP180_PATH
        string
        default "/packages/peripherals/sensors/bmp180"
        
	 config PKG_USING_BMP180_SAMPLE
        bool "Enable bmp180 sample"
        default n
        
    choice
        prompt "Version"
        default PKG_USING_BMP180_LATEST_VERSION
        help
            Select the package version

        config PKG_USING_BMP180_V100
            bool "v1.0.0"

        config PKG_USING_BMP180_LATEST_VERSION
            bool "latest"
    endchoice
          
    config PKG_BMP180_VER
       string
       default "v1.0.0"    if PKG_USING_BMP180_V100
       default "latest"    if PKG_USING_BMP180_LATEST_VERSION

endif
```

## peripherals/sensors/bmp280/Kconfig
```kconfig
# Kconfig file for package bmp280
menuconfig PKG_USING_BMP280
    bool "bmp280:bmp280 iic sensor driver package,support:pressure,temperature"
    default n

if PKG_USING_BMP280

    config PKG_BMP280_PATH
        string
        default "/packages/peripherals/sensors/bmp280"

    choice
        prompt "Version"
        default PKG_USING_BMP280_LATEST_VERSION
        help
            Select the package version

        config PKG_USING_BMP280_V100
            bool "v1.0.0"

        config PKG_USING_BMP280_LATEST_VERSION
            bool "latest"
    endchoice
          
    config PKG_BMP280_VER
       string
       default "v1.0.0"    if PKG_USING_BMP280_V100
       default "latest"    if PKG_USING_BMP280_LATEST_VERSION

endif
```

## peripherals/sensors/ccs811/Kconfig
```kconfig
# Kconfig file for package ccs811
menuconfig PKG_USING_CCS811
    bool "CCS811: Digital Gas Sensor for Monitoring Indoor Air Quality."
    default n

if PKG_USING_CCS811

    config PKG_CCS811_PATH
        string
        default "/packages/peripherals/sensors/ccs811"

    choice
        prompt "Select I2C address"
        default PKG_USING_CCS811_I2C_ADDR_LOW

        config PKG_USING_CCS811_I2C_ADDR_LOW
            bool "0x5A"

        config PKG_USING_CCS811_I2C_ADDR_HIGH
            bool "0X5B"
    endchoice

    config PKG_USING_CCS811_I2C_ADDRESS
       hex
       default 0x5A      if PKG_USING_CCS811_I2C_ADDR_LOW
       default 0x5B      if PKG_USING_CCS811_I2C_ADDR_HIGH

    config PKG_USING_CCS811_SAMPLE
        bool "Enable ccs811 sample"
        default n

    choice
        prompt "Version"
        default PKG_USING_CCS811_LATEST_VERSION
        help
            Select the package version

        config PKG_USING_CCS811_V100
            bool "v1.0.0"

        config PKG_USING_CCS811_LATEST_VERSION
            bool "latest"
    endchoice

    config PKG_CCS811_VER
       string
       default "v1.0.0"    if PKG_USING_CCS811_V100
       default "latest"    if PKG_USING_CCS811_LATEST_VERSION

endif
```

## peripherals/sensors/cw2015/Kconfig
```kconfig
# Kconfig file for package cw2015
menuconfig PKG_USING_CW2015
    bool "cw2015:fuel gauging system IC for Lithium-ion(Li+) Battery."
    default n

if PKG_USING_CW2015

    config PKG_CW2015_PATH
        string
        default "/packages/peripherals/sensors/cw2015"

   config CW2015_DEVICE_NAME
        string "the device name for cw2015"
        default "i2c1"

    config CW2015_USE_AUTO_UPDATE
        bool "Enable CW2015 AUTO UPDATE BAT INFO"
        default n
        help
            "It will create a thread to update the battery info."

    choice
        prompt "Version"
        default PKG_USING_CW2015_LATEST_VERSION
        help
            Select the package version

        config PKG_USING_CW2015_V100
            bool "v1.0.0"

        config PKG_USING_CW2015_LATEST_VERSION
            bool "latest"
    endchoice

    config PKG_CW2015_VER
       string
       default "v1.0.0"    if PKG_USING_CW2015_V100
       default "latest"    if PKG_USING_CW2015_LATEST_VERSION

endif
```

## peripherals/sensors/da270/Kconfig
```kconfig
# Kconfig file for package da270
menuconfig PKG_USING_DA270
    bool "DA270 sensor driver package, support: accelerometer."
    default n

if PKG_USING_DA270

    config PKG_DA270_PATH
        string
        default "/packages/peripherals/sensors/da270"

    config PKG_USING_DA270_ACCE
        bool "Enable da270 acce"
        default y

    config PKG_DA270_USING_SENSOR_V1
        bool "Enable sensor_v1 divce framework"
        select RT_USING_SENSOR
        default n

    choice
        prompt "Version"
        default PKG_USING_DA270_LATEST_VERSION
        help
            Select the package version

        config PKG_USING_DA270_V100
            bool "v1.0.0"

        config PKG_USING_DA270_LATEST_VERSION
            bool "latest"
    endchoice

    config PKG_DA270_VER
       string
       default "v1.0.0"    if PKG_USING_DA270_V100
       default "latest"    if PKG_USING_DA270_LATEST_VERSION

endif
```

## peripherals/sensors/df220/Kconfig
```kconfig
# Kconfig file for package df220
menuconfig PKG_USING_DF220
    bool "df220 sensor driver package, support: force sensor."
    default n

if PKG_USING_DF220

    config PKG_DF220_PATH
        string
        default "/packages/peripherals/sensors/df220"

    choice
        prompt "Version"
        default PKG_USING_DF220_LATEST_VERSION
        help
            Select the package version

        config PKG_USING_DF220_V100
            bool "v1.0.0"

        config PKG_USING_DF220_LATEST_VERSION
            bool "latest"
    endchoice

    config PKG_DF220_VER
       string
       default "v1.0.0"    if PKG_USING_DF220_V100
       default "latest"    if PKG_USING_DF220_LATEST_VERSION

endif
```

## peripherals/sensors/dht11/Kconfig
```kconfig
# Kconfig file for package dht11
menuconfig PKG_USING_DHT11
    bool "dht11: Digital temperature and humidity sensor(Single bus)"
    default n

if PKG_USING_DHT11

    config PKG_USING_DHT11_SAMPLE
        bool "Enable dth11 sample"
        default y

    config PKG_DHT11_PATH
        string
        default "/packages/peripherals/sensors/dht11"

    config PKG_DHT11_USING_SENSOR_V1
        bool "Enable sensor divce framework"
        select RT_USING_SENSOR
        default n

    choice
        prompt "Version"
        default PKG_USING_DHT11_LATEST_VERSION
        help
            Select the package version

        config PKG_USING_DHT11_LATEST_VERSION
            bool "latest"
    endchoice

    config PKG_DHT11_VER
       string
       default "v1.0.0"    if PKG_USING_DHT11_V100
       default "latest"    if PKG_USING_DHT11_LATEST_VERSION

endif
```

## peripherals/sensors/dhtxx/Kconfig
```kconfig
# Kconfig file for package dhtxx
menuconfig PKG_USING_DHTXX
    bool "DHTxx one-wire digital temperature and humidity sensor."
    default n

if PKG_USING_DHTXX

    config PKG_DHTXX_PATH
        string
        default "/packages/peripherals/sensors/dhtxx"

    if (PKG_DHTXX_VER_NUM >= 0x00900)

    choice
        prompt "Select dhtxx sensor type"
        default PKG_USING_DHTXX_TYPE_DHT11

        config PKG_USING_DHTXX_TYPE_DHT11
            bool "DHT11"

        config PKG_USING_DHTXX_TYPE_DHT12
            bool "DHT12"

        config PKG_USING_DHTXX_TYPE_DHT21
            bool "DHT21/AM2301"

        config PKG_USING_DHTXX_TYPE_DHT22
            bool "DHT22/AM2302"
    endchoice

    endif

    config PKG_DHTXX_USING_SENSOR_V1
        bool "Enable sensor_v1 device framework"
        select RT_USING_SENSOR
        default n
        if PKG_DHTXX_USING_SENSOR_V1
            config PKG_USING_DHTXX_SAMPLE_SENSOR_V1
                bool "Enable dhtxx sample for sensor_v1 frame"
                default n
        endif

    config PKG_USING_DHTXX_DEBUG
        bool "Enable debug log output"
        default n

    config PKG_USING_DHTXX_SAMPLE
        bool "Enable dthxx sample"
        default n

    if (PKG_DHTXX_VER_NUM >= 0x00900)

    config PKG_USING_DHTXX_SAMPLE_PIN
        int "data pin number"
        depends on PKG_USING_DHTXX_SAMPLE
        default 0

    endif

    choice
        prompt "Version"
        default PKG_USING_DHTXX_LATEST_VERSION
        help
            Select the package version

        config PKG_USING_DHTXX_V090
            bool "v0.9.0"

        config PKG_USING_DHTXX_V08X
            bool "v0.8.1"

        config PKG_USING_DHTXX_LATEST_VERSION
            bool "latest"
    endchoice

    config PKG_DHTXX_VER
       string
       default "v0.9.0"    if PKG_USING_DHTXX_V090
       default "v0.8.1"    if PKG_USING_DHTXX_V08X
       default "latest"    if PKG_USING_DHTXX_LATEST_VERSION

    config PKG_DHTXX_VER_NUM
        hex
        default 0x00900    if PKG_USING_DHTXX_V090
        default 0x00801    if PKG_USING_DHTXX_V08X
        default 0x99999    if PKG_USING_DHTXX_LATEST_VERSION

endif
```

## peripherals/sensors/ds18b20/Kconfig
```kconfig
# Kconfig file for package ds18b20
menuconfig PKG_USING_DS18B20
    bool "DS18B20 sensor driver package,support: temperature."
    default n
    select RT_USING_SENSOR

if PKG_USING_DS18B20

    config PKG_DS18B20_PATH
        string
        default "/packages/peripherals/sensors/ds18b20"

    config PKG_DS18B20_USING_SENSOR_V1
        bool "Enable sensor_v1 divce framework"
        select RT_USING_SENSOR
        default n
    
    config PKG_DS18B20_USING_SAMPLE_SENSOR_V1
        bool "Enable ds18b20 sample"
        default n
    
    choice
        prompt "Version"
        default PKG_USING_DS18B20_LATEST_VERSION
        help
            Select the package version

        config PKG_USING_DS18B20_LATEST_VERSION
            bool "latest"
    endchoice

    config PKG_DS18B20_VER
       string
       default "latest"    if PKG_USING_DS18B20_LATEST_VERSION

endif
```

## peripherals/sensors/gp2y10/Kconfig
```kconfig
# Kconfig file for package gp2y10
menuconfig PKG_USING_GP2Y10
    bool "GP2Y10: dust sensor by Sharp for detect air quality."
    default n

if PKG_USING_GP2Y10

    config PKG_GP2Y10_PATH
        string
        default "/packages/peripherals/sensors/gp2y10"

    config PKG_USING_GP2Y10_ADC_DEV_NAME
        string "ADC device name"
        default "adc1"

    config PKG_USING_GP2Y10_ADC_DEV_CHANNEL
        int "ADC device channel"
        default 0

    config PKG_USING_GP2Y10_CONVERT_BITS
        int "ADC device convert bit"
        range 1 16
        default 12

    config PKG_USING_GP2Y10_VOLTAGE_RATIO
        int "Set voltage divider ratio of Aout"
        range 1 100
        default 1

    config PKG_USING_GP2Y10_SOFT_FILTER
        bool "Enable soft filter"
        default n

    config PKG_USING_GP2Y10_DEBUG
        bool "Enable debug log output"
        default n

    config PKG_USING_GP2Y10_SAMPLE
        bool "Enable gp2y10 sample"
        default n

    if PKG_USING_GP2Y10_SAMPLE

        config PKG_USING_GP2Y10_SAMPLE_ILED_PIN
            int "iled pin number"
            default 95

        config PKG_USING_GP2Y10_SAMPLE_AOUT_PIN
            int "aout pin number"
            default 35
    endif

    choice
        prompt "Version"
        default PKG_USING_GP2Y10_LATEST_VERSION
        help
            Select the package version

        config PKG_USING_GP2Y10_V100
            bool "v1.0.0"

        config PKG_USING_GP2Y10_LATEST_VERSION
            bool "latest"
    endchoice

    config PKG_GP2Y10_VER
       string
       default "v1.0.0"    if PKG_USING_GP2Y10_V100
       default "latest"    if PKG_USING_GP2Y10_LATEST_VERSION

endif
```

## peripherals/sensors/gy271/Kconfig
```kconfig
# Kconfig file for package gy271
menuconfig PKG_USING_GY271
    bool "gy271: Universal 3-axis sensor driver packages,support: magnetism."
    default n

if PKG_USING_GY271

    config PKG_GY271_PATH
        string
        default "/packages/peripherals/sensors/gy271"

    choice
        prompt "Version"
        default PKG_USING_GY271_LATEST_VERSION
        help
            Select the package version

        config PKG_USING_GY271_V100
            bool "v1.0.0"

        config PKG_USING_GY271_LATEST_VERSION
            bool "latest"
    endchoice
          
    config PKG_GY271_VER
       string
       default "v1.0.0"    if PKG_USING_GY271_V100
       default "latest"    if PKG_USING_GY271_LATEST_VERSION

    config PKG_USING_GY271_SAMPLE
       bool "Enable gy271 sample"
       default n


endif
```
