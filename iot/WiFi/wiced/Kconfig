## iot/WiFi/wiced/Kconfig
```kconfig
menu "Wiced WiFi"

config PKG_USING_WLAN_WICED
    bool "Wiced WiFi driver for rt-thread"
    default n

if PKG_USING_WLAN_WICED

    config PKG_WICEDWIFI_PATH
        string
        default "/packages/iot/WiFi/wiced"

    config PKG_WICEDWIFI_VER
        string
        default "v1.0.0"
endif

endmenu
```

## iot/WiFi/wlan_bl808/Kconfig
```kconfig
menu "BL808 WiFi"

menuconfig PKG_USING_WLAN_BL808
    bool "BL808 WiFi driver for rt-thread"
    select RT_USING_LWIP
    select RT_USING_WIFI
    select RT_USING_SYSTEM_WORKQUEUE
    select PKG_USING_MBEDTLS
    default n
    help
        if "PKG_USING_WLAN_BL808" is opened, "RT_USING_LWIP" will be default selected.

if PKG_USING_WLAN_BL808

    config PKG_WLAN_BL808_PATH
        string
        default "/packages/iot/WiFi/wlan_bl808"

    choice
        prompt "version"
        default PKG_USING_WLAN_BL808_LATEST_VERSION
        help
            Select the BL808 wifi version

        config PKG_USING_WLAN_BL808_LATEST_VERSION
            bool "latest"

        config PKG_USING_WLAN_BL808_V001
            bool "v0.0.1"
    endchoice

    if PKG_USING_WLAN_BL808_V001
        config PKG_WLAN_BL808_VER
        string
        default "v0.0.1"
    endif

    if PKG_USING_WLAN_BL808_LATEST_VERSION
        config PKG_WLAN_BL808_VER
        string
        default "latest"
    endif

endif

endmenu
```

## iot/WiFi/wlan_cyw43012/Kconfig
```kconfig
menu "CYW43012 WiFi"

menuconfig PKG_USING_WLAN_CYW43012
    bool "CYW43012 WiFi driver for rt-thread"
    select RT_USING_LWIP
    select RT_USING_WIFI
    select RT_USING_SYSTEM_WORKQUEUE
    select PKG_USING_FREERTOS_WRAPPER
    default n
    help
        if "PKG_USING_WLAN_CYW43012" is opened, "RT_USING_LWIP" will be default selected.

if PKG_USING_WLAN_CYW43012

    config PKG_WLAN_CYW43012_PATH
        string
        default "/packages/iot/WiFi/wlan_cyw43012"

    choice
        prompt "version"
        default PKG_USING_WLAN_CYW43012_V001
        help
            Select the CYW43012 wifi version

        config PKG_USING_WLAN_CYW43012_LATEST_VERSION
            bool "latest"

        config PKG_USING_WLAN_CYW43012_V001
            bool "v0.0.1"
    endchoice

    if PKG_USING_WLAN_CYW43012_V001
        config PKG_WLAN_CYW43012_VER
        string
        default "v0.0.1"
    endif

    if PKG_USING_WLAN_CYW43012_LATEST_VERSION
        config PKG_WLAN_CYW43012_VER
        string
        default "latest"
    endif

endif

endmenu
```

## iot/WiFi/wlan_cyw43439/Kconfig
```kconfig
menu "CYW43439 WiFi"

menuconfig PKG_USING_WLAN_CYW43439
    bool "CYW43439 WiFi driver for rt-thread"
    select RT_USING_LWIP
    select RT_USING_WIFI
    select RT_USING_SAL
    select PKG_USING_CYW43XX
    default n
    help
        if "PKG_USING_WLAN_CYW43439" is opened, "RT_USING_LWIP" will be default selected.

if PKG_USING_WLAN_CYW43439

    config PKG_WLAN_CYW43439_PATH
        string
        default "/packages/iot/WiFi/wlan_cyw43439"

    choice
        prompt "version"
        default PKG_USING_WLAN_CYW43439_LATEST_VERSION
        help
            Select the CYW43439 wifi version

        config PKG_USING_WLAN_CYW43439_LATEST_VERSION
            bool "latest"
    endchoice

    if PKG_USING_WLAN_CYW43439_LATEST_VERSION
        config PKG_WLAN_CYW43439_VER
        string
        default "latest"
    endif

endif

endmenu
```

## iot/WiFi/wlan_wiced/Kconfig
```kconfig
menu "Wiced WiFi"

menuconfig PKG_USING_WLAN_WICED
    bool "Wiced WiFi driver for rt-thread"
    select RT_USING_LWIP
    select RT_USING_WIFI
    default n
    help
        if "PKG_USING_WLAN_WICED" is opened, "RT_USING_LWIP" will be default selected.

if PKG_USING_WLAN_WICED

    config PKG_WLAN_WICED_PATH
        string
        default "/packages/iot/WiFi/wlan_wiced"

    choice
        prompt "version"
        default PKG_USING_WLAN_WICED_V101
        help
            Select the wiced wifi version

        config PKG_USING_WLAN_WICED_LATEST_VERSION
            bool "latest"
            
        config PKG_USING_WLAN_WICED_V101
            bool "v1.0.1"

        config PKG_USING_WLAN_WICED_V100
            bool "v1.0.0"
    endchoice

    if PKG_USING_WLAN_WICED_V100
        config PKG_WLAN_WICED_VER
        string
        default "v1.0.0"
    endif
    
    if PKG_USING_WLAN_WICED_V101
        config PKG_WLAN_WICED_VER
        string
        default "v1.0.1"
    endif

    if PKG_USING_WLAN_WICED_LATEST_VERSION
        config PKG_WLAN_WICED_VER
        string
        default "latest"
    endif

endif

endmenu
```

## iot/WiFi/wlanmarvell/Kconfig
```kconfig
menu "Marvell WiFi"

menuconfig PKG_USING_WLANMARVELL
    bool "Marvell WiFi driver for rt-thread"
    select RT_USING_WIFI
    default n

if PKG_USING_WLANMARVELL

    config PKG_WLANMARVELL_PATH
        string
        default "/packages/iot/WiFi/wlanmarvell"

    choice
        prompt "marvell wifi version"
        help
            Select the marvell wifi version

        config PKG_USING_WLANMARVELL_LATEST_VERSION
            bool "latest"

        config PKG_USING_WLANMARVELL_V100
            bool "v1.0.0"
    endchoice

    config PKG_WLANMARVELL_VER
        string
        default "v1.0.0" if PKG_USING_WLANMARVELL_V100
        default "latest" if PKG_USING_WLANMARVELL_LATEST_VERSION

    config MARVELLWIFI_USING_STA
        bool "Using station mode"
        default y

    if MARVELLWIFI_USING_STA
        config MARVELLWIFI_STA_REASSOCIATION
        bool "station mode support reassociation"
        default y
    endif

    config MARVELLWIFI_USING_UAP
        bool "Using access point mode"
        default n
endif

endmenu
```

## iot/WiFi/wlanwiced/Kconfig
```kconfig
menu "Wiced WiFi"

config PKG_USING_WLANWICED
    bool "Wiced WiFi driver for rt-thread"
    default n

if PKG_USING_WLANWICED

    config PKG_WICEDWIFI_PATH
        string
        default "/packages/iot/WiFi/wlanwiced"

    config PKG_WICEDWIFI_VER
        string
        default "v1.0.0"
endif

endmenu
```

## iot/abup_fota/Kconfig
```kconfig
# Kconfig file for package abup_fota
menuconfig PKG_USING_ABUP_FOTA
    bool "abup_fota: The firmware downloader which using on Abup FOTA component"
    select PKG_USING_FAL
    default n

if PKG_USING_ABUP_FOTA

    config PKG_ABUP_FOTA_PATH
        string
        default "/packages/iot/abup_fota"

    choice
        prompt "Enable HTTP/CoAP FOTA"
        default ABUP_NETWORKING_MODE
        help
            Select the package Networking mode

        config ABUP_NETWORKING_MODE_COAP
            bool "CoAP"

        config ABUP_NETWORKING_MODE_HTTP
            bool "HTTP"
    endchoice
    
if ABUP_NETWORKING_MODE_COAP
    config ABUP_DEFAULT_NETWORK_PROTOCOL
        int
        default 1
endif

if ABUP_NETWORKING_MODE_HTTP
    config ABUP_DEFAULT_NETWORK_PROTOCOL
        int
        default 2
endif

    choice
        prompt "Recover algorithm"
        default ABUP_ALGORITHM
        help
            Select the package algorithm

        config ABUP_ALGORITHM_WOSUN
            bool "wosun"

        config ABUP_ALGORITHM_LUSUN
            bool "lusun"
    endchoice
        
if ABUP_ALGORITHM_WOSUN
    config ABUP_FOTA_ALGORITHM
        int
        default 1

    config ADUPS_FOTA_WOSUN_VERSION
        string
        default "IOT4.0_R42641"
endif

if ABUP_ALGORITHM_LUSUN
    config ABUP_FOTA_ALGORITHM
        int
        default 0

    config ADUPS_FOTA_LUSUN_VERSION
        string
        default "IOT5.0_LUSUN11_R50426"
endif

    config ABUP_DEBUG_MODE
        bool "Enable Abup FOTA Downloader debug"
        default n

    config ABUP_RTTHREAD_APP
        string "Application area name"
        default "App"

    config ABUP_RTTHREAD_FLASH
        string "Data area name"
        default "Abup"

    config ABUP_DEFAULT_SEGMENT_SIZE_INDEX
        hex
        default 3

    config ABUP_SECTOR_MAX_NUM
        hex "Flash minimum unit total"
        default 0x40

    config ABUP_DEFAULT_SECTOR_SIZE
        hex "Flash minimum unit size"
        default 0x00000800

    config ABUP_FLASH_BASE_ADDR
        hex "Flash start address"
        default 0x08000000

    config ABUP_BL_SIZE
        hex "Bootloader size"
        default 0x00004000

    config ABUP_APP_SIZE
        hex "Application size"
        default 0x10000

    config ABUP_UPDATE_ADDR
        hex "Abup partition address"
        default 0x08014000

    config ABUP_UPDATE_SIZE
        hex "Abup partition size"
        default 0xC000

    config ADUPS_FOTA_SERVICE_OEM
        string "OEM"
        default "G070RB"

    config ADUPS_FOTA_SERVICE_MODEL
        string "Device Name"
        default "G070RB"

    config ADUPS_FOTA_SERVICE_PRODUCT_ID
        string "Product ID"
        default "1562662709"

    config ADUPS_FOTA_SERVICE_PRODUCT_SEC
        string "Product Secret"
        default "d42a103a639f4b5d94d97c3bd7bc9ba5"

    config ADUPS_FOTA_SERVICE_DEVICE_TYPE
        string "Device Type"
        default "box"

    config ADUPS_FOTA_SERVICE_PLATFORM
        string "Platform"
        default "stm32l0"

    config ABUP_FIRMWARE_VERSION
        string "firmware version"
        default "1.0"

    config ADUPS_FOTA_APP_VERSION
        string
        default "ADUPS_V4.0"

    config ADUPS_FOTA_RTT_VERSION
        string
        default "RTT_V1.0"

    choice
        prompt "Version"
        default PKG_USING_ABUP_FOTA_LATEST_VERSION
        help
            Select the package version

        config PKG_USING_ABUP_FOTA_V100
            bool "v1.0.0"

        config PKG_USING_ABUP_FOTA_LATEST_VERSION
            bool "latest"
    endchoice
          
    config PKG_ABUP_FOTA_VER
       string
       default "v1.0.0"    if PKG_USING_ABUP_FOTA_V100
       default "latest"    if PKG_USING_ABUP_FOTA_LATEST_VERSION

endif
```

## iot/agile_ftp/Kconfig
```kconfig
# Kconfig file for package agile_ftp
menuconfig PKG_USING_AGILE_FTP
    bool "agile_ftp: Lightweight ftp server."
    default n
    select RT_USING_SAL             if RT_VER_NUM < 0x40100
    select SAL_USING_POSIX          if RT_VER_NUM < 0x40100
    select RT_USING_DFS             if RT_VER_NUM < 0x40100
    select RT_USING_POSIX_FS        if RT_VER_NUM >= 0x40100
    select RT_USING_POSIX_SOCKET    if RT_VER_NUM >= 0x40100

if PKG_USING_AGILE_FTP

    config PKG_AGILE_FTP_PATH
        string
        default "/packages/iot/agile_ftp"

    choice
        prompt "Version"
        default PKG_USING_AGILE_FTP_LATEST_VERSION
        help
            Select the package version

        config PKG_USING_AGILE_FTP_V100
            bool "v1.0.0"

        config PKG_USING_AGILE_FTP_LATEST_VERSION
            bool "latest"
    endchoice

    config PKG_AGILE_FTP_VER
       string
       default "v1.0.0"    if PKG_USING_AGILE_FTP_V100
       default "latest"    if PKG_USING_AGILE_FTP_LATEST_VERSION

    config PKG_AGILE_FTP_VER_NUM
        hex
        default 0x10000    if PKG_USING_AGILE_FTP_V100
        default 0x99999    if PKG_USING_AGILE_FTP_LATEST_VERSION

endif
```

## iot/agile_jsmn/Kconfig
```kconfig
# Kconfig file for package agile_jsmn
menuconfig PKG_USING_AGILE_JSMN
    bool "agile_jsmn: Lightweight JSON parser."
    default n

if PKG_USING_AGILE_JSMN

    config PKG_AGILE_JSMN_PATH
        string
        default "/packages/iot/agile_jsmn"

    choice
        prompt "Version"
        default PKG_USING_AGILE_JSMN_LATEST_VERSION
        help
            Select the package version

        config PKG_USING_AGILE_JSMN_LATEST_VERSION
            bool "latest"
    endchoice
          
    config PKG_AGILE_JSMN_VER
       string
       default "latest"    if PKG_USING_AGILE_JSMN_LATEST_VERSION

    config PKG_AGILE_JSMN_VER_NUM
        hex
        default 0x99999    if PKG_USING_AGILE_JSMN_LATEST_VERSION
endif
```

## iot/agile_modbus/Kconfig
```kconfig
# Kconfig file for package agile_modbus
menuconfig PKG_USING_AGILE_MODBUS
    bool "agile_modbus: Lightweight modbus protocol stack."
    default n

if PKG_USING_AGILE_MODBUS

    config PKG_AGILE_MODBUS_PATH
        string
        default "/packages/iot/agile_modbus"

    choice
        prompt "Version"
        default PKG_USING_AGILE_MODBUS_V112
        help
            Select the package version

        config PKG_USING_AGILE_MODBUS_V111
            bool "v1.1.1"

        config PKG_USING_AGILE_MODBUS_V112
            bool "v1.1.2"

        config PKG_USING_AGILE_MODBUS_LATEST_VERSION
            bool "latest"
    endchoice

    config PKG_AGILE_MODBUS_VER
       string
       default "v1.1.1"    if PKG_USING_AGILE_MODBUS_V111
       default "v1.1.2"    if PKG_USING_AGILE_MODBUS_V112
       default "latest"    if PKG_USING_AGILE_MODBUS_LATEST_VERSION

    config PKG_AGILE_MODBUS_VER_NUM
        hex
        default 0x10101    if PKG_USING_AGILE_MODBUS_V111
        default 0x10102    if PKG_USING_AGILE_MODBUS_V112
        default 0x99999    if PKG_USING_AGILE_MODBUS_LATEST_VERSION

endif
```

## iot/agile_telnet/Kconfig
```kconfig
# Kconfig file for package agile_telnet
menuconfig PKG_USING_AGILE_TELNET
    bool "agile_telnet: TCP debug for Ethernet"
    default n
    select RT_USING_SAL             if RT_VER_NUM < 0x40100
    select SAL_USING_POSIX          if RT_VER_NUM < 0x40100
    select RT_USING_DFS             if RT_VER_NUM < 0x40100
    select RT_USING_POSIX_FS        if RT_VER_NUM >= 0x40100
    select RT_USING_POSIX_STDIO     if RT_VER_NUM >= 0x40100
    select RT_USING_POSIX_SOCKET    if RT_VER_NUM >= 0x40100

if PKG_USING_AGILE_TELNET

    config PKG_AGILE_TELNET_PATH
        string
        default "/packages/iot/agile_telnet"

    config PKG_AGILE_TELNET_THREAD_STACK_SIZE
        int "Set agile_telnet thread stack size"
        default 2048

    config PKG_AGILE_TELNET_THREAD_PRIORITY
        int "Set agile_telnet thread priority"
        default 26

    config PKG_AGILE_TELNET_PORT
        int "Set agile_telnet listen port"
        default 23

    config PKG_AGILE_TELNET_RX_BUFFER_SIZE
        int "Set agile_telnet rx buffer size"
        default 256

    config PKG_AGILE_TELNET_TX_BUFFER_SIZE
        int "Set agile_telnet tx buffer size"
        default 2048

    config PKG_AGILE_TELNET_CLIENT_DEFAULT_TIMEOUT
        int "Set agile_telnet client timeout(min)"
        default 3

    if PKG_AGILE_TELNET_VER_NUM >= 0x20000

        config PKG_AGILE_TELNET_CONSOLE_PLUG
            bool
            default y

    endif

    if PKG_AGILE_TELNET_VER_NUM >= 0x20002

        config PKG_AGILE_TELNET_USING_AUTH
            bool "agile_telnet support authentication"
            default n

        if PKG_AGILE_TELNET_USING_AUTH

            config PKG_AGILE_TELNET_USERNAME
                string "agile_telnet username"
                default "loogg"

            config PKG_AGILE_TELNET_PASSWORD
                string "agile_telnet password"
                default "loogg"

        endif

    endif

    choice
        prompt "Version"
        default PKG_USING_AGILE_TELNET_V203
        help
            Select the package version

        config PKG_USING_AGILE_TELNET_V203
            bool "v2.0.3"

        config PKG_USING_AGILE_TELNET_LATEST_VERSION
            bool "latest"
    endchoice

    config PKG_AGILE_TELNET_VER
       string
       default "v2.0.3"    if PKG_USING_AGILE_TELNET_V203
       default "latest"    if PKG_USING_AGILE_TELNET_LATEST_VERSION

    config PKG_AGILE_TELNET_VER_NUM
        hex
        default 0x20003    if PKG_USING_AGILE_TELNET_V203
        default 0x99999    if PKG_USING_AGILE_TELNET_LATEST_VERSION
endif
```
