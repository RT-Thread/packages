## misc/CanopenNode/profile/cia401/device/Kconfig
```kconfig
# Kconfig for the Pure-C local CiA 401 Device core.

config PKG_CANOPENNODE_CIA401_DEVICE
    bool "Local CiA 401 Device core"
    default y
    depends on PKG_CANOPENNODE_CIA401
    help
        Build the Pure-C generic I/O Device core for Objects 0x6000, 0x6200,
        0x6401 and 0x6411. A device with analogue inputs also requires the
        conditional-mandatory 0x6423 global interrupt-enable object and the
        associated 0x0080 Operational-entry warning semantics. Generated OD
        objects are validated before process-image exchange is enabled.

if PKG_CANOPENNODE_CIA401_DEVICE

config PKG_CANOPENNODE_CIA401_DIGITAL_EVENTS
    bool "CiA 401 digital input events and filter bridge"
    default n
    depends on PKG_CANOPENNODE_TPDO
    depends on PKG_CANOPENNODE_PDO_OD_IO_ACCESS
    help
        Enable Objects 0x6002, 0x6003 and 0x6005..0x6008, logical edge
        detection, OD-based TPDO event requests and the product filter-enable
        bridge. OD_FLAGS_PDO_SIZE must cover every enabled 0x6000 sub-index.

config PKG_CANOPENNODE_CIA401_DIGITAL_OUTPUT_FAILSAFE
    bool "CiA 401 digital output profile semantics"
    default n
    depends on PKG_CANOPENNODE_RPDO
    depends on PKG_CANOPENNODE_PDO_OD_IO_ACCESS
    help
        Enable Objects 0x6202, 0x6206, 0x6207 and 0x6208, including output
        polarity, final physical-output filtering and fail-safe physical output
        selection. Product/internal failure and NMT Stopped are independent
        fault sources; either keeps fail-safe active until its own source clears.
        The product IOIF must provide masked physical writes so 0x6206 keep bits
        and 0x6208 blocked bits are never overwritten. The 0x6200 command image
        always retains the complete received value.

config PKG_CANOPENNODE_CIA401_ANALOG_EVENTS
    bool "CiA 401 analogue input events"
    default n
    depends on PKG_CANOPENNODE_TPDO
    depends on PKG_CANOPENNODE_PDO_OD_IO_ACCESS
    help
        Enable optional Objects 0x6421, 0x6422 and 0x6424..0x6428 for 16-bit
        analogue-input event selection. Object 0x6423 and its 0x0080 warning are
        part of the base analogue-input contract. SDO reads commit communication
        state at OD-read completion; TPDO state is committed only after successful
        transport submission.

config PKG_CANOPENNODE_CIA401_ANALOG_OUTPUT_FAILSAFE
    bool "CiA 401 analogue output fail-safe"
    default n
    help
        Enable Objects 0x6443/0x6444. Product/internal failure and NMT Stopped
        are independent fault sources; either keeps fail-safe active until its
        own source clears. Channels with error mode 1 use the 0x6444 value
        directly, bypassing normal command conditioning; mode 0 retains the
        current output.

config PKG_CANOPENNODE_CIA401_ANALOG_CONDITIONING
    bool "CiA 401 integer analogue conditioning"
    default n
    help
        Enable the integer conditioning views 0x6431/0x6432 and 0x6446/0x6447.
        The 16-bit process path applies scaling then offset using widened
        arithmetic and performs no undocumented clamp. Values outside INTEGER16
        are not committed to the process image/backend. Float aliases remain
        intentionally unopened until their cross-view conversion policy is frozen.

endif
```

## misc/CanopenNode/profile/cia401/port/rtthread/Kconfig
```kconfig
# RT-Thread lifecycle adapter for the local CiA 401 Device core.

config PKG_CANOPENNODE_CIA401_DEVICE_RTT_THREAD
    bool "Enable RT-Thread CiA 401 Device adapter"
    default n
    depends on PKG_CANOPENNODE_CIA401_DEVICE
    depends on RT_USING_HEAP
    select PKG_CANOPENNODE_RTT_LIFECYCLE_EXTENSIONS
    select PKG_CANOPENNODE_RTT_CAN_TX_SUCCESS_OBSERVER if PKG_CANOPENNODE_CIA401_DIGITAL_EVENTS || PKG_CANOPENNODE_CIA401_ANALOG_EVENTS
    help
        Bind the Pure-C CiA 401 Device before PDO initialization and schedule
        bounded process passes from the common profile worker by default.
        Communication Reset drains stale worker requests and rebinds the new
        Object Dictionary generation. Enable the dedicated-worker option below
        only when CiA 401 backend latency must be isolated from other profiles.

if PKG_CANOPENNODE_CIA401_DEVICE_RTT_THREAD

config PKG_CANOPENNODE_CIA401_DEVICE_RTT_DEDICATED_WORKER
    bool "Use a dedicated co_401 worker thread"
    default n
    help
        Create a profile-private co_401 thread and semaphore instead of running
        CiA 401 process passes on the common co_prof worker. Use this when product
        IOIF callbacks have a materially different WCET/blocking risk or require
        independent scheduling priority. The default shared worker minimizes
        thread/stack/context-switch overhead across Device Profiles.

if PKG_CANOPENNODE_CIA401_DEVICE_RTT_DEDICATED_WORKER

config PKG_CANOPENNODE_CIA401_THREAD_STACK_SIZE
    int "CiA 401 dedicated worker stack size"
    default 1536

config PKG_CANOPENNODE_CIA401_THREAD_PRIORITY
    int "CiA 401 dedicated worker priority"
    default 6
    help
        Must be numerically greater (lower scheduling priority) than the existing co_rt worker.

endif

config PKG_CANOPENNODE_CIA401_DEVICE_RTT_EMCY_BRIDGE
    bool "Bridge CiA 401 profile warnings to EMCY"
    default y
    depends on PKG_CANOPENNODE_EM_ERR_STATUS_BITS_COUNT >= 73
    select PKG_CANOPENNODE_EM_PRODUCER
    help
        Consume Pure-C profile warning events after the OD lock is released,
        including the mandatory 0x0080 warning for analogue-input devices with
        Object 0x6423 disabled on entry to NMT Operational. Error-status bit 0x48
        is reserved by this adapter so it does not collide
        with the CiA 402 adapter's 0x40..0x47 per-axis diagnostic bits.

config PKG_CANOPENNODE_CIA401_DEVICE_RTT_AUTOSTART
    bool "Automatically create and attach CiA 401 runtime"
    default n
    depends on PKG_CANOPENNODE_APP_AUTO_INIT
    depends on RT_USING_COMPONENTS_INIT
    depends on RT_USING_HEAP
    select PKG_CANOPENNODE_RTT_LIFECYCLE_AUTOSTART
    help
        Allocate only the adapter runtime. The CO_401_device_config_t and IOIF
        remain product-owned and must outlive the default CANopenNodeRTT app.

config PKG_CANOPENNODE_CIA401_DEVICE_RTT_MSH
    bool "Enable CiA 401 MSH bench control"
    default n
    depends on PKG_CANOPENNODE_CIA401_DEVICE_RTT_DEMO
    depends on PKG_CANOPENNODE_CIA401_DEVICE_RTT_AUTOSTART
    depends on RT_USING_FINSH && FINSH_USING_MSH
    help
        Register the cia401 MSH command for the software-only RT-Thread demo.
        Commands inject raw DI/AI process values, inspect physical DO/AO state,
        write the same bound output OD entries used by SDO/RPDO, inject output
        fault/supervision state, and wake the configured shared or dedicated
        profile worker. This is bench/debug functionality only and does not
        change the product IOIF API.

endif
```

## misc/CanopenNode/profile/cia402/Kconfig
```kconfig
# Kconfig entry for the CiA 402 drives and motion-control profile.

menuconfig PKG_CANOPENNODE_CIA402
    bool "CiA 402 drives and motion control profile"
    default n
    help
        Enable the role-neutral CiA 402 common definitions. The profile remains
        disabled by default and does not select PDO, SYNC, SDO Client, RT-Thread
        Event, or any hardware-drive dependency.

if PKG_CANOPENNODE_CIA402

rsource "controller/Kconfig"
rsource "device/Kconfig"
rsource "port/rtthread/Kconfig"
rsource "demo/Kconfig"

endif
```

## misc/CanopenNode/profile/cia402/controller/Kconfig
```kconfig
config PKG_CANOPENNODE_CIA402_CONTROLLER
    bool "Transport-agnostic CiA 402 Controller PDS API"
    default n
    help
        Enable the Pure-C CiA 402 Controller PDS command sequencer. This helper
        observes a remote Statusword and generates PDS-owned Controlword updates.
        It does not select or own NMT, Heartbeat Consumer, SDO Client, PDO, SYNC,
        Object Dictionary, Node-ID, CAN transport, RT-Thread tasks, or heap memory.


config PKG_CANOPENNODE_CIA402_CONTROLLER_CLIENT
    bool "Portable CiA 402 Controller transport client"
    default n
    depends on PKG_CANOPENNODE_CIA402_CONTROLLER
    select PKG_CANOPENNODE_PROFILE_CONTROLLER_PORT
    help
        Add the stack- and RTOS-neutral CiA 402 SDO control-plane client on top
        of the common profile transport contract. It preserves the existing PDS
        retry/Fault Reset semantics without depending on CANopenNode or RT-Thread.

config PKG_CANOPENNODE_CIA402_CONTROLLER_RTT
    bool "CANopenNode RT-Thread CiA 402 Controller SDO adapter"
    default n
    depends on PKG_CANOPENNODE_CIA402_CONTROLLER_CLIENT
    depends on !PKG_CANOPENNODE_DEMO_SDO_CLIENT_TEST
    select PKG_CANOPENNODE_PROFILE_MASTER_RTT
    help
        Add the thin RT-Thread compatibility facade which binds the portable
        CiA 402 client to the common CANopenNode RT-Thread Master backend.
        Cyclic motion modes should still use PDO/SYNC-specific integration.
```

## misc/CanopenNode/profile/cia402/demo/Kconfig
```kconfig
# Kconfig for the package-provided CiA 402 RT-Thread demo factory.

menu "Demo"

config PKG_CANOPENNODE_CIA402_DEVICE_RTT_DEMO
    bool "Enable RT-Thread CiA 402 Device demo"
    default n
    depends on PKG_CANOPENNODE_CIA402_DEVICE_RTT_THREAD
    depends on PKG_CANOPENNODE_APP_AUTO_INIT
    depends on RT_USING_COMPONENTS_INIT
    depends on RT_USING_HEAP
    select PKG_CANOPENNODE_CIA402_DEVICE_RTT_AUTOSTART
    select PKG_CANOPENNODE_USING_DEMO_OD
    help
        Register the package-provided software-only CiA 402 Device factory for
        the default CANopenNodeRTT application. PDS transitions complete without
        hardware; PP/HM expose one BUSY interval before deterministic completion,
        while PV and enabled CSP/CSV/CST modes update deterministic software feedback.
        The demo uses logical devices 0..N-1 from the generated demo Object
        Dictionary and never controls a physical motor or power stage. Enable
        CANopen debug + RT-Thread ULOG for PDS/PP/PV/HM logs; optionally enable
        PKG_CANOPENNODE_CIA402_DEMO_SYNC_LOG for cyclic command/feedback snapshots.

if PKG_CANOPENNODE_CIA402_DEVICE_RTT_DEMO

config PKG_CANOPENNODE_CIA402_DEMO_AXIS_COUNT
    int "Demo logical device count"
    range 1 3
    default 3
    help
        Number of package demo axes to register. The generated demo Object
        Dictionary provides logical devices 0, 1 and 2, so this option is
        intentionally limited to 1..3.

config PKG_CANOPENNODE_CIA402_DEMO_SYNC_LOG
    bool "Log cyclic synchronous command/feedback snapshots"
    default n
    depends on PKG_CANOPENNODE_CIA402_DEVICE_SYNC_FASTPATH
    help
        Print CSP/CSV/CST command and feedback snapshots from the lower-priority
        co_402 worker. If that worker lags co_rt, intermediate SYNC generations may
        be coalesced. This is intended for protocol bring-up only; leave it disabled
        for WCET, jitter, or production realtime measurements.

endif

endmenu
```

## misc/CanopenNode/profile/cia402/device/Kconfig
```kconfig
# Kconfig for the Pure-C local CiA 402 Device core.

config PKG_CANOPENNODE_CIA402_DEVICE
    bool "Local CiA 402 Device core"
    default y
    help
        Build the Pure-C local Device manager, generated-OD binding and PDS
        supervisor. This layer has no RT-Thread/BSP dependency and allocates no
        axis storage dynamically.

config PKG_CANOPENNODE_CIA402_DEVICE_DIAGNOSTICS
    bool "Per-axis fault diagnostics"
    default n
    depends on PKG_CANOPENNODE_CIA402_DEVICE
    help
        Add the Pure-C per-axis diagnostic latch, generated Error-code object
        update and deferred report/reset event contract. Each configured axis
        must provide a bounded non-blocking DiagIF which maps product/internal
        fault origins to independent 0x603F and CANopen EMCY error codes.
        This layer does not call CANopenNode emergency APIs directly.

config PKG_CANOPENNODE_CIA402_DEVICE_MODE_PP
    bool "Profile Position (PP) mode"
    default y
    depends on PKG_CANOPENNODE_CIA402_DEVICE
    help
        Build the Pure-C Profile Position supervisor. An axis advertises PP only
        when its DriveIF provides mode entry/exit and profilePosition callbacks;
        only then are the PP-specific OD objects required during binding.

config PKG_CANOPENNODE_CIA402_DEVICE_MODE_PV
    bool "Profile Velocity (PV) mode"
    default y
    depends on PKG_CANOPENNODE_CIA402_DEVICE
    help
        Build the Pure-C Profile Velocity supervisor. An axis advertises PV only
        when its DriveIF provides mode entry/exit and profileVelocity callbacks;
        only then are the PV-specific OD objects required during binding.

config PKG_CANOPENNODE_CIA402_DEVICE_MODE_HM
    bool "Homing (HM) mode"
    default y
    depends on PKG_CANOPENNODE_CIA402_DEVICE
    help
        Build the Pure-C Homing supervisor. An axis advertises HM only when its
        DriveIF provides mode entry/exit and homing callbacks; only then are the
        homing-specific OD objects required during binding.

config PKG_CANOPENNODE_CIA402_DEVICE_MODE_CSP
    bool "Cyclic Synchronous Position (CSP) mode"
    default y
    depends on PKG_CANOPENNODE_CIA402_DEVICE
    depends on PKG_CANOPENNODE_USING_SYNC
    depends on PKG_CANOPENNODE_USING_PDO
    depends on PKG_CANOPENNODE_RPDO
    depends on PKG_CANOPENNODE_TPDO
    depends on PKG_CANOPENNODE_PDO_SYNC
    select PKG_CANOPENNODE_CIA402_DEVICE_SYNC_FASTPATH
    help
        Build the bounded CSP target snapshot used by the synchronous fast path.
        Runtime capability still requires a complete per-axis SyncIF.

config PKG_CANOPENNODE_CIA402_DEVICE_MODE_CSV
    bool "Cyclic Synchronous Velocity (CSV) mode"
    default y
    depends on PKG_CANOPENNODE_CIA402_DEVICE
    depends on PKG_CANOPENNODE_USING_SYNC
    depends on PKG_CANOPENNODE_USING_PDO
    depends on PKG_CANOPENNODE_RPDO
    depends on PKG_CANOPENNODE_TPDO
    depends on PKG_CANOPENNODE_PDO_SYNC
    select PKG_CANOPENNODE_CIA402_DEVICE_SYNC_FASTPATH
    help
        Build the bounded CSV target snapshot used by the synchronous fast path.
        Runtime capability still requires a complete per-axis SyncIF.

config PKG_CANOPENNODE_CIA402_DEVICE_MODE_CST
    bool "Cyclic Synchronous Torque (CST) mode"
    default y
    depends on PKG_CANOPENNODE_CIA402_DEVICE
    depends on PKG_CANOPENNODE_USING_SYNC
    depends on PKG_CANOPENNODE_USING_PDO
    depends on PKG_CANOPENNODE_RPDO
    depends on PKG_CANOPENNODE_TPDO
    depends on PKG_CANOPENNODE_PDO_SYNC
    select PKG_CANOPENNODE_CIA402_DEVICE_SYNC_FASTPATH
    help
        Build the bounded CST target/feedback bridge used by the synchronous fast path.
        Runtime capability still requires a complete per-axis SyncIF.

config PKG_CANOPENNODE_CIA402_DEVICE_SYNC_FASTPATH
    bool
    depends on PKG_CANOPENNODE_CIA402_DEVICE
    help
        Internal guard for the RPDO -> CiA 402 cyclic bridge -> TPDO path.
```
