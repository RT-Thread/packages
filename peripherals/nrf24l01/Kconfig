## peripherals/rs485/Kconfig
```kconfig
# Kconfig file for package rs485

menuconfig PKG_USING_RS485
    bool "rs485 driver package."
    select RT_USING_SERIAL
    select RT_USING_PIN
    default n

if PKG_USING_RS485

    config PKG_RS485_PATH
        string
        default "/packages/peripherals/rs485"

    config RS485_USING_DEV
        bool "using making RS485 device"
        default n
        
    config RS485_USING_DMA_RX
        bool "receive using the DMA mode"
        default n

    config RS485_USING_INT_TX
        bool "send using the interrupt mode"
        default n
        
    config RS485_USING_DMA_TX
        bool "send using the DMA mode"
        default n
        
    config RS485_SW_DLY_US
        int "sending and receiving switching delay"
        default 0
        
    config RS485_USING_TEST
        bool "using test"
        default n
        
    if RS485_USING_TEST

        config RS485_TEST_SERIAL
            string "serial device name"
            default "uart1"

        config RS485_TEST_BAUDRATE
            int "baudrate"
            default 9600

        config RS485_TEST_PARITY
            int "parity"
            range 0 2
            default 0

        config RS485_TEST_PIN
            int "mode control pin"
            range -1 176
            default -1

        config RS485_TEST_LEVEL
            int "send mode level"
            range 0 1
            default 0

    endif

    config RS485_USING_SAMPLE_MASTER
        bool "using sample master"
        default n

    if RS485_USING_SAMPLE_MASTER

        config RS485_SAMPLE_MASTER_SERIAL
            string "serial device name"
            default "uart2"

        config RS485_SAMPLE_MASTER_BAUDRATE
            int "baudrate"
            default 9600

        config RS485_SAMPLE_MASTER_PARITY
            int "parity"
            range 0 2
            default 0

        config RS485_SAMPLE_MASTER_PIN
            int "mode control pin"
            range -1 176
            default -1

        config RS485_SAMPLE_MASTER_LVL
            int "send mode level"
            range 0 1
            default 0

    endif

    config RS485_USING_SAMPLE_SLAVE
        bool "using sample slave"
        default n

    if RS485_USING_SAMPLE_SLAVE

        config RS485_SAMPLE_SLAVE_SERIAL
            string "serial device name"
            default "uart2"

        config RS485_SAMPLE_SLAVE_BAUDRATE
            int "baudrate"
            default 9600

        config RS485_SAMPLE_SLAVE_PARITY
            int "parity"
            range 0 2
            default 0

        config RS485_SAMPLE_SLAVE_PIN
            int "mode control pin"
            range -1 176
            default -1

        config RS485_SAMPLE_SLAVE_LVL
            int "send mode level"
            range 0 1
            default 0

    endif

    choice
        prompt "Version"
        default PKG_USING_RS485_LATEST_VERSION
        help
            Select the package version

        config PKG_USING_RS485_LATEST_VERSION
            bool "latest"

        config PKG_USING_RS485_V106
            bool "v1.06"
            
        config PKG_USING_RS485_V105
            bool "v1.05"
            
        config PKG_USING_RS485_V104
            bool "v1.04"
            
        config PKG_USING_RS485_V103
            bool "v1.03"

        config PKG_USING_RS485_V102
            bool "v1.02"

        config PKG_USING_RS485_V101
            bool "v1.01"

        config PKG_USING_RS485_V100
            bool "v1.00"
    endchoice

    config PKG_RS485_VER
       string
       default "latest" if PKG_USING_RS485_LATEST_VERSION
       default "v1.06"  if PKG_USING_RS485_V106
       default "v1.05"  if PKG_USING_RS485_V105
       default "v1.04"  if PKG_USING_RS485_V104
       default "v1.03"  if PKG_USING_RS485_V103
       default "v1.02"  if PKG_USING_RS485_V102
       default "v1.01"  if PKG_USING_RS485_V101
       default "v1.00"  if PKG_USING_RS485_V100

endif
```

## peripherals/rtc/Kconfig
```kconfig
menuconfig PKG_USING_EXTERN_RTC_DRIVERS
    bool "extern rtc drivers"
    default n
    select RT_USING_EXTERN_RTC

    if PKG_USING_EXTERN_RTC_DRIVERS

        rsource "ds3231/Kconfig"
        rsource "rx8900/Kconfig"

    endif
```

## peripherals/rtc/ds1307/Kconfig
```kconfig
# Kconfig file for package ds1307
menuconfig PKG_USING_DS1307
    bool "ds1307 Extern RTC Driver."
    default n
	select RT_USING_MTD_NOR
	select RT_USING_I2C

if PKG_USING_DS1307

	config PKG_DS1307_IIC_BUS
		string "select iic bus"
		default "i2c1"

	config PKG_DS1307_DEBUG
		bool "Enable  output rtc ds1307 debug message"
		default n
		
	config PKG_DS1307_RAM_SHELL_TEST
		bool "Enable   ds1307  RAM read write test in finsh"
		default n
	
    config PKG_DS1307_PATH
        string
        default "/packages/peripherals/rtc/ds1307"

    choice
		default PKG_USING_DS1307_LATEST_VERSION
        prompt "Version"
        help
            Select the package version

        config PKG_USING_DS1307_V100
            bool "v1.0.0"

        config PKG_USING_DS1307_LATEST_VERSION
            bool "latest"
    endchoice

    config PKG_DS1307_VER
		string
		default "v1.0.0"    if PKG_USING_DS1307_V100
		default "latest"    if PKG_USING_DS1307_LATEST_VERSION
	   


endif
```

## peripherals/rtc/ds3231/Kconfig
```kconfig
# Kconfig file for package ds3231
menuconfig PKG_USING_DS3231
    bool "ds3231:Extern RTC Driver for ds3231"
    default n

if PKG_USING_DS3231

    config PKG_DS3231_PATH
        string
        default "/packages/peripherals/rtc/ds3231"

    choice
        prompt "Version"
        default PKG_USING_DS3231_LATEST_VERSION
        help
            Select the package version

        config PKG_USING_DS3231_V100
            bool "v1.0.0"

        config PKG_USING_DS3231_LATEST_VERSION
            bool "latest"
    endchoice
          
    config PKG_DS3231_VER
       string
       default "v1.0.0"    if PKG_USING_DS3231_V100
       default "latest"    if PKG_USING_DS3231_LATEST_VERSION

endif
```

## peripherals/rtc/rx8900/Kconfig
```kconfig
# Kconfig file for package rx8900
menuconfig PKG_USING_RX8900
    bool "rx8900:Extern RTC Driver for rx8900"
    default n

if PKG_USING_RX8900

    config PKG_RX8900_PATH
        string
        default "/packages/peripherals/rtc/rx8900"

    choice
        prompt "Version"
        default PKG_USING_RX8900_LATEST_VERSION
        help
            Select the package version

        config PKG_USING_RX8900_V100
            bool "v1.0.0"

        config PKG_USING_RX8900_LATEST_VERSION
            bool "latest"
    endchoice

    config PKG_RX8900_VER
       string
       default "v1.0.0"    if PKG_USING_RX8900_V100
       default "latest"    if PKG_USING_RX8900_LATEST_VERSION

endif
```

## peripherals/rtt_esp_idf/Kconfig
```kconfig
# Kconfig file for package rtt_esp_idf
menuconfig PKG_USING_RTT_ESP_IDF
    bool "ESP-IDF: for espress serial ESP32C3 etc."
    select PKG_USING_FREERTOS_WRAPPER
    default n

if PKG_USING_RTT_ESP_IDF

    config PKG_RTT_ESP_IDF_PATH
        string
        default "/packages/peripherals/rtt_esp_idf"

    choice
        prompt "Version"
        default PKG_USING_RTT_ESP_IDF_LATEST_VERSION
        help
            Select the package version

        config PKG_USING_RTT_ESP_IDF_LATEST_VERSION
            bool "latest"
    endchoice
          
    config PKG_RTT_ESP_IDF_VER
       string
       default "latest"    if PKG_USING_RTT_ESP_IDF_LATEST_VERSION

endif
```

## peripherals/rtt_isotp-c/Kconfig
```kconfig
menuconfig PKG_USING_ISOTP_C
    bool "ISO-TP:ISO 15765-2 (also known as ISO-TP) protocol with CAN multi-link and event-driven support"
    default n
    select RT_USING_HEAP
    select RT_USING_CAN
    help
        A C library that implements the ISO 15765-2 (also known as ISO-TP) protocol.
        This package provides an adapter layer for RT-Thread with multi-link and event-driven support.

if PKG_USING_ISOTP_C

    menu "Adapter Layer Configuration"
        config PKG_ISOTP_C_POLL_THREAD_STACK_SIZE
            int "Stack size for the isotp-c polling thread"
            default 1024
            help
                This thread periodically calls isotp_poll() for all active links.

        config PKG_ISOTP_C_POLL_THREAD_PRIORITY
            int "Priority for the isotp-c polling thread"
            default 20
            help
                Priority of the polling thread.

        config PKG_ISOTP_C_POLL_INTERVAL_MS
            int "Polling interval in milliseconds"
            default 5
            help
                The interval at which the polling thread runs to update link states.
                A smaller value gives faster response but higher CPU usage.
    endmenu

    menu "ISO-TP Protocol Parameters"
        config ISO_TP_DEFAULT_BLOCK_SIZE
            int "Block Size (BS)"
            default 8
            help
                ISO-TP Block Size (BS). Max number of consecutive frames the receiver
                can receive without sending a new Flow Control frame. (0 = infinite)

        config ISO_TP_DEFAULT_ST_MIN_US
            int "Minimum Separation Time (STmin) in microseconds"
            default 0
            help
                ISO-TP Separation Time (STmin). Specifies the minimum time gap
                allowed between the transmission of consecutive frames.

        config ISO_TP_MAX_WFT_NUMBER
            int "Max number of Wait Frame Transmissions (WFTmax)"
            default 1
            help
                ISO-TP WFTmax. Indicates how many Wait Frames (FC.WT) can be
                transmitted by the receiver in a row if it's not ready to receive.

        config ISO_TP_DEFAULT_RESPONSE_TIMEOUT_US
            int "Response timeout in microseconds (Ar/As, Br/Bs, Cr/Cs)"
            default 100000
            help
                Default timeout for waiting for a response during a multi-frame
                send or receive (e.g., waiting for a Flow Control frame).

        config ISO_TP_FRAME_PADDING
            bool "Enable CAN frame padding"
            default n
            help
                If enabled, all transmitted CAN frames will be padded to 8 bytes.
                This is required by some ECUs.

        if ISO_TP_FRAME_PADDING
            config ISO_TP_FRAME_PADDING_VALUE
                hex "Padding value"
                default 0xAA
                help
                    The byte value used for padding CAN frames if padding is enabled.
        endif

        # The following options are mandatory for the event-driven adapter
        config ISO_TP_USER_SEND_CAN_ARG
            bool "Enable user argument for send_can function"
            default y
            help
                Adds a 'void *user_send_can_arg' to isotp_user_send_can.
                This is ESSENTIAL for multi-link/multi-CAN support. DO NOT DISABLE.

        config ISO_TP_TRANSMIT_COMPLETE_CALLBACK
            bool "Enable transmit complete callback"
            default y
            help
                Enables the isotp_set_tx_done_cb function.
                This is ESSENTIAL for the event-driven adapter. DO NOT DISABLE.

        config ISO_TP_RECEIVE_COMPLETE_CALLBACK
            bool "Enable receive complete callback"
            default y
            help
                Enables the isotp_set_rx_done_cb function.
                This is ESSENTIAL for the event-driven adapter. DO NOT DISABLE.
    endmenu

    config PKG_ISOTP_C_EXAMPLES
        bool "Enable isotp-c examples"
        default n
        select BSP_USING_CAN1
        select BSP_USING_CAN2
        help
            Enable examples for isotp-c package, demonstrating communication
            between two CAN interfaces.

    config PKG_ISOTP_C_PATH
        string
        default "/packages/peripherals/rtt_isotp-c"

    choice
        prompt "Version"
        help
            Select the package version

        config PKG_USING_ISOTP_C_V100
            bool "v1.0.0"

        config PKG_USING_ISOTP_C_LATEST_VERSION
            bool "latest"
    endchoice

    config PKG_ISOTP_C_VER
       string
       default "v1.0.0"    if PKG_USING_ISOTP_C_V100
       default "latest"    if PKG_USING_ISOTP_C_LATEST_VERSION


endif
```

## peripherals/sean_ws2812b/Kconfig
```kconfig
# Kconfig file for package sean_ws2812b
menuconfig PKG_USING_SEAN_WS2812B
    bool "Sean's WS2812B LED Driver Package"
    default n

if PKG_USING_SEAN_WS2812B

    config PKG_SEAN_WS2812B_PATH
        string
        default "/packages/peripherals/sean_ws2812b"

    choice
        prompt "Version"
        help
            Select the version of sean_ws2812b

        config PKG_USING_SEAN_WS2812B_LATEST
            bool "latest version (master branch)"

    endchoice

    config PKG_SEAN_WS2812B_VER
        string
        default "latest" if PKG_USING_SEAN_WS2812B_LATEST

    config SEAN_WS2812B_SPI_BUS_NAME
        string "SPI bus name (master)"
        default "spi1"
        help
            SPI bus (controller) name for WS2812B, e.g., 'spi1'.

    config SEAN_WS2812B_SPI_DEV_NAME
        string "SPI device name (slave)"
        default "spi10"
        help
            SPI device name for WS2812B, e.g., 'spi10'.

    config SEAN_WS2812B_SPI_CS_PORT
        string "SPI CS GPIO port"
        default "GPIOB"
        help
            SPI CS GPIO port for WS2812B, e.g., 'GPIOB'.

    config SEAN_WS2812B_SPI_CS_PIN
        int "SPI CS GPIO pin number"
        default 12
        help
            SPI CS GPIO pin number for WS2812B, e.g., 12.

    config SEAN_WS2812B_LED_NUMS
        int "Number of LEDs"
        default 5
        help
            Set the number of LEDs on the WS2812B strip.

    config SEAN_WS2812B_USING_DEMO
        bool "Enable demo examples"
        default n
        help
            Enable demo examples for WS2812B.

endif
```
