## misc/lwgps/Kconfig
```kconfig
# Kconfig file for package lwgps
menuconfig PKG_USING_LWGPS
    bool "lwgps: Lightweight GPS NMEA parser"
    default n

if PKG_USING_LWGPS

    config LWGPS_USING_SAMPLES
        bool "enable samples"
        default n

    config PKG_LWGPS_PATH
        string
        default "/packages/misc/lwgps"

    config GPS_MODULE_BAUD_RATE
    int "module communication baudrate(4800~115200)"
    default 9600
    range 4800 115200

    config LWGPS_CFG_DOUBLE
    int "Enables double precision for floating point values"
    default 0
    range 0 1

    config LWGPS_CFG_STATUS
    int "Enables status reporting callback"
    default 0
    range 0 1

    config LWGPS_CFG_STATEMENT_GPGGA
    int "Enables `GGA` statement parsing"
    default 1
    range 0 1

    config LWGPS_CFG_STATEMENT_GPGSA
    int "Enables `GSA` statement parsing"
    default 1
    range 0 1

    config LWGPS_CFG_STATEMENT_GPRMC
    int "Enables `RMC` statement parsing"
    default 1
    range 0 1

    config LWGPS_CFG_STATEMENT_GPGSV
    int "Enables `GSV` statement parsing"
    default 1
    range 0 1

    config LWGPS_CFG_STATEMENT_GPGSV_SAT_DET
    int "Enables detailed parsing of each satellite"
    default 0
    range 0 1

    config LWGPS_CFG_STATEMENT_PUBX
    int "Enables parsing and generation of PUBX (uBlox) messages"
    default 0
    range 0 1

    config LWGPS_CFG_STATEMENT_PUBX_TIME
    int "Enables parsing and generation of PUBX (uBlox) TIME messages"
    default 0
    range 0 1

    choice
        prompt "Version"
        default PKG_USING_LWGPS_LATEST_VERSION
        help
            Select the package version

        config PKG_USING_LWGPS_V100
            bool "v1.0.0"

        config PKG_USING_LWGPS_V110
            bool "v1.1.0"

        config PKG_USING_LWGPS_LATEST_VERSION
            bool "latest"
    endchoice


    config PKG_LWGPS_VER
       string
       default "v1.0.0"    if PKG_USING_LWGPS_V100
       default "v1.1.0"    if PKG_USING_LWGPS_V110
       default "latest"    if PKG_USING_LWGPS_LATEST_VERSION

endif
```

## misc/lzma/Kconfig
```kconfig
# Kconfig file for package lzma
menuconfig PKG_USING_LZMA
    bool "LZMA: A compression library with high compression ratio"
    default n
    help
       LZMA is a compression library with high compression ratio

if PKG_USING_LZMA

    config PKG_LZMA_PATH
        string
        default "/packages/misc/lzma"

    config LZMA_USING_SAMPLE
        bool "Enable using lzma sample"
        default n
        select RT_USING_DFS      if RT_VER_NUM < 0x40100
        select RT_USING_POSIX_FS if RT_VER_NUM >= 0x40100

    choice
        prompt "Version"
        default PKG_USING_LZMA_LATEST_VERSION
        help
            Select the lzma version

        config PKG_USING_LZMA_LATEST_VERSION
            bool "latest"

        config PKG_USING_LZMA_V100
            bool "v1.0.0"

    endchoice

    config PKG_LZMA_VER
       string
       default "v1.0.0"    if PKG_USING_LZMA_V100
       default "latest"    if PKG_USING_LZMA_LATEST_VERSION

endif
```

## misc/mcurses/Kconfig
```kconfig
# Kconfig file for package mcurses
menuconfig PKG_USING_MCURSES
    bool "mcurses: micro ncurses library"
    default n

if PKG_USING_MCURSES

    config PKG_MCURSES_PATH
        string
        default "/packages/misc/mcurses"

    config MCURSES_USING_SIMPLE
        bool "mcurses: simple demo"
        help
            mcurses: simple demo
        default n

    config MCURSES_USING_BOX
        bool "mcurses: box animation demo"
        help
            mcurses: box animation demo
        default n

    config MCURSES_USING_MATRIX_RAIN
        bool "mcurses: magic matrix rain demo"
        help
            mcurses: magic matrix rain demo
        default n

    config MCURSES_USING_SCREEN
        bool "mcurses: screen animation demo"
        help
            mcurses: screen animation demo
        default n

    config MCURSES_USING_TEMPERATURE
        bool "mcurses: temperature monitor demo"
        help
            mcurses: temperature monitor demo
        default n

    config MCURSES_USING_TOWER
        bool "mcurses: towers of hanoi animation demo"
        help
            mcurses: towers of hanoi animation demo
        default n

    choice
        prompt "Version"
        default PKG_USING_MCURSES_LATEST_VERSION
        help
            Select the package version

        config PKG_USING_MCURSES_LATEST_VERSION
            bool "latest"
    endchoice
          
    config PKG_MCURSES_VER
       string
       default "latest"    if PKG_USING_MCURSES_LATEST_VERSION
endif
```

## misc/miniLZO/Kconfig
```kconfig
menuconfig PKG_USING_MINILZO
    bool "miniLZO: A mini subset of the LZO real-time data compression library"
    default n
    help
        miniLZO is a mini subset of the LZO real-time data compression library.

if PKG_USING_MINILZO

    config PKG_MINILZO_VER
        string
        default "v1.0.0"

    config PKG_MINILZO_PATH
        string
        default "/packages/misc/miniLZO"

    config MINILZO_USING_SAMPLE
        bool "Enable using miniLZO sample"
        default n
        select RT_USING_DFS      if RT_VER_NUM < 0x40100
        select RT_USING_POSIX_FS if RT_VER_NUM >= 0x40100

    choice
        prompt "version"
        help
            Select the miniLZO version
        default PKG_USING_MINILZO_LATEST_VERSION

        config PKG_USING_MINILZO_LATEST_VERSION
            bool "latest"

        config PKG_USING_MINILZO_V100
            bool "v1.0.0"

    endchoice

    if PKG_USING_MINILZO_V100
        config PKG_MINILZO_VER
        string
        default "v1.0.0"
    endif

    if PKG_USING_MINILZO_LATEST_VERSION
       config PKG_MINILZO_VER
       string
       default "latest"
    endif

endif
```

## misc/minizip/Kconfig
```kconfig
# Kconfig file for package minizip
menuconfig PKG_USING_MINIZIP
    bool "minizip: zip manipulation library"
    select PKG_USING_ZLIB
    select RT_USING_DFS      if RT_VER_NUM < 0x40100
    select RT_USING_LIBC     if RT_VER_NUM < 0x40100
    select RT_USING_POSIX    if RT_VER_NUM < 0x40100
    select RT_USING_POSIX_FS if RT_VER_NUM >= 0x40100
    default n

if PKG_USING_MINIZIP

    config PKG_MINIZIP_PATH
        string
        default "/packages/misc/minizip"

    choice
        prompt "Version"
        default PKG_USING_MINIZIP_LATEST_VERSION
        help
            Select the package version

        config PKG_USING_MINIZIP_LATEST_VERSION
            bool "latest"
    endchoice

    config PKG_MINIZIP_VER
       string
       default "latest"    if PKG_USING_MINIZIP_LATEST_VERSION

endif
```

## misc/nnom/Kconfig
```kconfig
# Kconfig file for package nnom
menuconfig PKG_USING_NNOM
    bool "NNoM: A higher-level Neural Network framework on Microcontroller"
    default n

if PKG_USING_NNOM

    config PKG_NNOM_PATH
        string
        default "/packages/misc/nnom"

    choice
        prompt "Version"
        default PKG_USING_NNOM_V021
        help
            Select the package version

        config PKG_USING_NNOM_V010
            bool "v0.1.0"
			
        config PKG_USING_NNOM_V020
            bool "v0.2.0"
	    
        config PKG_USING_NNOM_V021
            bool "v0.2.1"

        config PKG_USING_NNOM_LATEST_VERSION
            bool "latest"
    endchoice
          
    config PKG_NNOM_VER
       string
       default "v0.1.0"    if PKG_USING_NNOM_V010
       default "v0.2.0"    if PKG_USING_NNOM_V020
       default "v0.2.1"    if PKG_USING_NNOM_V021
       default "latest"    if PKG_USING_NNOM_LATEST_VERSION

endif
```

## misc/optparse/Kconfig
```kconfig
# Kconfig file for package optparse
menuconfig PKG_USING_OPTPARSE
    bool "optparse: a public domain, portable, reentrant, embeddable, getopt-like option parser."
    default n

if PKG_USING_OPTPARSE

    config PKG_OPTPARSE_PATH
        string
        default "/packages/misc/optparse"

    choice
        prompt "optparse version"
        help
            Select the optparse version

        config PKG_USING_OPTPARSE_LATEST_VERSION
            bool "latest"
    endchoice

    config PKG_OPTPARSE_VER
        string
        default "latest" if PKG_USING_OPTPARSE_LATEST_VERSION

    config OPTPARSE_USING_DEMO
        bool
        prompt "optparse demo example"
        default n

endif
```

## misc/phase-locked-loop/Kconfig
```kconfig
# Kconfig file for package PHASE_LOCKED_LOOP
menuconfig PKG_USING_PHASE_LOCKED_LOOP
    bool "SOGI-based phase-locked loop(PLL) and frequency-locked loop(FLL) library"
    default n
    help
        PHASE_LOCKED_LOOP package is an implementation of SOGI based PLL and FLL.

if PKG_USING_PHASE_LOCKED_LOOP

    config PKG_PHASE_LOCKED_LOOP_PATH
        string
        default "/packages/misc/phase-locked-loop"

    choice
        prompt "Version"
        default PKG_USING_PHASE_LOCKED_LOOP_LATEST_VERSION
        help
            Select the version

        config PKG_USING_PHASE_LOCKED_LOOP_LATEST_VERSION
            bool "latest"

        config PKG_USING_PHASE_LOCKED_LOOP_V1_0_0
            bool "v1.0.0"
    endchoice

    config PKG_PHASE_LOCKED_LOOP_VER
        string
        default "latest" if PKG_USING_PHASE_LOCKED_LOOP_LATEST_VERSION
        default "v1.0.0" if PKG_USING_PHASE_LOCKED_LOOP_V1_0_0
endif
```

## misc/projects/Kconfig
```kconfig
menu "project laboratory"

rsource "industrial-gateway/Kconfig"
rsource "music-player/Kconfig"

endmenu
```

## misc/projects/industrial-gateway/Kconfig
```kconfig
menuconfig PROJECT_USING_INDUSTRIAL_DATEWAY
    bool "Industrial gataway: Integrate RS-485, RS-232, Ethernet"
    depends on BOARD_STM32F407_ATK_EXPLORER
    default n

if PROJECT_USING_INDUSTRIAL_DATEWAY

    config INDUSTRIAL_DATEWAY_ON_STM32F407_ATK_EXPLORER
        bool
        depends on BOARD_STM32F407_ATK_EXPLORER
        select BSP_USING_USB_TO_USART
        select BSP_USING_COM3
        select BSP_USING_ETH
        select BSP_USING_SDCARD_FATFS
        select BSP_USING_SPI_FLASH_LITTLEFS
        default y

endif
```

## misc/projects/music-player/Kconfig
```kconfig
menuconfig PROJECT_USING_MUSIC_PLAYER
    bool "music player"
    depends on BOARD_STM32L475_ATK_PANDORA
    default n

if PROJECT_USING_MUSIC_PLAYER

    config MUSIC_PLAYER_ON_STM32L475_ATK_PANDORA
        bool
        depends on BOARD_STM32L475_ATK_PANDORA
        select RT_USING_POSIX_FS
        select RT_USING_POSIX_STDIO
        select BSP_USING_SDCARD
        select BSP_USING_AUDIO
        select BSP_USING_AUDIO_PLAY
        select PKG_USING_WAVPLAYER
        select PKG_WP_USING_PLAY
        select PKG_USING_VT100
        default y

endif
```

## misc/qparam/Kconfig
```kconfig
# Kconfig file for package qparam

menuconfig PKG_USING_QPARAM
    bool "A quick and easy-to-use parameter management component."
    select PKG_USING_FAL if RT_VER_NUM < 0x40100
    select RT_USING_FAL if RT_VER_NUM >= 0x40100
    select PKG_USING_CRCLIB
    default n

if PKG_USING_QPARAM

    config PKG_QPARAM_PATH
        string
        default "/packages/misc/qparam"

    config PARAM_USING_INDEX
        bool "using index fast read/write param"
        default y

    config PARAM_USING_CLI
        bool "using command line list/read/write... param"
        default y

    config PARAM_USING_AUTO_INIT
        bool "using automatic initialize and load from flash"
        default y

    config PARAM_USING_AUTO_SAVE
        bool "using automatic save into flash"
        default y

    if PARAM_USING_AUTO_SAVE
        config PARAM_AUTO_SAVE_DELAY
            int "delay time (ms) of automatic saving"
            default 2000
    endif

    config PARAM_PART_NAME
        string "partition name for saving parameters"
        default "param"

    config PARAM_SECTOR_SIZE
        int "flash sector size"
        default 4096

    config PARAM_SAVE_ADDR
        int "save address for parameters"
        default 0

    config PARAM_SAVE_ADDR_BAK
        int "save address for backup parameters"
        default 4096

    choice
        prompt "Version"
        default PKG_USING_QPARAM_LATEST_VERSION
        help
            Select the package version
        config PKG_USING_QPARAM_LATEST_VERSION
            bool "latest"
    endchoice

    config PKG_QPARAM_VER
       string
       default "latest" if PKG_USING_QPARAM_LATEST_VERSION

endif
```

## misc/quicklz/Kconfig
```kconfig
menuconfig PKG_USING_QUICKLZ
    bool "QuickLZ : Fast data compression library"
    default n

if PKG_USING_QUICKLZ

    config PKG_QUICKLZ_PATH
        string
        default "/packages/misc/quicklz"

    config QLZ_USING_SAMPLE
        bool "Enable using quicklz sample"
        default n
        select RT_USING_DFS

    config QLZ_COMPRESSION_LEVEL
        help
            Set to 1, 2 or 3. Level 1 gives the fastest compression speed
            while level 3 gives the fastest decompression speed.
        int "The level of compression"
        default 3
        range 1 3

    choice
        prompt "version"
        default PKG_USING_QUICKLZ_V101
        help
            Select the QuickLZ version

        config PKG_USING_QUICKLZ_LATEST_VERSION
            bool "latest"

        config PKG_USING_QUICKLZ_V101
            bool "v1.0.1"

        config PKG_USING_QUICKLZ_V100
            bool "v1.0.0"

    endchoice

    config PKG_QUICKLZ_VER
       string
       default "v1.0.1"    if PKG_USING_QUICKLZ_V101
       default "v1.0.0"    if PKG_USING_QUICKLZ_V100
       default "latest"    if PKG_USING_QUICKLZ_LATEST_VERSION

endif
```

## misc/ralarm/Kconfig
```kconfig
# Kconfig file for package ralarm
menuconfig PKG_USING_RALARAM
    bool "ralarm: Infinitely scalable alarm components"
    default n

if PKG_USING_RALARAM

    config PKG_RALARM_PATH
        string
        default "/packages/misc/ralarm"

    config PKG_USING_RALARM_EXAMPLE
       bool "Enable ralarm example"
       default n

    choice
        prompt "Version"
        default PKG_USING_RALARM_LATEST_VERSION
        help
            Select the package version

        config PKG_USING_RALARM_LATEST_VERSION
            bool "latest"
    endchoice

    config PKG_RALARM_VER
       string
       default "latest"    if PKG_USING_RALARM_LATEST_VERSION

endif
```
