## peripherals/hal-sdk/n32/n32h47x_48x_std_driver/Kconfig
```kconfig
# Kconfig file for package n32h47x_48x_std_driver
menuconfig PKG_USING_N32H47X_48X_STD_DRIVER
    bool "N32H47X_48X STD driver package"
    default n

if PKG_USING_N32H47X_48X_STD_DRIVER

    config PKG_N32H47X_48X_STD_DRIVER_PATH
        string
        default "/packages/peripherals/hal-sdk/n32/n32h47x_48x_std_driver"

    choice
        prompt "Version"
        help
            Select the package version

        config PKG_USING_N32H47X_48X_STD_DRIVER_LATEST_VERSION
            bool "latest"
    endchoice

    config PKG_N32H47X_48X_STD_DRIVER_VER
       string
       default "latest"    if PKG_USING_N32H47X_48X_STD_DRIVER_LATEST_VERSION

endif
```

## peripherals/hal-sdk/n32/n32h49x_cmsis_driver/Kconfig
```kconfig
# Kconfig file for package n32h49x_cmsis_driver
menuconfig PKG_USING_N32H49X_CMSIS_DRIVER
    bool "N32H49x CMSIS driver package"
	select PKG_USING_CMSIS_CORE
    default n

if PKG_USING_N32H49X_CMSIS_DRIVER

    config PKG_N32H49X_CMSIS_DRIVER_PATH
        string
		default "/packages/peripherals/hal-sdk/n32/n32h49x_cmsis_driver"

    choice
        prompt "Version"
        help
            Select the package version

        config PKG_USING_N32H49X_CMSIS_DRIVER_LATEST_VERSION
            bool "latest"
    endchoice

    config PKG_N32H49X_CMSIS_DRIVER_VER
       string
       default "latest"    if PKG_USING_N32H49X_CMSIS_DRIVER_LATEST_VERSION

endif
```

## peripherals/hal-sdk/n32/n32h49x_std_driver/Kconfig
```kconfig
# Kconfig file for package n32h49x_std_driver
menuconfig PKG_USING_N32H49X_STD_DRIVER
    bool "N32H49X STD driver package"
    default n

if PKG_USING_N32H49X_STD_DRIVER

    config PKG_N32H49X_STD_DRIVER_PATH
        string
        default "/packages/peripherals/hal-sdk/n32/n32h49x_std_driver"

    choice
        prompt "Version"
        help
            Select the package version

        config PKG_USING_N32H49X_STD_DRIVER_LATEST_VERSION
            bool "latest"
    endchoice

    config PKG_N32H49X_STD_DRIVER_VER
       string
       default "latest"    if PKG_USING_N32H49X_STD_DRIVER_LATEST_VERSION

endif
```

## peripherals/hal-sdk/n32/n32h7xx_cmsis_driver/Kconfig
```kconfig
# Kconfig file for package n32h7xx_cmsis_driver
menuconfig PKG_USING_N32H7XX_CMSIS_DRIVER
    bool "N32H7xx CMSIS driver package"
	select PKG_USING_CMSIS_CORE
    default n

if PKG_USING_N32H7XX_CMSIS_DRIVER

    config PKG_N32H7XX_CMSIS_DRIVER_PATH
        string
		default "/packages/peripherals/hal-sdk/n32/n32h7xx_cmsis_driver"

    choice
        prompt "Version"
        help
            Select the package version

        config PKG_USING_N32H7XX_CMSIS_DRIVER_LATEST_VERSION
            bool "latest"
    endchoice

    config PKG_N32H7XX_CMSIS_DRIVER_VER
       string
       default "latest"    if PKG_USING_N32H7XX_CMSIS_DRIVER_LATEST_VERSION

endif
```

## peripherals/hal-sdk/n32/n32h7xx_std_driver/Kconfig
```kconfig
# Kconfig file for package n32h7xx_std_driver
menuconfig PKG_USING_N32H7XX_STD_DRIVER
    bool "N32H7XX STD driver package"
    default n

if PKG_USING_N32H7XX_STD_DRIVER

    config PKG_N32H7XX_STD_DRIVER_PATH
        string
        default "/packages/peripherals/hal-sdk/n32/n32h7xx_std_driver"

    choice
        prompt "Version"
        help
            Select the package version

        config PKG_USING_N32H7XX_STD_DRIVER_LATEST_VERSION
            bool "latest"
    endchoice

    config PKG_N32H7XX_STD_DRIVER_VER
       string
       default "latest"    if PKG_USING_N32H7XX_STD_DRIVER_LATEST_VERSION

endif
```

## peripherals/hal-sdk/novosns/Kconfig
```kconfig
menu "NOVOSNS Drivers"

#novosns
source "$PKGS_DIR/packages/peripherals/hal-sdk/novosns/novosns-series/Kconfig"

endmenu
```

## peripherals/hal-sdk/novosns/novosns-series/Kconfig
```kconfig
# Kconfig file for package novosns_series_driver
menuconfig PKG_USING_NOVOSNS_SERIES_DRIVER
    bool "NOVOSNS SERIES DRIVER PACKAGE"
    default n

if PKG_USING_NOVOSNS_SERIES_DRIVER

    config PKG_NOVOSNS_SERIES_DRIVER_PATH
        string
        default "/packages/peripherals/hal-sdk/novosns/novosns-series"

    choice
        prompt "Version"
        help
            Select the package version

        config PKG_USING_NOVOSNS_SERIES_DRIVER_LATEST_VERSION
            bool "latest"
    endchoice

    config PKG_NOVOSNS_SERIES_DRIVER_VER
       string
       default "latest"    if PKG_USING_NOVOSNS_SERIES_DRIVER_LATEST_VERSION

endif
```

## peripherals/hal-sdk/nrfx/Kconfig
```kconfig
# Kconfig file for package nrfx
menuconfig PKG_USING_NRFX
    bool "nrfx: Standalone drivers for peripherals present in Nordic Semiconductor's SoCs."
    default n

if PKG_USING_NRFX

    config PKG_NRFX_PATH
        string
        default "/packages/peripherals/hal-sdk/nrfx"

    choice
        prompt "Version"
        default PKG_USING_NRFX_LATEST_VERSION
        help
            Select the package version

        config PKG_USING_NRFX_V210
            bool "v2.1.0"

        config PKG_USING_NRFX_LATEST_VERSION
            bool "latest"
    endchoice

    config PKG_NRFX_VER
       string
       default "v2.1.0"    if PKG_USING_NRFX_V210
       default "latest"    if PKG_USING_NRFX_LATEST_VERSION

endif
```

## peripherals/hal-sdk/nuclei_sdk/Kconfig
```kconfig
# Only enable package nuclei_sdk when ARCH_RISCV is selected
# Currently it only works with Nuclei RISC-V Processor IP
if ARCH_RISCV
# Kconfig file for package nuclei_sdk
menuconfig PKG_USING_NUCLEI_SDK
    bool "Nuclei RISC-V Software Development Kit"
    default n

if PKG_USING_NUCLEI_SDK
    comment "!!!Nuclei SDK only works with Nuclei RISC-V Processor IP!!!"

    config PKG_NUCLEI_SDK_PATH
        string
        default "/packages/peripherals/hal-sdk/nuclei_sdk"

    choice
        prompt "Version"
        default PKG_USING_NUCLEI_SDK_LATEST_VERSION
        help
            Select the package version

        config PKG_USING_NUCLEI_SDK_V023
            bool "0.2.3"

        config PKG_USING_NUCLEI_SDK_V030
            bool "0.3.0"

        config PKG_USING_NUCLEI_SDK_V034
            bool "0.3.4"

        config PKG_USING_NUCLEI_SDK_LATEST_VERSION
            bool "latest"
    endchoice

    config PKG_NUCLEI_SDK_VER
       string
       default "0.2.3"     if PKG_USING_NUCLEI_SDK_V023
       default "0.3.0"     if PKG_USING_NUCLEI_SDK_V030
       default "0.3.4"     if PKG_USING_NUCLEI_SDK_V034
       default "latest"    if PKG_USING_NUCLEI_SDK_LATEST_VERSION

endif
endif
```

## peripherals/hal-sdk/nuvoton/Kconfig
```kconfig
menu "NUVOTON Drivers"

#nuvoton
source "$PKGS_DIR/packages/peripherals/hal-sdk/nuvoton/nuvoton-series/Kconfig"

endmenu
```

## peripherals/hal-sdk/nuvoton/nuvoton-arm926-lib/Kconfig
```kconfig
# Kconfig file for package nuvoton_arm926_lib
menuconfig PKG_USING_NUVOTON_ARM926_LIB
    bool "NUVOTON ARM926 LIB PACKAGE"
    default n

if PKG_USING_NUVOTON_ARM926_LIB

    config PKG_NUVOTON_ARM926_LIB_PATH
        string
        default "/packages/peripherals/hal-sdk/nuvoton/nuvoton-arm926-lib"

    choice
        prompt "Version"
        help
            Select the package version

        config PKG_USING_NUVOTON_ARM926_LIB_LATEST_VERSION
            bool "latest"
    endchoice

    config PKG_NUVOTON_ARM926_LIB_VER
       string
       default "latest"    if PKG_USING_NUVOTON_ARM926_LIB_LATEST_VERSION

endif
```

## peripherals/hal-sdk/nuvoton/nuvoton-series/Kconfig
```kconfig
# Kconfig file for package nuvoton_series_driver
menuconfig PKG_USING_NUVOTON_SERIES_DRIVER
    bool "NUVOTON SERIES DRIVER PACKAGE"
    select PKG_USING_NUVOTON_CMSIS_DRIVER
    default n

if PKG_USING_NUVOTON_SERIES_DRIVER

    config PKG_NUVOTON_SERIES_DRIVER_PATH
        string
        default "/packages/peripherals/hal-sdk/nuvoton/nuvoton-series"

    choice
        prompt "Version"
        help
            Select the package version

        config PKG_USING_NUVOTON_SERIES_DRIVER_LATEST_VERSION
            bool "latest"
    endchoice

    config PKG_NUVOTON_SERIES_DRIVER_VER
       string
       default "latest"    if PKG_USING_NUVOTON_SERIES_DRIVER_LATEST_VERSION

endif
```

## peripherals/hal-sdk/nuvoton/nuvoton_arm926_lib/Kconfig
```kconfig
# Kconfig file for package nuvoton_arm926_lib
menuconfig PKG_USING_NUVOTON_RAM926_LIB
    bool "NUVOTON ARM926 LIB PACKAGE"
    default n

if PKG_USING_NUVOTON_RAM926_LIB

    config PKG_NUVOTON_RAM926_LIB_PATH
        string
        default "/packages/peripherals/hal-sdk/nuvoton/nuvoton_arm926_lib"

    choice
        prompt "Version"
        help
            Select the package version

        config PKG_USING_NUVOTON_RAM926_LIB_LATEST_VERSION
            bool "latest"
    endchoice

    config PKG_USING_NUVOTON_RAM926_LIB_VER
       string
       default "latest"    if PKG_USING_NUVOTON_RAM926_LIB_LATEST_VERSION

endif
```

## peripherals/hal-sdk/nuvoton/nuvoton_cmsis/Kconfig
```kconfig
# Kconfig file for package NUVOTON_cmsis_driver
menuconfig PKG_USING_NUVOTON_CMSIS_DRIVER
    bool "NUVOTON CMSIS DRIVER PACKAGE"
    default n

if PKG_USING_NUVOTON_CMSIS_DRIVER

    config PKG_NUVOTON_CMSIS_DRIVER_PATH
        string
        default "/packages/peripherals/hal-sdk/nuvoton/nuvoton_cmsis"

    choice
        prompt "Version"
        help
            Select the package version

        config PKG_USING_NUVOTON_CMSIS_DRIVER_LATEST_VERSION
            bool "latest"
    endchoice

    config PKG_NUVOTON_CMSIS_DRIVER_VER
       string
       default "latest"    if PKG_USING_NUVOTON_CMSIS_DRIVER_LATEST_VERSION

endif
```

## peripherals/hal-sdk/nxp/Kconfig
```kconfig
menu "NXP HAL & SDK Drivers"

# nxp-mcx
source "$PKGS_DIR/packages/peripherals/hal-sdk/nxp/nxp-mcx-cmsis/Kconfig"
source "$PKGS_DIR/packages/peripherals/hal-sdk/nxp/nxp-mcx-series/Kconfig"

# nxp-lpc
source "$PKGS_DIR/packages/peripherals/hal-sdk/nxp/nxp-lpc-series/Kconfig"
source "$PKGS_DIR/packages/peripherals/hal-sdk/nxp/nxp-lpc55s-series/Kconfig"

# nxp-imx
source "$PKGS_DIR/packages/peripherals/hal-sdk/nxp/nxp-imx6sx-sdk/Kconfig"
source "$PKGS_DIR/packages/peripherals/hal-sdk/nxp/nxp-imx6ul-sdk/Kconfig"
source "$PKGS_DIR/packages/peripherals/hal-sdk/nxp/nxp-imxrt-sdk/Kconfig"

endmenu
```

## peripherals/hal-sdk/nxp/nxp-imx6sx-sdk/Kconfig
```kconfig
# Kconfig file for package nxp-imx6sx-sdk
menuconfig PKG_USING_NXP_IMX6SX_DRIVER
    bool "NXP IMX6SX DRIVER PACKAGE"
    default n

if PKG_USING_NXP_IMX6SX_DRIVER

    config PKG_NXP_IMX6SX_DRIVER_PATH
        string
        default "/packages/peripherals/hal-sdk/nxp/nxp-imx6sx-sdk"

    choice
        prompt "Version"
        help
            Select the package version

        config PKG_USING_NXP_IMX6SX_DRIVER_LATEST_VERSION
            bool "latest"
    endchoice

    config PKG_NXP_IMX6SX_DRIVER_VER
       string
       default "latest"    if PKG_USING_NXP_IMX6SX_DRIVER_LATEST_VERSION

endif
```

## peripherals/hal-sdk/nxp/nxp-imx6ul-sdk/Kconfig
```kconfig
# Kconfig file for package nxp-imx6ul-sdk
menuconfig PKG_USING_NXP_IMX6UL_DRIVER
    bool "NXP IMX6UL DRIVER PACKAGE"
    default n

if PKG_USING_NXP_IMX6UL_DRIVER

    config PKG_NXP_IMX6UL_DRIVER_PATH
        string
        default "/packages/peripherals/hal-sdk/nxp/nxp-imx6ul-sdk"

    choice
        prompt "Version"
        help
            Select the package version

        config PKG_USING_NXP_IMX6UL_DRIVER_LATEST_VERSION
            bool "latest"
    endchoice

    config PKG_NXP_IMX6UL_DRIVER_VER
       string
       default "latest"    if PKG_USING_NXP_IMX6UL_DRIVER_LATEST_VERSION

endif
```

## peripherals/hal-sdk/nxp/nxp-imxrt-sdk/Kconfig
```kconfig
# Kconfig file for package nxp-imxrt-sdk
menuconfig PKG_USING_NXP_IMXRT_DRIVER
    bool "NXP IMXRT DRIVER PACKAGE"
    default n

if PKG_USING_NXP_IMXRT_DRIVER

    config PKG_NXP_IMXRT_DRIVER_PATH
        string
        default "/packages/peripherals/hal-sdk/nxp/nxp-imxrt-sdk"

    choice
        prompt "Version"
        help
            Select the package version

        config PKG_USING_NXP_IMXRT_DRIVER_LATEST_VERSION
            bool "latest"
    endchoice

    config PKG_NXP_IMXRT_DRIVER_VER
       string
       default "latest"    if PKG_USING_NXP_IMXRT_DRIVER_LATEST_VERSION

endif
```

## peripherals/hal-sdk/nxp/nxp-lpc-series/Kconfig
```kconfig
# Kconfig file for package nxp_lpc_driver
menuconfig PKG_USING_NXP_LPC_DRIVER
    bool "NXP LPC DRIVER PACKAGE"
    default n

if PKG_USING_NXP_LPC_DRIVER

    config PKG_NXP_LPC_DRIVER_PATH
        string
        default "/packages/peripherals/hal-sdk/nxp/nxp-lpc-series"

    choice
        prompt "Version"
        help
            Select the package version

        config PKG_USING_NXP_LPC_DRIVER_LATEST_VERSION
            bool "latest"
    endchoice

    config PKG_NXP_LPC_DRIVER_VER
       string
       default "latest"    if PKG_USING_NXP_LPC_DRIVER_LATEST_VERSION

endif
```

## peripherals/hal-sdk/nxp/nxp-lpc55s-series/Kconfig
```kconfig
# Kconfig file for package nxp_lpc55s_driver
menuconfig PKG_USING_NXP_LPC55S_DRIVER
    bool "NXP LPC55S DRIVER PACKAGE"
    default n

if PKG_USING_NXP_LPC55S_DRIVER

    config PKG_NXP_LPC55S_DRIVER_PATH
        string
        default "/packages/peripherals/hal-sdk/nxp/nxp-lpc55s-series"

    choice
        prompt "Version"
        help
            Select the package version

        config PKG_USING_NXP_LPC55S_DRIVER_LATEST_VERSION
            bool "latest"
    endchoice

    config PKG_NXP_LPC55S_DRIVER_VER
       string
       default "latest"    if PKG_USING_NXP_LPC55S_DRIVER_LATEST_VERSION

endif
```

## peripherals/hal-sdk/nxp/nxp-mcx-cmsis/Kconfig
```kconfig
# Kconfig file for package nxp_mcx_cmsis_driver
menuconfig PKG_USING_NXP_MCX_CMSIS_DRIVER
    bool "NXP MCX CMSIS DRIVER PACKAGE"
    default n

if PKG_USING_NXP_MCX_CMSIS_DRIVER

    config PKG_NXP_MCX_CMSIS_DRIVER_PATH
        string
        default "/packages/peripherals/hal-sdk/nxp/nxp-mcx-cmsis"

    choice
        prompt "Version"
        help
            Select the package version

        config PKG_USING_NXP_MCX_CMSIS_DRIVER_LATEST_VERSION
            bool "latest"
    endchoice

    config PKG_NXP_MCX_CMSIS_DRIVER_VER
       string
       default "latest"    if PKG_USING_NXP_MCX_CMSIS_DRIVER_LATEST_VERSION

endif
```

## peripherals/hal-sdk/nxp/nxp-mcx-series/Kconfig
```kconfig
# Kconfig file for package nxp_mcx_series_driver
menuconfig PKG_USING_NXP_MCX_SERIES_DRIVER
    bool "NXP MCX SERIES DRIVER PACKAGE"
    default n

if PKG_USING_NXP_MCX_SERIES_DRIVER

    config PKG_NXP_MCX_SERIES_DRIVER_PATH
        string
        default "/packages/peripherals/hal-sdk/nxp/nxp-mcx-series"

    choice
        prompt "Version"
        help
            Select the package version

        config PKG_USING_NXP_MCX_SERIES_DRIVER_LATEST_VERSION
            bool "latest"
    endchoice

    config PKG_NXP_MCX_SERIES_DRIVER_VER
       string
       default "latest"    if PKG_USING_NXP_MCX_SERIES_DRIVER_LATEST_VERSION

endif
```

## peripherals/hal-sdk/raspberrypi-pico-rp2350-sdk/Kconfig
```kconfig
# Kconfig file for package raspberrypi rp2350
menuconfig PKG_USING_RASPBERRYPI_PICO_RP2350_SDK
    bool "Raspberry Pi Pico RP2350 SDK"
    default n

if PKG_USING_RASPBERRYPI_PICO_RP2350_SDK

    config PKG_RASPBERRYPI_PICO_RP2350_SDK_PATH
        string
        default "/packages/peripherals/hal-sdk/raspberrypi-pico-rp2350-sdk"

    choice
        prompt "Version"
        default PKG_USING_RASPBERRYPI_PICO_RP2350_SDK_LATEST_VERSION
        help
            Select the package version

        config PKG_USING_RASPBERRYPI_PICO_RP2350_SDK_LATEST_VERSION
            bool "latest"
    endchoice

    config PKG_RASPBERRYPI_PICO_RP2350_SDK_VER
       string
       default "latest"    if PKG_USING_RASPBERRYPI_PICO_RP2350_SDK_LATEST_VERSION

endif
```
