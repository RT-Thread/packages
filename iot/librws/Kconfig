## iot/librws/Kconfig
```kconfig
# Kconfig file for package librws
menuconfig PKG_USING_LIBRWS
    bool "librws: Tiny, cross platform websocket client C library"
    select RT_USING_LIBC        if RT_VER_NUM < 0x40100
    select RT_USING_POSIX       if RT_VER_NUM < 0x40100
    select RT_USING_POSIX_FS    if RT_VER_NUM >= 0x40100
    select RT_USING_PTHREADS
    default n
    help
        No additional dependecies
        Single header library interface librws.h with public methods
        Thread safe
        Send/receive logic in background thread
if PKG_USING_LIBRWS

    config PKG_LIBRWS_PATH
        string
        default "/packages/iot/librws"

    choice
        prompt "version"
        default PKG_USING_LIBRWS_V124
        help
            Select the librws version

        config PKG_USING_LIBRWS_V124
            bool "v1.2.4"

        config PKG_USING_LIBRWS_LATEST_VERSION
            bool "latest"
    endchoice

    config PKG_LIBRWS_VER
       string
       default "v1.2.4"    if PKG_USING_LIBRWS_V124
       default "latest"    if PKG_USING_LIBRWS_LATEST_VERSION

    config RWS_CONNECT_RETRY_DELAY
        int "Connect retry delay time(ms)"
        default 200

    config RWS_CONNECT_ATTEMPS
        int "Connect retry count"
        default 5

    config RWS_RECEIVE_BUFF_SIZE
        int "receive data buffer size"
        default 2048

    config LIBRWS_USING_MBED_TLS
    choice
        prompt "Select TLS mode"
        default LIBRWS_NOT_USE_TLS

        config LIBRWS_NOT_USE_TLS
            bool "Not support"

        config LIBRWS_USING_MBED_TLS
            bool "MbedTLS support"
            select PKG_USING_MBEDTLS
    endchoice

    config LIBRWS_USING_EXAMPLE
        bool "Using librws msh command example"
        default y
endif
```

## iot/ljson/Kconfig
```kconfig
config PKG_USING_LJSON
    bool "ljson: JSON parser in ANSI C"
    default n

if PKG_USING_LJSON

    config PKG_LJSON_PATH
        string
        default "/packages/iot/ljson"

    config PKG_LJSON_VER
        string
        default "v0.0.1"

endif
```

## iot/llsync_sdk_adapter/Kconfig
```kconfig
# Kconfig file for package llsync_sdk_adapter
menuconfig PKG_USING_LLSYNC_SDK_ADAPTER
    bool "The llsync ble sdk adapter."
    default n

if PKG_USING_LLSYNC_SDK_ADAPTER

    config PKG_LLSYNC_SDK_ADAPTER_PATH
        string
        default "/packages/iot/llsync_sdk_adapter"

    choice
        prompt "Version"
        default PKG_USING_LLSYNC_SDK_ADAPTER_LATEST_VERSION
        help
            Select the package version

        config PKG_USING_LLSYNC_SDK_ADAPTER_V100
            bool "v1.0.0"

        config PKG_USING_LLSYNC_SDK_ADAPTER_LATEST_VERSION
            bool "latest"
    endchoice

    config PKG_LLSYNC_SDK_ADAPTER_VER
       string
       default "v1.0.0"    if PKG_USING_LLSYNC_SDK_ADAPTER_V100
       default "latest"    if PKG_USING_LLSYNC_SDK_ADAPTER_LATEST_VERSION

endif
```

## iot/lora_pkt_fwd/Kconfig
```kconfig
# Kconfig file for package lora_pkt_fwd
menuconfig PKG_USING_LORA_PKT_FWD
    bool "lora_pkt_fwd:lora(wan) packet forward based on Semtech GWMP protocol(UDP)"
    default n

if PKG_USING_LORA_PKT_FWD

    config PKG_LORA_PKT_FWD_PATH
        string
        default "/packages/iot/lora_pkt_fwd"

    config LORA_PKT_FWD_USING_PROTOCOL_SEMTECH_GWMP
        bool
        default y

    config LORA_PKT_FWD_USING_MULTI_CHANNEL_MODE
        bool
        default y
        select RT_USING_SAL
        select RT_USING_PTHREADS

    config PKG_USING_LORA_GW_DRIVER_LIB
        bool "Use lora-gw-driver-lib"
        default y

    config LORA_PKT_FWD_USING_PARAMS_CONF_BY_JSON
        bool "Use Gateway JSON Configuration File"
        default n

    choice
        prompt "Select LoRaWAN Network Server"
        default LORA_PKT_FWD_USING_PROTOCOL_LIERDA_UNICORE
        help
            Select LoRaWAN Network Server(GWMP)

        config LORA_PKT_FWD_USING_PROTOCOL_LIERDA_UNICORE
            bool "Lierda Unicore"

        config LORA_PKT_FWD_USING_NETWORK_SERVER_TTN
            bool "TTN"

        config LORA_PKT_FWD_USING_NETWORK_SERVER_TENCENT
            bool "Tencent iot-explorer"
    endchoice

    menu "Enable LoRa Packet Forward Debug"
        config LORA_PKT_FWD_DEBUG
        bool "Enable lora-pkt-fwd Debug"
        default n

        if LORA_PKT_FWD_DEBUG
            config LPF_DBG_GWMP_CONFIG
                bool "Enable LPF GWMP Debug"
                default y
             config LPF_DBG_GWMP
                int
                default 1 if LPF_DBG_GWMP_CONFIG

             config LPF_DBG_SHELL_CONFIG
                bool "Enable LPF Shell Debug"
                default y
             config LPF_DBG_SHELL
                int
                default 1 if LPF_DBG_SHELL_CONFIG

             config LPF_DBG_PARAMS_CONF_CONFIG
                bool "Enable LPF Params Config Debug"
                default n
             config LPF_DBG_PARAMS_CONF
                int
                default 1 if LPF_DBG_PARAMS_CONF_CONFIG

            config LPF_DBG_USING_JIT_QUEUE
                bool "Enable Jit Queue Debug"
                default n
        endif
    endmenu

    choice
        prompt "Version"
        default PKG_USING_LORA_PKT_FWD_LATEST_VERSION
        help
            Select the package version

        config PKG_USING_LORA_PKT_FWD_V100
            bool "v1.0.0"

        config PKG_USING_LORA_PKT_FWD_LATEST_VERSION
            bool "latest"
    endchoice

    config PKG_LORA_PKT_FWD_VER
       string
       default "v1.0.0"    if PKG_USING_LORA_PKT_FWD_V100
       default "latest"    if PKG_USING_LORA_PKT_FWD_LATEST_VERSION
endif
```

## iot/lora_pkt_sniffer/Kconfig
```kconfig
# Kconfig file for package lora_pkt_sniffer
menuconfig PKG_USING_LORA_PKT_SNIFFER
    bool "lora_pkt_sniffer is a sniffer tool of lora(wan) packets."
    default n

if PKG_USING_LORA_PKT_SNIFFER

    config PKG_LORA_PKT_SNIFFER_PATH
        string
        default "/packages/iot/lora_pkt_sniffer"

    config LORA_PKT_SNIFFER_USING_WIRESHARK_MODE
        bool "Enable Wireshark Mode"
        default n

    config PKG_USING_LORA_GW_DRIVER_LIB
        bool "Use lora-gw-driver-lib"
        default y

    menu "Select lora-pkt-sniffer Debug"
         config LORA_PKT_SNIFFER_DEBUG
             bool "Enable lora-pkt-sniffer Debug"
             default n

             if LORA_PKT_SNIFFER_DEBUG
                 config LPS_DEBUG_SNF_CONFIG
                    bool "Enable LPS Sniffer Debug"
                    default n
                 config LPS_DBG_SNF
                    int
                    default 1 if LPS_DEBUG_SNF_CONFIG
                    default 0 if !LPS_DEBUG_SNF_CONFIG

                 config LPS_DEBUG_SHELL_CONFIG
                    bool "Enable LPS Shell Debug"
                    default n
                 config LPS_DBG_SHELL
                    int
                    default 1 if LPS_DEBUG_SHELL_CONFIG
                    default 0 if !LPS_DEBUG_SHELL_CONFIG

                 config LPS_DEBUG_NVM_CONFIG
                    bool "Enable LPS NVM Debug"
                    default n
                 config LPS_DBG_NVM
                    int
                    default 1 if LPS_DEBUG_NVM_CONFIG
                    default 0 if !LPS_DEBUG_NVM_CONFIG

                  config LPS_DEBUG_UDP_CONFIG
                    bool "Enable LPS UDP Debug"
                    default n
                 config LPS_DBG_UDP
                    int
                    default 1 if LPS_DEBUG_UDP_CONFIG
                    default 0 if !LPS_DEBUG_UDP_CONFIG
             endif
      endmenu

    config PKG_LORA_PKT_SNIFFER_VER
       string
       default "v1.0.0"    if PKG_USING_LORA_PKT_SNIFFER_V100
       default "latest"    if PKG_USING_LORA_PKT_SNIFFER_LATEST_VERSION

    choice
        prompt "Version"
        default PKG_USING_LORA_PKT_SNIFFER_LATEST_VERSION
        help
            Select the package version

        config PKG_USING_LORA_PKT_SNIFFER_V100
            bool "v1.0.0"

        config PKG_USING_LORA_PKT_SNIFFER_LATEST_VERSION
            bool "latest"
    endchoice
endif
```

## iot/lorawan_driver/Kconfig
```kconfig
# Kconfig file for package lorawan_driver
menuconfig PKG_USING_LORAWAN_DRIVER
    bool "LoRaWAN_Driver : Support for LoRaWAN Network(Semtech)"
    default n

if PKG_USING_LORAWAN_DRIVER

    config PKG_LORAWAN_DRIVER_PATH
        string
        default "/packages/iot/lorawan_driver"

    config LORAWAN_DRIVER_DEFAULT_DATARATE
    int "LORAWAN_DRIVER_DEFAULT_DATARATE"
    range 1 5
    default 5

    config LORAWAN_DRIVER_APP_PORT
    int "LORAWAN_DRIVER_APP_PORT"
    range 0 255
    default 3

    config LORAWAN_DRIVER_USING_Example
    bool "Enable Example"
    default y

    choice
        prompt "Work Mode"
        default LORAWAN_DRIVER_ClassA
        help
            Select the Work Mode
        config LORAWAN_DRIVER_ClassA
            bool "ClassA"
        config LORAWAN_DRIVER_ClassC
            bool "ClassC"
    endchoice

    choice
        prompt "Join Mode"
        default LORAWAN_DRIVER_ABP
        help
            Select the Join Mode
        config LORAWAN_DRIVER_OTAA
            bool "OTAA"

        config LORAWAN_DRIVER_ABP
            bool "ABP"
    endchoice

    choice
        prompt "Select the RF frequency"
        help
            Select the RF frequency

        config LORAWAN_DRIVER_REGION_EU433
            bool "LORAMAC_REGION_EU433"

        config LORAWAN_DRIVER_REGION_CN470
            bool "LORAMAC_REGION_CN470"
    endchoice

    choice
    prompt "Version"
    default PKG_USING_LORAWAN_DRIVER_LATEST_VERSION
    help
        Select the package version

    config PKG_USING_LORAWAN_DRIVER_LATEST_VERSION
        bool "latest"
    endchoice

    config PKG_LORAWAN_DRIVER_VER
       string
       default "latest"    if PKG_USING_LORAWAN_DRIVER_LATEST_VERSION

endif
```
