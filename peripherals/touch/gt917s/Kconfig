## signalprocess/kissfft/Kconfig
```kconfig
# Kconfig file for package kissfft
menuconfig PKG_USING_KISSFFT
    bool "kissfft: a Fast Fourier Transform (FFT) library"
    default n

if PKG_USING_KISSFFT

    config PKG_KISSFFT_PATH
        string
        default "/packages/signalprocess/kissfft"

    choice
        prompt "Version"
        help
            Select the package version

        config PKG_USING_KISSFFT_V100
            bool "v131.1.0"

        config PKG_USING_KISSFFT_LATEST_VERSION
            bool "latest"
    endchoice

    config PKG_KISSFFT_VER
       string
       default "v131.1.0"    if PKG_USING_KISSFFT_V13110
       default "latest"      if PKG_USING_KISSFFT_LATEST_VERSION

endif
```

## signalprocess/qpid/Kconfig
```kconfig
# Kconfig file for package qpid

menuconfig PKG_USING_QPID
    bool "A quick and easy-to-use PID algorithm component"
    default n

if PKG_USING_QPID

    config PKG_QPID_PATH
        string
        default "/packages/signalprocess/qpid"

    config QPID_USING_TEST
        bool "using test"
        default n

    choice
        prompt "Version"
        default PKG_USING_QPID_LATEST_VERSION
        help
            Select the package version

        config PKG_USING_QPID_LATEST_VERSION
            bool "latest"

        config PKG_USING_QPID_V100
            bool "v1.00"
    endchoice

    config PKG_QPID_VER
       string
       default "latest" if PKG_USING_QPID_LATEST_VERSION
       default "v1.00"  if PKG_USING_QPID_V100

endif
```

## system/Arm-2D/Kconfig
```kconfig
# Kconfig file for package Arm_2D
menuconfig PKG_USING_ARM_2D
    bool "Arm-2D Graphics Library"
    select RT_USING_LIBC if RT_VER_NUM < 0x40100
    select PKG_USING_CMSIS_5
    select PKG_CMSIS_DSP
    select PKG_CMSIS_DSP_BASIC_MATH
    select PKG_CMSIS_DSP_COMMON_TABLES
    select PKG_CMSIS_DSP_FAST_MATH
    default n

if PKG_USING_ARM_2D

    config PKG_ARM_2D_PATH
        string
        default "/packages/system/Arm-2D"

    choice
        prompt "Version"
        default PKG_USING_ARM_2D_LATEST_VERSION
        help
            Select the package version

        config PKG_USING_ARM_2D_LATEST_VERSION
            bool "latest"
    endchoice

    config PKG_ARM_2D_VER
       string
       default "latest"    if PKG_USING_ARM_2D_LATEST_VERSION

    config PKG_ARM_2D_USE_ANTI_ALIAS_TRANSFORM
        bool "Using transform for rotation and scaling."
        default y

    config PKG_ARM_2D_USE_EXAMPLE
        bool "Using Arm-2D example."
        default n
        help
            Using memory heap object to manage dynamic memory heap.
    if PKG_ARM_2D_USE_EXAMPLE
        choice
            prompt "Select an example"
            default PKG_ARM_2D_USE_EXAMPLE_BASIC

            config PKG_ARM_2D_USE_EXAMPLE_BASIC
                bool "Using basic example."

            config PKG_ARM_2D_USE_EXAMPLE_COMPLEX
                bool "Using complex example."
        endchoice
    endif

endif
```
