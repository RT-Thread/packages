## peripherals/kendryte-sdk/Kconfig
```kconfig
menu "Kendryte SDK"

source "$PKGS_DIR/packages/peripherals/kendryte-sdk/K210-SDK/Kconfig"
source "$PKGS_DIR/packages/peripherals/kendryte-sdk/K210-SDK/kendryte-sdk/Kconfig"

endmenu
```

## peripherals/kobuki/Kconfig
```kconfig
# Kconfig file for package kobuki
menuconfig PKG_USING_KOBUKI
    select RT_USING_LIBC if RT_VER_NUM < 0x40100
    bool "kobuki: Kobuki Robot serial communication driver."
    default n

if PKG_USING_KOBUKI

    config PKG_KOBUKI_PATH
        string
        default "/packages/peripherals/kobuki"

    config KOBUKI_SERIAL_NAME
        string "kobuki serial port"
        default "uart2"

    config KOBUKI_USING_GET_odometr_EXAMPLE
        bool "kobuki_get_odometry: get kobuki odometry (x, y, theta, v_x, v_theta)"
        help
            kobuki_get_odometry: get kobuki odometry (x, y, theta, v_x, v_theta)
        default n

    config KOBUKI_USING_GET_VERSION_EXAMPLE
        bool "kobuki_get_version: get kobuki firmware and hardware version and uuid."
        help
            kobuki_get_version: get kobuki firmware and hardware version and uuid
        default n

    config KOBUKI_USING_LED_EXAMPLE
        bool "kobuki_led_example: set the color of leds on the panel."
        help
            kobuki_led_example: set the color of leds on the panel.
        default n

    config KOBUKI_USING_PLAY_SOUND_EXAMPLE
        bool "kobuki_play_sound: play different sound sequences."
        help
            kobuki_play_sound: play different sound sequences.
        default n

    config KOBUKI_USING_POWER_EXAMPLE
        bool "kobuki_enable_power_example: enable power supply on the panel."
        help
            kobuki_enable_power_example: enable power supply on the panel.
        default n

    config KOBUKI_USING_SET_SPEED_EXAMPLE
        bool "kobuki_set_speed: set transformation and rotation speed in cm/s."
        help
            kobuki_set_speed: set transformation and rotation speed in cm/s.
        default n

    choice
        prompt "Version"
        default PKG_USING_KOBUKI_LATEST_VERSION
        help
            Select the package version

        config PKG_USING_KOBUKI_LATEST_VERSION
            bool "latest"
    endchoice

    config PKG_KOBUKI_VER
       string
       default "latest"    if PKG_USING_KOBUKI_LATEST_VERSION

endif
```

## peripherals/lcd/Kconfig
```kconfig
menuconfig PKG_USING_LCD_DRIVERS
    bool "lcd drivers"
    default n
    select RT_USING_LCD

    if PKG_USING_LCD_DRIVERS

        source "$PKGS_DIR/packages/peripherals/lcd/nt5510/Kconfig"

    endif
```

## peripherals/lcd/nt5510/Kconfig
```kconfig
# Kconfig file for package nt5510
menuconfig PKG_USING_NT5510
    bool "nt5510 lcd driver package."
    default n

if PKG_USING_NT5510

    config PKG_NT5510_PATH
        string
        default "/packages/peripherals/lcd/nt5510"

    choice
        prompt "Version"
        default PKG_USING_NT5510_LATEST_VERSION
        help
            Select the package version

        config PKG_USING_NT5510_V100
            bool "v1.0.0"

        config PKG_USING_NT5510_LATEST_VERSION
            bool "latest"
    endchoice
          
    config PKG_NT5510_VER
       string
       default "v1.0.0"    if PKG_USING_NT5510_V100
       default "latest"    if PKG_USING_NT5510_LATEST_VERSION

    config PKG_USING_NT5510_SAMPLE
        bool "Using sample"
        default n
endif
```

## peripherals/lcd_spi_driver/Kconfig
```kconfig
# Kconfig file for package lcd_spi_driver
menuconfig PKG_USING_LCD_SPI_DRIVER
    bool "The lcd spi driver"
    default n

if PKG_USING_LCD_SPI_DRIVER

    config PKG_LCD_SPI_DRIVER_PATH
        string
        default "/packages/peripherals/lcd_spi_driver"

    choice
        prompt "Select LCD driver"
        default PKG_LCD_SPI_USING_LCD_ST7789V2
        config PKG_LCD_SPI_USING_LCD_ST7789V2
            bool "ST7789V2"
        config PKG_LCD_SPI_USING_LCD_ST7735S
            bool "ST7735S"
        config PKG_LCD_SPI_USING_LCD_ST7796S
            bool "ST7796S"
        config PKG_LCD_SPI_USING_LCD_ILI9341
            bool "ILI9341"
        config PKG_LCD_SPI_USING_LCD_ILI9486
            bool "ILI9486"
        config PKG_LCD_SPI_USING_LCD_GC9A01
            bool "GC9A01"
        config PKG_LCD_SPI_USING_LCD_NV3030B
            bool "NV3030B"
    endchoice

    menu "LCD Configuration"

        choice
            prompt "LCD Orientation"
            default PKG_LCD_SPI_DIRECTION_0
            config PKG_LCD_SPI_DIRECTION_0
                bool "0 Degree"
            config PKG_LCD_SPI_DIRECTION_90
                bool "90 Degree"
            config PKG_LCD_SPI_DIRECTION_180
                bool "180 Degree"
            config PKG_LCD_SPI_DIRECTION_270
                bool "270 Degree"
        endchoice

        config PKG_LCD_SPI_PIXEL_WIDTH
            int "LCD Pixel Width"
            range 0 1024
            default 0

        config PKG_LCD_SPI_PIXEL_HEIGHT
            int "LCD Pixel Height"
            range 0 1024
            default 0

        config PKG_LCD_SPI_X_OFFSET
            int "LCD Pixel X Offset"
            range -128 128
            default 0

        config PKG_LCD_SPI_Y_OFFSET
            int "LCD Pixel Y Offset"
            range -128 128
            default 0

        config PKG_LCD_SPI_FRAME_BUFF
            bool "LCD Use Frame Buff"
            default n

        config PKG_LCD_SPI_SWAP_ENDIAN
            bool "LCD Swap Data Endian"
            default n
            
        config PKG_LCD_SPI_COLOR_BGR
            bool "LCD Use BGR Color Format"
            default n

        config PKG_LCD_SPI_DISPLAY_INVERSION
            bool "LCD Enable Display Inversion"
            default n

    endmenu

    config PKG_LCD_SPI_BUS_NAME
        string "LCD SPI Bus Name"
        default "spi0"

    config PKG_LCD_SPI_DEVICE_NAME
        string "LCD SPI Device Name"
        default "spi00"

    config PKG_LCD_SPI_FREQ
        int "SPI Frequency"
        range 0 100000000
        default 25000000

    config PKG_LCD_SPI_CS_PIN
        int "CS Pin"
        range -1 255
        default -1

    config PKG_LCD_SPI_DC_PIN
        int "DC Pin"
        range -1 255
        default -1

    config PKG_LCD_SPI_RES_PIN
        int "RES Pin"
        range -1 255
        default -1

    choice
        prompt "LCD Backlight Control Method"
        default PKG_LCD_SPI_BLK_PIN
        config PKG_LCD_SPI_BLK_PIN
            bool "Control Backlight via GPIO Pin"
        config PKG_LCD_SPI_BLK_PWM
            bool "Control Backlight via PWM"
    endchoice

    if PKG_LCD_SPI_BLK_PIN
        config PKG_LCD_SPI_BLK_PIN_NUM
            int "Backlight Control Pin Number"
            range -1 255
            default -1
    endif

    if PKG_LCD_SPI_BLK_PWM
        config PKG_LCD_SPI_BLK_PWM_NUM
            int "Backlight Control PWM Number"
            range -1 255
            default -1
    endif

    choice
        prompt "Version"
        default PKG_USING_LCD_SPI_DRIVER_LATEST_VERSION
        help
            Select the package version

        config PKG_USING_LCD_SPI_DRIVER_LATEST_VERSION
            bool "latest"
    endchoice

    config PKG_LCD_SPI_DRIVER_VER
       string
       default "latest"    if PKG_USING_LCD_SPI_DRIVER_LATEST_VERSION

endif
```

## peripherals/ld3320/Kconfig
```kconfig
# Kconfig file for package ld3320
menuconfig PKG_USING_LD3320
    bool "ld3320 speech recognition chip"
    default n

if PKG_USING_LD3320

    config PKG_LD3320_PATH
        string
        default "/packages/peripherals/ld3320"

    choice
        prompt "Version"
        default PKG_USING_LD3320_LATEST_VERSION
        help
            Select the package version

        config PKG_USING_LD3320_V100
            bool "v1.0.0"

        config PKG_USING_LD3320_LATEST_VERSION
            bool "latest"
    endchoice

    config PKG_LD3320_VER
       string
       default "v1.0.0"    if PKG_USING_LD3320_V100
       default "latest"    if PKG_USING_LD3320_LATEST_VERSION

    config PKG_LD3320_VERSION
       string
       default "v1.0.0"    if PKG_USING_LD3320_V100
       default "latest"    if PKG_USING_LD3320_LATEST_VERSION

    config PKG_USING_LD3320_DEMO
        bool "Use demo"
        default n

    if PKG_USING_LD3320_DEMO
        choice
            prompt "Role"
            default PKG_LD3320_DEMO_ROLE_ASR
            help
                Select the role
            config PKG_LD3320_DEMO_ROLE_ASR
                bool "ASR"
            config PKG_LD3320_DEMO_ROLE_MP3
                bool "MP3"
        select  PKG_USING_LD3320_MP3
        endchoice

        config PKG_LD3320_DEMO_SPI_DEV_NAME
            string "The spi device name for LD3320"
            default "spi10"

        config PKG_LD3320_DEMO_WR_PIN
            int "The wr pin of LD3320"
            default -1

        config PKG_LD3320_DEMO_RST_PIN
            int "The rst pin of LD3320"
            default -1

        config PKG_LD3320_DEMO_IRQ_PIN
            int "The irq pin of LD3320"
            default -1

    endif

    config PKG_USING_LD3320_DEBUG
        bool "Enable debug"
        default n

    if PKG_USING_LD3320_DEBUG
        config PKG_USING_LD3320_RECV_REPORT
            bool "Use recv report"
            default y

        config PKG_USING_LD3320_FINSH
            bool "Use shell cmd"
            default y

    endif

    config PKG_USING_LD3320_MP3
        bool "enable ld3320 mp3 mode"
        default n

endif
```

## peripherals/libnfc/Kconfig
```kconfig
# Kconfig file for package libnfc
menuconfig PKG_USING_LIBNFC
    select RT_USING_LIBC if RT_VER_NUM < 0x40100
    bool "libnfc: Platform independent Near Field Communication (NFC) library."
    default n

if PKG_USING_LIBNFC

    config PKG_LIBNFC_PATH
        string
        default "/packages/peripherals/libnfc"

    config LIBNFC_UART_NAME
        string "serial device name"
        default "uart2"

    config LIBNFC_USING_READ_TAG_EXAMPLE
        bool "libnfc: reading the tag example."
        help
            libnfc: reading the tag example.
        default n

    config DBG_ENABLE
        bool "Enable Debug"
        default n

    choice
        prompt "Version"
        default PKG_USING_LIBNFC_LATEST_VERSION
        help
            Select the package version

        config PKG_USING_LIBNFC_LATEST_VERSION
            bool "latest"
    endchoice

    config PKG_LIBNFC_VER
       string
       default "latest"    if PKG_USING_LIBNFC_LATEST_VERSION

endif
```

## peripherals/littled/Kconfig
```kconfig
# Kconfig file for package littled
menuconfig PKG_USING_LITTLED
    bool "littled: Little LED Daemon for LED driver"
    default n

if PKG_USING_LITTLED

    config PKG_LITTLED_PATH
        string
        default "/packages/peripherals/littled"

    config PKG_USING_LITTLED_PERIOD
        int "default pwm period (ms)"
        default 1000

    config PKG_USING_LITTLED_PULSE
        int "default pwm pulse (ms)"
        default 500

    config PKG_USING_LITTLED_BELL_TIME
        int "default bell time (ms)"
        default 50000

    config PKG_USING_LITTLED_BEEP_COUNT
        int "default beep count"
        range 1 100
        default 3

    config PKG_USING_LITTLED_SAMPLE
        bool "Enable littled sample"
        default n

    choice
        prompt "Version"
        default PKG_USING_LITTLED_LATEST_VERSION
        help
            Select the package version

        config PKG_USING_LITTLED_V020
            bool "v0.2.0"

        config PKG_USING_LITTLED_LATEST_VERSION
            bool "latest"
    endchoice
          
    config PKG_LITTLED_VER
       string
       default "v0.2.0"    if PKG_USING_LITTLED_V020
       default "latest"    if PKG_USING_LITTLED_LATEST_VERSION

endif
```

## peripherals/lkdGui/Kconfig
```kconfig
# Kconfig file for package lkdGui
menuconfig PKG_USING_LKDGUI
    bool "lkdGui a monochrome graphic lirary."
    default n

if PKG_USING_LKDGUI

    config PKG_LKDGUI_PATH
        string
        default "/packages/peripherals/lkdGui"

    config PKG_USING_LKDGUI_SAMPLE
        bool "Enable lkdGui sample"
        default n

    choice
        prompt "Version"
        default PKG_USING_LKDGUI_LATEST_VERSION
        help
            Select the package version

        config PKG_USING_LKDGUI_V001
            bool "v0.0.1"

        config PKG_USING_LKDGUI_LATEST_VERSION
            bool "latest"
    endchoice
          
    config PKG_LKDGUI_VER
       string
       default "v0.0.1"    if PKG_USING_LKDGUI_V001
       default "latest"    if PKG_USING_LKDGUI_LATEST_VERSION

endif
```
