## peripherals/at24cxx/Kconfig
```kconfig
# Kconfig file for package at24cxx
menuconfig PKG_USING_AT24CXX
    bool "at24cxx: eeprom at24cxx driver library."
    default n

if PKG_USING_AT24CXX

    config PKG_AT24CXX_PATH
        string
        default "/packages/peripherals/at24cxx"

    config PKG_AT24CXX_FINSH
        bool "Enable finsh test"
        default n

    menu "Select the Type of AT24CXX EEPROM"
        depends on PKG_USING_AT24CXX

        choice
            prompt "EEPROM Type Selection"
            default PKG_AT24CXX_EE_TYPE_AT24C02
            help
                Select the specific type of AT24CXX EEPROM.

            config PKG_AT24CXX_EE_TYPE_AT24C01
                bool "AT24C01 (1Kbit)"
                default n

            config PKG_AT24CXX_EE_TYPE_AT24C02
                bool "AT24C02 (2Kbit)"
                default y

            config PKG_AT24CXX_EE_TYPE_AT24C04
                bool "AT24C04 (4Kbit)"
                default n

            config PKG_AT24CXX_EE_TYPE_AT24C08
                bool "AT24C08 (8Kbit)"
                default n

            config PKG_AT24CXX_EE_TYPE_AT24C16
                bool "AT24C16 (16Kbit)"
                default n

            config PKG_AT24CXX_EE_TYPE_AT24C032
                bool "AT24C32 (32Kbit)"
                default n

            config PKG_AT24CXX_EE_TYPE_AT24C64
                bool "AT24C64 (64Kbit)"
                default n

            config PKG_AT24CXX_EE_TYPE_AT24C128
                bool "AT24C128 (128Kbit)"
                default n

            config PKG_AT24CXX_EE_TYPE_AT24C256
                bool "AT24C256 (256Kbit)"
                default n

            config PKG_AT24CXX_EE_TYPE_AT24C512
                bool "AT24C512 (512Kbit)"
                default n

        endchoice

        config PKG_AT24CXX_EE_TYPE
            int
            default 0 if PKG_AT24CXX_EE_TYPE_AT24C01
            default 1 if PKG_AT24CXX_EE_TYPE_AT24C02
            default 2 if PKG_AT24CXX_EE_TYPE_AT24C04
            default 3 if PKG_AT24CXX_EE_TYPE_AT24C08
            default 4 if PKG_AT24CXX_EE_TYPE_AT24C16
            default 5 if PKG_AT24CXX_EE_TYPE_AT24C32
            default 6 if PKG_AT24CXX_EE_TYPE_AT24C64
            default 7 if PKG_AT24CXX_EE_TYPE_AT24C128
            default 8 if PKG_AT24CXX_EE_TYPE_AT24C256
            default 9 if PKG_AT24CXX_EE_TYPE_AT24C512

    endmenu

    choice
        prompt "Version"
        default PKG_USING_AT24CXX_LATEST_VERSION
        help
            Select the package version

        config PKG_USING_AT24CXX_LATEST_VERSION
            bool "latest"
    endchoice

    config PKG_AT24CXX_VER
       string
       default "latest"    if PKG_USING_AT24CXX_LATEST_VERSION

endif
```

## peripherals/beep/Kconfig
```kconfig
# Kconfig file for package beep

menuconfig PKG_USING_BEEP
    bool "beep: Control the buzzer to make beeps at different intervals."
    default n

if PKG_USING_BEEP

    choice
        prompt "Buzzer type"
        default PKG_BEEP_ACTIVE_BUZZER
        help
            Select the the Buzzer type

        config PKG_BEEP_ACTIVE_BUZZER
            bool "Active buzzer"
            select RT_USING_PIN
            select BSP_USING_GPIO

        config PKG_BEEP_PASSIVE_BUZZER
            bool "Passive buzzer"
            select RT_USING_PWM
            select BSP_USING_PWM
    endchoice

    if PKG_BEEP_PASSIVE_BUZZER

        config PKG_BEEP_PWM_DEV_NAME
            string "Setting current PWM device name."
            default "pwm1"

        config PKG_BEEP_PWM_DEV_CHANNEL
            int "Setting current PWM device channel."
            range 1 4
            default 1

        config PKG_BEEP_DEFAULT_FREQ
            int "Setting the best frequency(Hz) for buzzer."
            range 100 10000
            default 2700

        if RT_USING_PM
            config PKG_BEEP_BLOCK_POWER_STOP
                bool "Block the MCU power enter to stop mode on beeping."
                default y

            config PKG_BEEP_SUPPORT_PM_RUN_FREQ_CHANGE
                bool "Beep with the original frequency at MCU run frequency changed."
                default y
        endif

    endif

    if !PKG_USING_BEEP_V100
        config PKG_BEEP_USING_MSH_CMD
        bool "Beep the buzzer on console to test."
        default n
    endif

    if RT_USING_HEAP
        config PKG_BEEP_THREAD_STACK_USING_HEAP
        bool "Use heap with the beep thread stack created."
        default y
    endif

    config PKG_BEEP_PATH
        string
        default "/packages/peripherals/beep"

    choice
        prompt "Version"
        default PKG_USING_BEEP_V100
        help
            Select the this package version

        config PKG_USING_BEEP_V100
            bool "v1.0.0"

        config PKG_USING_BEEP_LATEST_VERSION
            bool "latest"
    endchoice

    config PKG_BEEP_VER
        string
        default "v1.0.0" if PKG_USING_BEEP_V100
        default "latest" if PKG_USING_BEEP_LATEST_VERSION

endif
```

## peripherals/bh1750/Kconfig
```kconfig
# Kconfig file for package BH1750FVI
menuconfig PKG_USING_BH1750
    bool "BH1750FVI: Ambient Light Sensor IC BH1750FVI driver library"
    default n

if PKG_USING_BH1750

    config PKG_BH1750_PATH
        string
        default "/packages/peripherals/bh1750"

    config BH1750_USING_SOFT_FILTER
        bool "Enable average filter by software"
        default n
        help
            "It will automatic sample sensor's data by average filter thread."
            
    if BH1750_USING_SOFT_FILTER  
    
        config BH1750_AVERAGE_TIMES
            int "The number of averaging"
            default 10  
            help
                "When selected filter function, it will be the number you will add and divide amount."
                
        config BH1750_SAMPLE_PERIOD
            int "Peroid of sampling data(unit ms)"
            default 1000 
            help
                "When selected filter function, it will be the period you will sample. The unit of the period is millisecond."
    endif        
       

    choice
        prompt "Version"
        default PKG_USING_BH1750_LATEST_VERSION
        help
            Select the package version

        config PKG_USING_BH1750_LATEST_VERSION
            bool "latest"
    endchoice

    config PKG_BH1750_VER
       string
       default "v1.0.0"    if PKG_USING_BH1750_V100
       default "latest"    if PKG_USING_BH1750_LATEST_VERSION

endif
```

## peripherals/blink/Kconfig
```kconfig
# Kconfig file for package blink
menuconfig PKG_USING_BLINK
    bool "blink: easy led blink support lib"
    default n

if PKG_USING_BLINK

    config PKG_BLINK_PATH
        string
        default "/packages/peripherals/blink"

    choice
        prompt "Version"
        default PKG_USING_BLINK_LATEST_VERSION
        help
            Select the package version

        config PKG_USING_BLINK_V100
            bool "v1.0.0"

        config PKG_USING_BLINK_LATEST_VERSION
            bool "latest"
    endchoice

    config PKG_BLINK_VER
       string
       default "v1.0.0"    if PKG_USING_BLINK_V100
       default "latest"    if PKG_USING_BLINK_LATEST_VERSION

endif
```

## peripherals/bouffalolab_sdk/Kconfig
```kconfig
# Kconfig file for package bouffalolab_sdk

menuconfig PKG_USING_BL_MCU_SDK
    bool "bouffalolab: bl_mcu_sdk"
    default n

if PKG_USING_BL_MCU_SDK

    config PKG_BL_MCU_SDK_PATH
        string
        default "/packages/peripherals/bouffalolab_sdk"

    choice
        prompt "Version"
        default PKG_USING_BL_MCU_SDK_LATEST_VERSION
        help
            Select the package version

        config PKG_USING_BL_MCU_SDK_LATEST_VERSION
            bool "latest"
    endchoice

    config PKG_BL_MCU_SDK_VER
       string
       default "latest"    if PKG_USING_BL_MCU_SDK_LATEST_VERSION

endif
```

## peripherals/bt24s/Kconfig
```kconfig
# Kconfig file for package bt24s
menuconfig PKG_USING_BT24S
    bool "bt24s:  BT24S Bluetooth Module Support based on UART
    default n
    select PKG_USING_UAT    
    help
        Enable this option to add support for BT24S Bluetooth module.

if PKG_USING_BT24S
    config PKG_BT24S_PATH
        string
        default "/packages/peripherals/bt24s"

    choice
        prompt "Version"
        default PKG_USING_BT24S_LATEST_VERSION
        help
            Select the package version

        config PKG_USING_BT24S_LATEST_VERSION
            bool "latest"
    endchoice

    config PKG_BT24S_VER
       string
       default "latest" if PKG_USING_BT24S_LATEST_VERSION
    config BT24S_UART_NAME
        string "UART Device Name"
        default "uart1"
        help
            Set the UART device name for BT24S communication (e.g., uart1, uart2, uart3).
			
    config BT24S_UART_BUFFER_SIZE
        int "UART Receive Buffer Size"
        range 16 253
        default 253
        help
            Set the receive buffer size for UART.

    menu "GPIO Pin Configuration"
        config BT24S_ENPWR_PIN
            string "ENPWR (Power Enable) Pin"
            default "PD.2"
            help
                Set the GPIO pin for power control (format: Port.Pin, e.g., PD.2).

        config BT24S_ENAT_PIN
            string "ENAT (AT Mode) Pin"
            default "PD.1"
            help
                Set the GPIO pin for AT mode control (format: Port.Pin, e.g., PD.1).

        config BT24S_P09I_PIN
            string "P09I (HW RESET) Pin"
            default "PD.3"
            help
                Set the GPIO pin for hardware reset (format: Port.Pin, e.g., PD.3).
    endmenu

    config USING_BT24S_DEMO
        bool "Enable App Demo (example folder)"
        default n
        help
            Enable this option to compile the example code in the "example" folder.

endif 
```

## peripherals/bt_ecb02c/Kconfig
```kconfig
# Kconfig file for package bt_ecb02c

menuconfig PKG_USING_BT_ECB02C
    bool "Device driver of BT chip ECB02C"
    select PKG_USING_UAT
    default n

if PKG_USING_BT_ECB02C

    config PKG_BT_ECB02C_PATH
        string
        default "/packages/peripherals/bt_ecb02c"

    config BT_ECB02C_USING_TEST
        bool "using test function"
        default n

    config BT_ECB02C_USING_SAMPLE_MASTER
        bool "using master sample"
        default n

    config BT_ECB02C_USING_SAMPLE_SLAVE
        bool "using slave sample"
        default n

    choice
        prompt "Version"
        default PKG_USING_BT_ECB02C_LATEST_VERSION
        help
            Select the package version

        config PKG_USING_BT_ECB02C_LATEST_VERSION
            bool "latest"

        config PKG_USING_BT_ECB02C_V100
            bool "v1.00"
    endchoice

    config PKG_BT_ECB02C_VER
       string
       default "latest" if PKG_USING_BT_ECB02C_LATEST_VERSION
       default "v1.00"  if PKG_USING_BT_ECB02C_V100

endif
```

## peripherals/bt_mx01/Kconfig
```kconfig
# Kconfig file for package bt_mx01

menuconfig PKG_USING_BT_MX01
    bool "Device driver of BT chip MX-01"
    select PKG_USING_UAT
    default n

if PKG_USING_BT_MX01

    config PKG_BT_MX01_PATH
        string
        default "/packages/peripherals/bt_mx01"

    config BT_MX01_USING_SAMPLE
        bool "using slave sample"
        default n

    choice
        prompt "Version"
        default PKG_USING_BT_MX01_LATEST_VERSION
        help
            Select the package version

        config PKG_USING_BT_MX01_LATEST_VERSION
            bool "latest"

        config PKG_USING_BT_MX01_V100
            bool "v1.00"
    endchoice

    config PKG_BT_MX01_VER
       string
       default "latest" if PKG_USING_BT_MX01_LATEST_VERSION
       default "v1.00"  if PKG_USING_BT_MX01_V100

endif
```

## peripherals/bt_mx02/Kconfig
```kconfig
# Kconfig file for package bt_mx02

menuconfig PKG_USING_BT_MX02
    bool "Device driver of BT chip MX-02"
    select PKG_USING_UAT
    default n

if PKG_USING_BT_MX02

    config PKG_BT_MX02_PATH
        string
        default "/packages/peripherals/bt_mx02"

    config BT_MX02_USING_SAMPLE
        bool "using slave sample"
        default n

    choice
        prompt "Version"
        default PKG_USING_BT_MX02_LATEST_VERSION
        help
            Select the package version

        config PKG_USING_BT_MX02_LATEST_VERSION
            bool "latest"

        config PKG_USING_BT_MX02_V100
            bool "v1.00"
    endchoice

    config PKG_BT_MX02_VER
       string
       default "latest" if PKG_USING_BT_MX02_LATEST_VERSION
       default "v1.00"  if PKG_USING_BT_MX02_V100

endif
```

## peripherals/button/Kconfig
```kconfig
# Kconfig file for package button
menuconfig PKG_USING_BUTTON
    bool "button drive by C, support single and double click, long press, long press release"
    default n

if PKG_USING_BUTTON

    config PKG_BUTTON_PATH 
        string
        default "/packages/peripherals/button"
		
    config SINGLE_AND_DOUBLE_TRIGGER
        bool "support single and double click"
        default y
		
    config CONTINUOS_TRIGGER
        bool "support continuos trigger"
        default n
		
    config LONG_FREE_TRIGGER
        bool "support long press release"
        default n	
		
	config BUTTON_DEBOUNCE_TIME
		int "This value is the button debounce time"
		default 2  
		help
			"This value = (n-1)*(button processing callback cycle)"
			
	config BUTTON_CONTINUOS_CYCLE
		int "This value is the button press the trigger cycle continuously"
		default 1  
		help
			"This value = (n-1)*(button processing callback cycle)"	
			
	config BUTTON_LONG_CYCLE
		int "This value is the button long press cycle time"
		default 1  
		help
			"This value = (n-1)*(button processing callback cycle)"
			
	config BUTTON_DOUBLE_TIME
		int "This value is the button double click time"
		default 15  
		help
			"This value = (n-1)*(button processing callback cycle)"		
			
	config BUTTON_LONG_TIME
		int "This value is the button long press time"
		default 50  
		help
			"This value = (n-1)*(button processing callback cycle)"		
			
    choice
        prompt "Version"
        default PKG_USING_BUTTON_V100
        help
            Select the package version

        config PKG_USING_BUTTON_V100
            bool "v1.0.0"

        config PKG_USING_BUTTON_LATEST_VERSION
            bool "latest"
    endchoice
          
    config PKG_BUTTON_VER
       string
       default "v1.0.0"    if PKG_USING_BUTTON_V100
       default "latest"    if PKG_USING_BUTTON_LATEST_VERSION

endif
```
