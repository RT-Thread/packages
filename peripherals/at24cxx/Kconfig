## peripherals/easyblink/Kconfig
```kconfig
# Kconfig file for package easyblink

menuconfig PKG_USING_EASYBLINK
    bool "easyblink: Blink the LED easily and use a little RAM"
    select RT_USING_SEMAPHORE
    default n

if PKG_USING_EASYBLINK

    config PKG_EASYBLINK_MAX_LED_NUMS
        int "Setting the max LED nums"
        range 1 100
        default 1

    config PKG_EASYBLINK_USING_MSH_CMD
        bool "Blink led on console to test"
        default n

    if PKG_EASYBLINK_VER_NUM < 0x20100
        config PKG_EASYBLINK_USING_MUTEX
            bool "Use mutex to make thread safe"
            select RT_USING_MUTEX
            default n
    endif

    if RT_USING_HEAP
        config PKG_EASYBLINK_USING_HEAP
        bool "Use heap with the easyblink thread stack created"
        default n
    endif

    config PKG_EASYBLINK_PATH
        string
        default "/packages/peripherals/easyblink"

    choice
        prompt "Version"
        default PKG_USING_EASYBLINK_V210
        help
            Select the package version

        config PKG_USING_EASYBLINK_V210
            bool "v2.1.0"

        config PKG_USING_EASYBLINK_V201
            bool "v2.0.1"

        config PKG_USING_EASYBLINK_V200
            bool "v2.0.0"

        config PKG_USING_EASYBLINK_V100
            bool "v1.0.0"

        config PKG_USING_EASYBLINK_LATEST_VERSION
            bool "latest"
    endchoice

    config PKG_EASYBLINK_VER
        string
        default "v2.1.0" if PKG_USING_EASYBLINK_V210
        default "v2.0.1" if PKG_USING_EASYBLINK_V201
        default "v2.0.0" if PKG_USING_EASYBLINK_V200
        default "v1.0.0" if PKG_USING_EASYBLINK_V100
        default "latest" if PKG_USING_EASYBLINK_LATEST_VERSION

    config PKG_EASYBLINK_VER_NUM
        hex
        default 0x99999    if PKG_USING_EASYBLINK_LATEST_VERSION
        default 0x10000    if PKG_USING_EASYBLINK_V100
        default 0x20000    if PKG_USING_EASYBLINK_V200
        default 0x20001    if PKG_USING_EASYBLINK_V201
        default 0x20100    if PKG_USING_EASYBLINK_V210

endif
```

## peripherals/embARC_bsp/Kconfig
```kconfig
# Kconfig file for package embARC_bsp
menuconfig PKG_USING_EMBARC_BSP
    bool "embARC_bsp(Synopsys ARC Processer Board Support Package Software) package"
    default n

if PKG_USING_EMBARC_BSP

    config PKG_EMBARC_BSP_PATH
        string
        default "/packages/peripherals/embARC_bsp"

    choice
        prompt "Version"
        default PKG_USING_EMBARC_BSP_UPSTREAM_VERSION
        help
            Select the package version

        config PKG_USING_EMBARC_BSP_UPSTREAM_VERSION
            bool "upstream"
        config PKG_USING_EMBARC_BSP_MASTER_VERSION
            bool "master"
    endchoice

    config PKG_EMBARC_BSP_VER
       string
       default "upstream"    if PKG_USING_EMBARC_BSP_UPSTREAM_VERSION
       default "master"    if PKG_USING_EMBARC_BSP_MASTER_VERSION

endif
```

## peripherals/fingerprint/Kconfig
```kconfig
# Kconfig file for package fingerprint
menuconfig PKG_USING_FINGERPRINT
    bool "fingerprint module driver."
    default n

if PKG_USING_FINGERPRINT

    config FINGERPRINT_UART_NAME
        string "fingerprint uart name"
        default "uart2"

    config PKG_USING_FINGERPRINT_SAMPLE
        bool "Enable fingerprint SAMPLE"
        default y


    config PKG_FINGERPRINT_PATH
        string
        default "/packages/peripherals/fingerprint"

    choice
        prompt "Version"
        default PKG_USING_FINGERPRINT_LATEST_VERSION
        help
            Select the package version

        config PKG_USING_FINGERPRINT_V100
            bool "v1.0.0"

        config PKG_USING_FINGERPRINT_LATEST_VERSION
            bool "latest"
    endchoice

    config PKG_FINGERPRINT_VER
       string
       default "v1.0.0"    if PKG_USING_FINGERPRINT_V100
       default "latest"    if PKG_USING_FINGERPRINT_LATEST_VERSION

endif
```

## peripherals/gc9a01/Kconfig
```kconfig
# Kconfig file for package gc9a01
menuconfig PKG_USING_GC9A01
    bool "gc9a01: RT-Thread package for working with TFT LCD based on SPI."
    default n

if PKG_USING_GC9A01

    config PKG_GC9A01_PATH
        string
        default "/packages/peripherals/gc9a01"

    config PKG_USING_GC9A01_SPI_BUS_NAME
        string "SPI bus name"
        default "spi0"

    config PKG_USING_GC9A01_DC_PIN
        int "DC PIN number for example in frdm-mcxa153 board P3_1 -> 3*32+1"
        default "97"

    config PKG_USING_GC9A01_RES_PIN
        int "RES PIN number for example in frdm-mcxa153 board P3_30 -> 3*32+30"
        default "126"

    config PKG_USING_GC9A01_CS_PIN
        int "CS PIN number for example in frdm-mcxa153 board P1_3 -> 1*32+3"
        default "35"

    config PKG_USING_GC9A01_SAMPLE
        bool "Enable gc9a01 sample"
        default n

    choice
        prompt "Version"
        default PKG_USING_GC9A01_LATEST_VERSION
        help
            Select the package version

        config PKG_USING_GC9A01_LATEST_VERSION
            bool "latest"
    endchoice

    config PKG_GC9A01_VER
       string
       default "latest"    if PKG_USING_GC9A01_LATEST_VERSION

endif
```

## peripherals/hal-sdk/ESP-IDF/Kconfig
```kconfig
# Kconfig file for package ESP-IDF
menuconfig PKG_USING_ESP_IDF
    bool "ESP-IDF: Espressif IoT Development Framework"
    select PKG_USING_FREERTOS_WRAPPER
    default n

if PKG_USING_ESP_IDF

    config PKG_ESP_IDF_PATH
        string
        default "/packages/peripherals/hal-sdk/ESP-IDF"

    choice
        prompt "Version"
        default PKG_USING_ESP_IDF_LATEST_VERSION
        help
            Select the package version

        config PKG_USING_ESP_IDF_LATEST_VERSION
            bool "latest"
    endchoice

    config PKG_ESP_IDF_VER
       string
       default "latest"    if PKG_USING_ESP_IDF_LATEST_VERSION

endif
```

## peripherals/hal-sdk/Infineon/Infineon_capsense/Kconfig
```kconfig
# Kconfig file for package Infineon_capsense
menuconfig PKG_USING_INFINEON_CAPSENSE
    bool "Infineon_capsense."
    default n

if PKG_USING_INFINEON_CAPSENSE

    config PKG_INFINEON_CAPSENSE_PATH
        string
        default "/packages/peripherals/hal-sdk/Infineon/Infineon_capsense"

    choice
        prompt "Version"
        help
            Select the package version

        config PKG_USING_INFINEON_CAPSENSE_LATEST_VERSION
            bool "latest"
    endchoice

    config PKG_INFINEON_CAPSENSE_VER
       string
       default "latest"    if PKG_USING_INFINEON_CAPSENSE_LATEST_VERSION

endif
```

## peripherals/hal-sdk/Infineon/Infineon_cat1cm0p/Kconfig
```kconfig
# Kconfig file for package Infineon_cat1cm0p
menuconfig PKG_USING_INFINEON_CAT1CM0P
    bool "Infineon_cat1cm0p."
    default n

if PKG_USING_INFINEON_CAT1CM0P

    config PKG_INFINEON_CAT1CM0P_PATH
        string
        default "/packages/peripherals/hal-sdk/Infineon/Infineon_cat1cm0p"

    choice
        prompt "Version"
        help
            Select the package version

        config PKG_USING_INFINEON_CAT1CM0P_LATEST_VERSION
            bool "latest"
    endchoice

    config PKG_INFINEON_CAT1CM0P_VER
       string
       default "latest"    if PKG_USING_INFINEON_CAT1CM0P_LATEST_VERSION

endif
```

## peripherals/hal-sdk/Infineon/Infineon_cmsis/Kconfig
```kconfig
# Kconfig file for package Infineon_cmsis
menuconfig PKG_USING_INFINEON_CMSIS
    bool "Infineon_cmsis."
    default n

if PKG_USING_INFINEON_CMSIS

    config PKG_INFINEON_CMSIS_PATH
        string
        default "/packages/peripherals/hal-sdk/Infineon/Infineon_cmsis"

    choice
        prompt "Version"
        help
            Select the package version

        config PKG_USING_INFINEON_CMSIS_LATEST_VERSION
            bool "latest"
    endchoice

    config PKG_INFINEON_CMSIS_VER
       string
       default "latest"    if PKG_USING_INFINEON_CMSIS_LATEST_VERSION

endif
```

## peripherals/hal-sdk/Infineon/Infineon_core-lib/Kconfig
```kconfig
# Kconfig file for package Infineon_core-lib
menuconfig PKG_USING_INFINEON_CORE_LIB
    bool "Infineon_core-lib."
    default n

if PKG_USING_INFINEON_CORE_LIB

    config PKG_INFINEON_CORE_LIB_PATH
        string
        default "/packages/peripherals/hal-sdk/Infineon/Infineon_core-lib"

    choice
        prompt "Version"
        help
            Select the package version

        config PKG_USING_INFINEON_CORE_LIB_LATEST_VERSION
            bool "latest"
    endchoice

    config PKG_INFINEON_CORE_LIB_VER
       string
       default "latest"    if PKG_USING_INFINEON_CORE_LIB_LATEST_VERSION

endif
```

## peripherals/hal-sdk/Infineon/Infineon_csdidac/Kconfig
```kconfig
# Kconfig file for package Infineon_csdidac
menuconfig PKG_USING_INFINEON_CSDIDAC
    bool "Infineon_csdidac."
    default n

if PKG_USING_INFINEON_CSDIDAC

    config PKG_INFINEON_CSDIDAC_PATH
        string
        default "/packages/peripherals/hal-sdk/Infineon/Infineon_csdidac"

    choice
        prompt "Version"
        help
            Select the package version

        config PKG_USING_INFINEON_CSDIDAC_LATEST_VERSION
            bool "latest"
    endchoice

    config PKG_INFINEON_CSDIDAC_VER
       string
       default "latest"    if PKG_USING_INFINEON_CSDIDAC_LATEST_VERSION

endif
```
