## system/FreeRTOS_Wrapper/Kconfig
```kconfig
# Kconfig file for package FreeRTOS_Wrapper
menuconfig PKG_USING_FREERTOS_WRAPPER
    bool "FreeRTOS Application Compatibility Layer for RT-Thread"
    default n

if PKG_USING_FREERTOS_WRAPPER

    config PKG_FREERTOS_WRAPPER_PATH
        string
        default "/packages/system/FreeRTOS_Wrapper"

    config PKG_FREERTOS_USING_CONFIG_H
        bool "include <FreeRTOSConfig.h> to overwirte default configurations in FreeRTOS.h"
        default n

    config PKG_FREERTOS_USING_MEMMANG
        bool "Enable FreeRTOS memory heap policy"
        default n

    choice
        prompt "FreeRTOS memory heap policy"
        default PKG_FREERTOS_USING_MEMMANG_HEAP3
        depends on PKG_FREERTOS_USING_MEMMANG

        config PKG_FREERTOS_USING_MEMMANG_HEAP1
            bool "Heap1"

        config PKG_FREERTOS_USING_MEMMANG_HEAP2
            bool "Heap2"

        config PKG_FREERTOS_USING_MEMMANG_HEAP3
            bool "Heap3"

        config PKG_FREERTOS_USING_MEMMANG_HEAP4
            bool "Heap4"

        config PKG_FREERTOS_USING_MEMMANG_HEAP5
            bool "Heap5"
    endchoice

    choice
        prompt "Version"
        default PKG_USING_FREERTOS_WRAPPER_LATEST_VERSION
        help
            Select the package version

        config PKG_USING_FREERTOS_WRAPPER_V100
            bool "v1.0.0"
        config PKG_USING_FREERTOS_WRAPPER_LATEST_VERSION
            bool "latest"
    endchoice

    config PKG_FREERTOS_WRAPPER_VER
       string
       default "v1.0.0"    if PKG_USING_FREERTOS_WRAPPER_V100
       default "latest"    if PKG_USING_FREERTOS_WRAPPER_LATEST_VERSION

endif
```

## system/Kconfig
```kconfig
menu "system packages"

source "$PKGS_DIR/packages/system/enhanced-kservice/Kconfig"
source "$PKGS_DIR/packages/system/aUnity/Kconfig"
source "$PKGS_DIR/packages/system/acceleration/Kconfig"
source "$PKGS_DIR/packages/system/CMSIS/Kconfig"
source "$PKGS_DIR/packages/system/Micrium/Kconfig"
source "$PKGS_DIR/packages/system/FreeRTOS_Wrapper/Kconfig"
source "$PKGS_DIR/packages/system/LiteOS-SDK/Kconfig"
source "$PKGS_DIR/packages/system/tz-database/Kconfig"
source "$PKGS_DIR/packages/system/cairo/Kconfig"
source "$PKGS_DIR/packages/system/pixman/Kconfig"
source "$PKGS_DIR/packages/system/partition/Kconfig"
source "$PKGS_DIR/packages/system/perf_counter/Kconfig"
source "$PKGS_DIR/packages/system/fal/Kconfig"
source "$PKGS_DIR/packages/system/filex/Kconfig"
source "$PKGS_DIR/packages/system/levelx/Kconfig"
source "$PKGS_DIR/packages/system/FlashDB/Kconfig"
source "$PKGS_DIR/packages/system/sqlite/Kconfig"
source "$PKGS_DIR/packages/system/rti/Kconfig"
source "$PKGS_DIR/packages/system/yaffs2/Kconfig"
source "$PKGS_DIR/packages/system/littlefs/Kconfig"
source "$PKGS_DIR/packages/system/jffs2/Kconfig"
source "$PKGS_DIR/packages/system/uffs/Kconfig"
source "$PKGS_DIR/packages/system/lwext4/Kconfig"
source "$PKGS_DIR/packages/system/thread_pool/Kconfig"
source "$PKGS_DIR/packages/system/rt-robot/Kconfig"
source "$PKGS_DIR/packages/system/EV/Kconfig"
source "$PKGS_DIR/packages/system/syswatch/Kconfig"
source "$PKGS_DIR/packages/system/sys_load_monitor/Kconfig"
source "$PKGS_DIR/packages/system/plccore/Kconfig"
source "$PKGS_DIR/packages/system/ramdisk/Kconfig"
source "$PKGS_DIR/packages/system/minIni/Kconfig"
source "$PKGS_DIR/packages/system/qboot/Kconfig"
source "$PKGS_DIR/packages/system/Ppool/Kconfig"
source "$PKGS_DIR/packages/system/openamp/Kconfig"
source "$PKGS_DIR/packages/system/rpmsg-lite/Kconfig"
source "$PKGS_DIR/packages/system/lpm/Kconfig"
source "$PKGS_DIR/packages/system/tlsf/Kconfig"
source "$PKGS_DIR/packages/system/event_recorder/Kconfig"
source "$PKGS_DIR/packages/system/Arm-2D/Kconfig"
source "$PKGS_DIR/packages/system/mcuboot/Kconfig"
source "$PKGS_DIR/packages/system/TinyUSB/Kconfig"
source "$PKGS_DIR/packages/system/CherryUSB/Kconfig"
source "$PKGS_DIR/packages/system/kmulti_rtimer/Kconfig"
source "$PKGS_DIR/packages/system/TFDB/Kconfig"
source "$PKGS_DIR/packages/system/qpc/Kconfig"
source "$PKGS_DIR/packages/system/agile_upgrade/Kconfig"
source "$PKGS_DIR/packages/system/flash_blob/Kconfig"
source "$PKGS_DIR/packages/system/mlibc/Kconfig"
source "$PKGS_DIR/packages/system/TaskMsgBus/Kconfig"
source "$PKGS_DIR/packages/system/UartFramework/Kconfig"
source "$PKGS_DIR/packages/system/sfdb/Kconfig"
source "$PKGS_DIR/packages/system/rtp/Kconfig"
source "$PKGS_DIR/packages/system/reb/Kconfig"
source "$PKGS_DIR/packages/system/rmp/Kconfig"
source "$PKGS_DIR/packages/system/r-rhealstone/Kconfig"
source "$PKGS_DIR/packages/system/heartbeat/Kconfig"
endmenu
```

## system/LiteOS-SDK/Kconfig
```kconfig
# Kconfig file for package LiteOS-SDK
menuconfig PKG_USING_LITEOS_SDK
    bool "LiteOS SDK."
    default n

if PKG_USING_LITEOS_SDK

    config PKG_LITEOS_SDK_PATH
        string
        default "/packages/system/LiteOS-SDK"

    config PKG_LITEOS_SDK_USING_LITEOS_WRAPPER
        bool "Use the wrapper of LiteOS."
        default n

    menuconfig PKG_LITEOS_SDK_USING_HWSECUREC
        bool "Use the hwsecurec library of LiteOS."
        default n

        if PKG_LITEOS_SDK_USING_HWSECUREC

            config PKG_LITEOS_SDK_USING_DEMO
                bool "Use the hwsecurec library demo."
                default n

                if PKG_LITEOS_SDK_USING_DEMO

                    config PKG_LITEOS_SDK_USING_DEMO_MEMCPY_S
                        bool "Use the hwsecurec library <memcpy_s> demo."
                        default n

                    config PKG_LITEOS_SDK_USING_DEMO_MEMSET_S
                        bool "Use the hwsecurec library <memset_s> demo."
                        default n
                endif
        endif

    menuconfig PKG_LITEOS_SDK_USING_CLOUD
        bool "liteOS connects to Huawei Cloud"
        select BSP_USING_LPUART1
        select PKG_USING_AT_DEVICE
        select AT_DEVICE_USING_ESP8266
        select PKG_USING_KAWAII_MQTT
        select PKG_USING_KAWAII_MQTT_TEST
        select KAWAII_MQTT_NETSOCKET_USE_SAL
        default n

        if PKG_LITEOS_SDK_USING_CLOUD

            config ESP8266_SAMPLE_WIFI_SSID
                string "WIFI ssid"
                default "rtthread"

            config ESP8266_SAMPLE_WIFI_PASSWORD
                string "WIFI password"
                default "12345678"

            config ESP8266_SAMPLE_CLIENT_NAME
                string "AT client device name"
                default "lpuart1"
        endif

    choice
        prompt "Version"
        default PKG_USING_LITEOS_SDK_LATEST_VERSION
        help
            Select the package version

        config PKG_USING_LITEOS_SDK_LATEST_VERSION
            bool "latest"
    endchoice

    config PKG_LITEOS_SDK_VER
        string
        default "latest"    if PKG_USING_LITEOS_SDK_LATEST_VERSION
endif
```

## system/LittlevGL2RTT/Kconfig
```kconfig
# Kconfig file for package LittlevGL2RTT
menuconfig PKG_USING_LITTLEVGL2RTT
    bool "LittlevGL2RTT: The LittlevGl gui lib adapter RT-Thread"
    default n

if PKG_USING_LITTLEVGL2RTT

    config PKG_LITTLEVGL2RTT_PATH
        string
        default "/packages/system/LittlevGL2RTT"

    choice
        prompt "version"
        help
            Select the LittlevGL2RTT version

        config PKG_USING_LITTLEVGL2RTT_V001
            bool "v0.0.1"

        config PKG_USING_LITTLEVGL2RTT_LATEST_VERSION
            bool "latest"
    endchoice

    config PKG_LITTLEVGL2RTT_VER
       string
       default "v0.0.1" if PKG_USING_LITTLEVGL2RTT_V001
       default "latest" if PKG_USING_LITTLEVGL2RTT_LATEST_VERSION

    menu "LittlevGL2RTT Options"
        choice
            prompt "Memory management mode"
            default LV_MEM_DYNAMIC

            config LV_MEM_STATIC
                bool "static"
            config LV_MEM_DYNAMIC
                bool "dynamic"
        endchoice
        config LV_MEM_CUSTOM
            int
            default 0 if LV_MEM_STATIC
            default 1 if LV_MEM_DYNAMIC

        choice
            prompt "Color depth"
            default LV_COLOR_DEPTH_16

            config LV_COLOR_DEPTH_1
                bool "1bit"
            config LV_COLOR_DEPTH_8
                bool "8bit"
            config LV_COLOR_DEPTH_16
                bool "16bit"
            config LV_COLOR_DEPTH_24
                bool "24bit"
        endchoice
        config LV_COLOR_DEPTH
            int
            default 1  if LV_COLOR_DEPTH_1
            default 8  if LV_COLOR_DEPTH_8
            default 16 if LV_COLOR_DEPTH_16
            default 24 if LV_COLOR_DEPTH_24

        config LV_MEM_KB_SIZE
            int "Memory Size used by 'lv_mem_alloc'(KB)"
            range 2 65536
            default 32
            depends on LV_MEM_STATIC

        config LV_MEM_AUTO_DEFRAG
            int "Automatically defrag on free"
            default 1
            range 0 1
            depends on LV_MEM_STATIC

        config LV_HOR_RES
            int "horizontal pixels"
            default 480
        config LV_VER_RES
            int "vertical pixels"
            default 272
        config LV_DPI
            int "DPI(dot per inch)"
            default 50
    endmenu

    config LITTLEVGL2RTT_USING_DEMO
        bool
        prompt "LittlevGL2RTT demo example"
        default y
endif
```

## system/LuatOS_SOC/Kconfig
```kconfig
# Kconfig file for package LuatOS_SOC
menuconfig PKG_USING_LUATOS_SOC
    select RT_USING_DFS 
    select RT_USING_POSIX if RT_VER_NUM >= 0x40100
    select RT_USING_DFS_ROMFS
    select RT_USING_LIBC
    select RT_LIBC_USING_FILEIO if RT_VER_NUM >= 0x40100
    bool "LUATOS_SOC : Powerful embedded Lua Engine for IoT devices"
    default n

if PKG_USING_LUATOS_SOC

    config PKG_LUATOS_SOC_PATH
        string
        default "/packages/system/LuatOS_SOC"

    choice
        prompt "Version"
        default PKG_USING_LUATOS_SOC_LATEST_VERSION
        help
            Select the package version

        config PKG_USING_LUATOS_SOC_LATEST_VERSION
            bool "latest"
    endchoice
          
    config PKG_LUATOS_SOC_VER
       string
       default "latest"    if PKG_USING_LUATOS_SOC_LATEST_VERSION

config PKG_USING_LUATOS_SOC_LCD
    bool "LuatOS_SOC using lcd"
    default n

config PKG_USING_LUATOS_SOC_EINK
    bool "LuatOS_SOC using eink"
    default n

config PKG_LUATOS_SOC_LUAT_HEAP_SIZE
    int "LuatOS heap size"
    range 1 999
    default 64

endif
```

## system/Micrium/Kconfig
```kconfig
menu "Micrium: Micrium software products porting for RT-Thread"

rsource "uCOSIII_Wrapper/Kconfig"
rsource "uCOSII_Wrapper/Kconfig"
rsource "uC_CRC/Kconfig"
rsource "uC_CLK/Kconfig"
rsource "uC_Common/Kconfig"
rsource "uC_Modbus/Kconfig"

endmenu
```

## system/Micrium/uCOSIII_Wrapper/Kconfig
```kconfig
# Kconfig file for package uCOSIII_Wrapper
menuconfig PKG_USING_UCOSIII_WRAPPER
    bool "μC/OS-III RTOS Application Compatibility Layer for RT-Thread"
    default n
    select RT_USING_TIMER_SOFT
    select RT_USING_IDLE_HOOK

if PKG_USING_UCOSIII_WRAPPER

    config PKG_UCOSIII_WRAPPER_PATH
        string
        default "/packages/system/Micrium/uCOSIII_Wrapper"

    config PKG_USING_UCOSIII_WRAPPER_AUTOINIT
        bool "Enable uCOS-III wrapper automatical initialization"
        default y
        help
            The wrapper supports uCOS-III standard startup procedure. Alternatively,
            if you want to run uCOS-III apps directly and ignore the startup procedure,
            you can choose this option.

     config PKG_USING_UCOSIII_WRAPPER_TINY
        bool "Enable uCOS-III wrapper tiny mode"
        default y

    choice
        prompt "Version"
        default PKG_USING_UCOSIII_WRAPPER_LATEST_VERSION
        help
            Select the package version

        config PKG_USING_UCOSIII_WRAPPER_V100
            bool "v1.0.0"

        config PKG_USING_UCOSIII_WRAPPER_LATEST_VERSION
            bool "latest"
    endchoice

    config PKG_UCOSIII_WRAPPER_VER
       string
       default "v1.0.0"    if PKG_USING_UCOSIII_WRAPPER_V100
       default "latest"    if PKG_USING_UCOSIII_WRAPPER_LATEST_VERSION

endif
```

## system/Micrium/uCOSII_Wrapper/Kconfig
```kconfig
# Kconfig file for package uCOSII_Wrapper
menuconfig PKG_USING_UCOSII_WRAPPER
    bool "μC/OS-II RTOS Application Compatibility Layer for RT-Thread"
    default n
    select RT_USING_TIMER_SOFT
    select RT_USING_IDLE_HOOK


if PKG_USING_UCOSII_WRAPPER

    config PKG_UCOSII_WRAPPER_PATH
        string
        default "/packages/system/Micrium/uCOSII_Wrapper"

    config PKG_USING_UCOSII_WRAPPER_AUTOINIT
        bool "Enable uCOS-II wrapper automatical initialization"
        default y
        help
            The wrapper supports uCOS-II standard startup procedure. Alternatively,
            if you want to run uCOS-II apps directly and ignore the startup procedure,
            you can choose this option.

     config PKG_USING_UCOSII_WRAPPER_TINY
        bool "Enable uCOS-II wrapper tiny mode"
        default y

    choice
        prompt "Version"
        default PKG_USING_UCOSII_WRAPPER_LATEST_VERSION
        help
            Select the package version

        config PKG_USING_UCOSII_WRAPPER_V100
            bool "v1.0.0"

        config PKG_USING_UCOSII_WRAPPER_LATEST_VERSION
            bool "latest"
    endchoice

    config PKG_UCOSII_WRAPPER_VER
       string
       default "v1.0.0"    if PKG_USING_UCOSII_WRAPPER_V100
       default "latest"    if PKG_USING_UCOSII_WRAPPER_LATEST_VERSION

endif
```

## system/Micrium/uC_CLK/Kconfig
```kconfig
# Kconfig file for package uC_CLK
menuconfig PKG_USING_UC_CLK
    bool "uC/Clk for RT-Thread"
    default n
    select PKG_USING_UCOSIII_WRAPPER
    select PKG_USING_UCOSIII_WRAPPER_AUTOINIT

if PKG_USING_UC_CLK

    config PKG_UC_CLK_PATH
        string
        default "/packages/system/Micrium/uC_CLK"

    config PKG_USING_UC_CLK_TASK_PRIO
        int "The priority level value of uC/Clk task"
        default 10

    config PKG_USING_UC_CLK_TASK_STK_SIZE
        int "The stack size of uC/Clk task (sizeof(CPU_STK))"
        default 80

    config PKG_USING_UC_CLK_AUTOINIT
        bool "Enable uC/Clk automatical initialization"
        default y

    choice
        prompt "Version"
        default PKG_USING_UC_CLK_LATEST_VERSION
        help
            Select the package version

        config PKG_USING_UC_CLK_V100
            bool "v1.0.0"

        config PKG_USING_UC_CLK_LATEST_VERSION
            bool "latest"
    endchoice

    config PKG_UC_CLK_VER
       string
       default "v1.0.0"    if PKG_USING_UC_CLK_V100
       default "latest"    if PKG_USING_UC_CLK_LATEST_VERSION

endif
```

## system/Micrium/uC_CRC/Kconfig
```kconfig
# Kconfig file for package uC_CRC
menuconfig PKG_USING_UC_CRC
    bool "uC/CRC for RT-Thread"
    default n
    select PKG_USING_UCOSIII_WRAPPER

if PKG_USING_UC_CRC

    config PKG_UC_CRC_PATH
        string
        default "/packages/system/Micrium/uC_CRC"

    choice
        prompt "Version"
        default PKG_USING_UC_CRC_LATEST_VERSION
        help
            Select the package version

        config PKG_USING_UC_CRC_V100
            bool "v1.0.0"

        config PKG_USING_UC_CRC_LATEST_VERSION
            bool "latest"
    endchoice

    config PKG_UC_CRC_VER
       string
       default "v1.0.0"    if PKG_USING_UC_CRC_V100
       default "latest"    if PKG_USING_UC_CRC_LATEST_VERSION

endif
```
