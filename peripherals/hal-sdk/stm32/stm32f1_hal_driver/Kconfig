## peripherals/hal-sdk/stm32/stm32f1_hal_driver/Kconfig
```kconfig
# Kconfig file for package stm32f1_hal_driver
menuconfig PKG_USING_STM32F1_HAL_DRIVER
    bool "STM32 F1 HAL driver package"
    select PKG_USING_STM32F1_CMSIS_DRIVER
    default n

if PKG_USING_STM32F1_HAL_DRIVER

    config PKG_STM32F1_HAL_DRIVER_PATH
        string
        default "/packages/peripherals/hal-sdk/stm32/stm32f1_hal_driver"

    choice
        prompt "Version"
        help
            Select the package version

        config PKG_USING_STM32F1_HAL_DRIVER_LATEST_VERSION
            bool "latest"
    endchoice

    config PKG_STM32F1_HAL_DRIVER_VER
       string
       default "latest"    if PKG_USING_STM32F1_HAL_DRIVER_LATEST_VERSION

endif
```

## peripherals/hal-sdk/stm32/stm32g0_hal_driver/Kconfig
```kconfig
# Kconfig file for package stm32g0_hal_driver
menuconfig PKG_USING_STM32G0_HAL_DRIVER
    bool "STM32 G0 HAL driver package"
    select PKG_USING_STM32G0_CMSIS_DRIVER
    default n

if PKG_USING_STM32G0_HAL_DRIVER

    config PKG_STM32G0_HAL_DRIVER_PATH
        string
        default "/packages/peripherals/hal-sdk/stm32/stm32g0_hal_driver"

    choice
        prompt "Version"
        help
            Select the package version

        config PKG_USING_STM32G0_HAL_DRIVER_LATEST_VERSION
            bool "latest"
    endchoice

    config PKG_STM32G0_HAL_DRIVER_VER
       string
       default "latest"    if PKG_USING_STM32G0_HAL_DRIVER_LATEST_VERSION

endif
```

## peripherals/hal-sdk/stm32/stm32g4_hal_driver/Kconfig
```kconfig
# Kconfig file for package stm32g4_hal_driver
menuconfig PKG_USING_STM32G4_HAL_DRIVER
    bool "STM32 G4 HAL driver package"
    select PKG_USING_STM32G4_CMSIS_DRIVER
    default n

if PKG_USING_STM32G4_HAL_DRIVER

    config PKG_STM32G4_HAL_DRIVER_PATH
        string
        default "/packages/peripherals/hal-sdk/stm32/stm32g4_hal_driver"

    choice
        prompt "Version"
        help
            Select the package version

        config PKG_USING_STM32G4_HAL_DRIVER_LATEST_VERSION
            bool "latest"
    endchoice

    config PKG_STM32G4_HAL_DRIVER_VER
       string
       default "latest"    if PKG_USING_STM32G4_HAL_DRIVER_LATEST_VERSION

endif
```

## peripherals/hal-sdk/stm32/stm32h7_hal_driver/Kconfig
```kconfig
# Kconfig file for package stm32h7_hal_driver
menuconfig PKG_USING_STM32H7_HAL_DRIVER
    bool "STM32 H7 HAL driver package"
    select PKG_USING_STM32H7_CMSIS_DRIVER
    default n

if PKG_USING_STM32H7_HAL_DRIVER

    config PKG_STM32H7_HAL_DRIVER_PATH
        string
        default "/packages/peripherals/hal-sdk/stm32/stm32h7_hal_driver"

    choice
        prompt "Version"
        help
            Select the package version

        config PKG_USING_STM32H7_HAL_DRIVER_LATEST_VERSION
            bool "latest"
    endchoice

    config PKG_STM32H7_HAL_DRIVER_VER
       string
       default "latest"    if PKG_USING_STM32H7_HAL_DRIVER_LATEST_VERSION

endif
```

## peripherals/hal-sdk/stm32/stm32h7rs_cmsis_driver/Kconfig
```kconfig
# Kconfig file for package stm32h7rs_cmsis_driver
menuconfig PKG_USING_STM32H7RS_CMSIS_DRIVER
    bool "STM32 H7RS CMSIS driver package"
    select PKG_USING_CMSIS_CORE
    default n

if PKG_USING_STM32H7RS_CMSIS_DRIVER

    config PKG_STM32H7RS_CMSIS_DRIVER_PATH
        string
        default "/packages/peripherals/hal-sdk/stm32/stm32h7rs_cmsis_driver"

    choice
        prompt "Version"
        help
            Select the package version

        config PKG_USING_STM32H7RS_CMSIS_DRIVER_LATEST_VERSION
            bool "latest"
    endchoice

    config PKG_STM32H7RS_CMSIS_DRIVER_VER
       string
       default "latest"    if PKG_USING_STM32H7RS_CMSIS_DRIVER_LATEST_VERSION

endif
```

## peripherals/hal-sdk/stm32/stm32h7rs_hal_driver/Kconfig
```kconfig
# Kconfig file for package stm32h7rs_hal_driver
menuconfig PKG_USING_STM32H7RS_HAL_DRIVER
    bool "STM32 H7RS HAL driver package"
    select PKG_USING_STM32H7RS_CMSIS_DRIVER
    default n

if PKG_USING_STM32H7RS_HAL_DRIVER

    config PKG_STM32H7RS_HAL_DRIVER_PATH
        string
        default "/packages/peripherals/hal-sdk/stm32/stm32h7rs_hal_driver"

    choice
        prompt "Version"
        help
            Select the package version

        config PKG_USING_STM32H7RS_HAL_DRIVER_LATEST_VERSION
            bool "latest"
    endchoice

    config PKG_STM32H7RS_HAL_DRIVER_VER
       string
       default "latest"    if PKG_USING_STM32H7RS_HAL_DRIVER_LATEST_VERSION

endif
```

## peripherals/hal-sdk/stm32/stm32l4_hal_driver/Kconfig
```kconfig
# Kconfig file for package stm32l4_hal_driver
menuconfig PKG_USING_STM32L4_HAL_DRIVER
    bool "STM32 L4 HAL driver package"
    select PKG_USING_STM32L4_CMSIS_DRIVER
    default n

if PKG_USING_STM32L4_HAL_DRIVER

    config PKG_STM32L4_HAL_DRIVER_PATH
        string
        default "/packages/peripherals/hal-sdk/stm32/stm32l4_hal_driver"

    choice
        prompt "Version"
        help
            Select the package version

        config PKG_USING_STM32L4_HAL_DRIVER_LATEST_VERSION
            bool "latest"
    endchoice

    config PKG_STM32L4_HAL_DRIVER_VER
       string
       default "latest"    if PKG_USING_STM32L4_HAL_DRIVER_LATEST_VERSION

endif
```

## peripherals/hal-sdk/stm32/stm32l4xx_hal_driver/Kconfig
```kconfig
# Kconfig file for package stm32l4xx_hal_driver
menuconfig PKG_USING_STM32L4XX_HAL_DRIVER
    bool "STM32 L4 HAL driver package"
    default n

if PKG_USING_STM32L4XX_HAL_DRIVER

    config PKG_STM32L4XX_HAL_DRIVER_PATH
        string
        default "/packages/peripherals/hal-sdk/stm32/stm32l4xx_hal_driver"

    choice
        prompt "Version"
        help
            Select the package version

        config PKG_USING_STM32L4XX_HAL_DRIVER_LATEST_VERSION
            bool "latest"
    endchoice

    config PKG_STM32L4XX_HAL_DRIVER_VER
       string
       default "latest"    if PKG_USING_STM32L4XX_HAL_DRIVER_LATEST_VERSION

endif
```

## peripherals/hal-sdk/stm32/stm32u5_hal_driver/Kconfig
```kconfig
# Kconfig file for package stm32u5_hal_driver
menuconfig PKG_USING_STM32U5_HAL_DRIVER
    bool "STM32 U5 HAL driver package"
    select PKG_USING_STM32U5_CMSIS_DRIVER
    default n

if PKG_USING_STM32U5_HAL_DRIVER

    config PKG_STM32U5_HAL_DRIVER_PATH
        string
        default "/packages/peripherals/hal-sdk/stm32/stm32u5_hal_driver"

    choice
        prompt "Version"
        help
            Select the package version

        config PKG_USING_STM32U5_HAL_DRIVER_LATEST_VERSION
            bool "latest"
    endchoice

    config PKG_STM32U5_HAL_DRIVER_VER
       string
       default "latest"    if PKG_USING_STM32U5_HAL_DRIVER_LATEST_VERSION

endif
```

## peripherals/hal-sdk/stm32/stm32wb55_sdk/Kconfig
```kconfig
# Kconfig file for package stm32wb55_sdk
menuconfig PKG_USING_STM32WB55_SDK
    bool "stm32wb55_sdk: a stm32wb55_sdk(only ble stack now) package for rt-thread."
    select RT_USING_RTC
    select BSP_USING_ON_CHIP_FLASH
    default n
    help
        this sdk fork from STM32Cube_FW_WB. You can add more routine support based on this.

if PKG_USING_STM32WB55_SDK

    config PKG_STM32WB55_SDK_PATH
        string
        default "/packages/peripherals/hal-sdk/stm32/stm32wb55_sdk"

    choice
        prompt "ble sample"
        default STM32WB55_BLE_IBEACON

        config STM32WB55_BLE_IBEACON
        bool "stm32wb55_ble_iBeacon"

        config STM32WB55_BLE_HRS
        bool "stm32wb55_ble_hrs"

    endchoice

    choice
        prompt "Version"
        default PKG_USING_STM32WB55_SDK_LATEST_VERSION
        help
            Select the package version

        config PKG_USING_STM32WB55_SDK_V1100
            bool "v1.10.0"

        config PKG_USING_STM32WB55_SDK_LATEST_VERSION
            bool "latest"
    endchoice

    config PKG_STM32WB55_SDK_VER
       string
       default "latest"    if PKG_USING_STM32WB55_SDK_LATEST_VERSION
       default "v1.10.0"   if PKG_USING_STM32WB55_SDK_V1100

endif
```

## peripherals/hal-sdk/stm32/stm32wb_cmsis_driver/Kconfig
```kconfig
# Kconfig file for package stm32wb_cmsis_driver
menuconfig PKG_USING_STM32WB_CMSIS_DRIVER
    bool "STM32 WB CMSIS driver package"
    select PKG_USING_CMSIS_CORE
    default n

if PKG_USING_STM32WB_CMSIS_DRIVER

    config PKG_STM32WB_CMSIS_DRIVER_PATH
        string
        default "/packages/peripherals/hal-sdk/stm32/stm32wb_cmsis_driver"

    choice
        prompt "Version"
        help
            Select the package version

        config PKG_USING_STM32WB_CMSIS_DRIVER_LATEST_VERSION
            bool "latest"
    endchoice

    config PKG_STM32WB_CMSIS_DRIVER_VER
       string
       default "latest"    if PKG_USING_STM32WB_CMSIS_DRIVER_LATEST_VERSION

endif
```

## peripherals/hal-sdk/stm32/stm32wb_hal_driver/Kconfig
```kconfig
# Kconfig file for package stm32wb_hal_driver
menuconfig PKG_USING_STM32WB_HAL_DRIVER
    bool "STM32 WB HAL driver package"
    select PKG_USING_STM32WB_CMSIS_DRIVER
    default n

if PKG_USING_STM32WB_HAL_DRIVER

    config PKG_STM32WB_HAL_DRIVER_PATH
        string
        default "/packages/peripherals/hal-sdk/stm32/stm32wb_hal_driver"

    choice
        prompt "Version"
        help
            Select the package version

        config PKG_USING_STM32WB_HAL_DRIVER_LATEST_VERSION
            bool "latest"
    endchoice

    config PKG_STM32WB_HAL_DRIVER_VER
       string
       default "latest"    if PKG_USING_STM32WB_HAL_DRIVER_LATEST_VERSION

endif
```

## peripherals/hal-sdk/stm32/stm32wl_hal_driver/Kconfig
```kconfig
# Kconfig file for package stm32wl_hal_driver
menuconfig PKG_USING_STM32WL_HAL_DRIVER
    bool "STM32 WL HAL driver package"
    select PKG_USING_STM32WL_CMSIS_DRIVER
    default n

if PKG_USING_STM32WL_HAL_DRIVER

    config PKG_STM32WL_HAL_DRIVER_PATH
        string
        default "/packages/peripherals/hal-sdk/stm32/stm32wl_hal_driver"

    choice
        prompt "Version"
        help
            Select the package version

        config PKG_USING_STM32WL_HAL_DRIVER_LATEST_VERSION
            bool "latest"
    endchoice

    config PKG_STM32WL_HAL_DRIVER_VER
       string
       default "latest"    if PKG_USING_STM32WL_HAL_DRIVER_LATEST_VERSION

endif
```

## peripherals/hal-sdk/wch/Kconfig
```kconfig
menu "WCH HAL & SDK Drivers"

source "$PKGS_DIR/packages/peripherals/hal-sdk/wch/ch32v20x_sdk/Kconfig"
source "$PKGS_DIR/packages/peripherals/hal-sdk/wch/ch32v307_sdk/Kconfig"

endmenu
```

## peripherals/hal-sdk/wch/ch32v20x_sdk/Kconfig
```kconfig
# Kconfig file for package ch32v20x_sdk
menuconfig PKG_USING_CH32V20x_SDK
    bool "CH32V20x SDK"
    default n

if PKG_USING_CH32V20x_SDK

    config PKG_CH32V20x_SDK_PATH
        string
        default "/packages/peripherals/hal-sdk/wch/ch32v20x_sdk"

    choice
        prompt "Version"
        help
            Select the package version

        config PKG_USING_CH32V20x_SDK_V202
            bool "v2.2"

        config PKG_USING_CH32V20x_SDK_LATEST_VERSION
            bool "latest"
    endchoice

    config PKG_CH32V20x_SDK_VER
        string
        default "v2.2"      if PKG_USING_CH32V20x_SDK_V202
        default "latest"    if PKG_USING_CH32V20x_SDK_LATEST_VERSION

endif
```

## peripherals/hal-sdk/wch/ch32v307_sdk/Kconfig
```kconfig
# Kconfig file for package ch32v307_sdk
menuconfig PKG_USING_CH32V307_SDK
    bool "CH32V307 SDK"
    default n

if PKG_USING_CH32V307_SDK

    config PKG_CH32V307_SDK_PATH
        string
        default "/packages/peripherals/hal-sdk/wch/ch32v307_sdk"

    choice
        prompt "Version"
        help
            Select the package version

        config PKG_USING_CH32V307_SDK_V207
            bool "v2.7"

        config PKG_USING_CH32V307_SDK_LATEST_VERSION
            bool "latest"
    endchoice

    config PKG_CH32V307_SDK_VER
        string
        default "v2.7"      if PKG_USING_CH32V307_SDK_V207
        default "latest"    if PKG_USING_CH32V307_SDK_LATEST_VERSION

endif
```

## peripherals/i2c_tools/Kconfig
```kconfig
# Kconfig file for package I2C_TOOLS
menuconfig PKG_USING_I2C_TOOLS
    bool "i2c-tools: a collection of i2c tools including scan/read/write"
    select RT_USING_PIN
    select RT_USING_I2C
    select RT_USING_I2C_BITOPS
    default n

if PKG_USING_I2C_TOOLS

    config PKG_I2C_TOOLS_PATH
        string
        default "/packages/peripherals/i2c_tools"

    config I2C_TOOLS_USE_SW_I2C
        bool "Use sofware I2C"
        help
            Use software i2c instead of hardware
        default n

    if I2C_TOOLS_USE_SW_I2C
        config I2C_TOOLS_SW_ACK_TIMEOUT
        int "Software I2C ACK timeout in microseconds"
        default "100"
    endif

    choice
        prompt "Version"
        default PKG_USING_I2C_TOOLS_LATEST_VERSION
        help
            Select the package version
        config PKG_USING_I2C_TOOLS_V100
            bool "v1.0.0"
        config PKG_USING_I2C_TOOLS_LATEST_VERSION
            bool "latest"
    endchoice

    config PKG_I2C_TOOLS_VER
       string
       default "v1.0.0"    if PKG_USING_I2C_TOOLS_V100
       default "latest"    if PKG_USING_I2C_TOOLS_LATEST_VERSION

endif
```

## peripherals/ic74hc165/Kconfig
```kconfig
menuconfig PKG_USING_IC74HC165
    bool "ic74hc165: 74HC165 GPIO/SPI 驱动"
    depends on RT_USING_COMPONENTS_INIT
    help
      使用 GPIO 或 SPI 模式读取 74HC165 输入数据的驱动软件包

if PKG_USING_IC74HC165

choice
    prompt "通信模式选择"
    default PKG_IC74HC165_MODE_GPIO
    help
      选择使用 GPIO 模拟方式 或 SPI 外设方式驱动 74165

config PKG_IC74HC165_MODE_GPIO
    bool "GPIO 模拟模式"

config PKG_IC74HC165_MODE_SPI
    bool "SPI 硬件模式"
endchoice

config PKG_IC74HC165_SAMPLE
    bool "启用示例代码(sample/sample.c)"
    default y

config IC74HC165_NODE_COUNT
    int "节点数量(74HC165 串联芯片数)"
    default 1

config PKG_IC74HC165_USE_CLKINH
    bool "启用 CLK_INH(CE)引脚控制功能"
    default y

# SPI 专属配置
if PKG_IC74HC165_MODE_SPI

config PKG_IC74HC165_SPI_BUS_NAME
    string "SPI 总线名称"
    default "spi1"
    help
      SPI 总线名,例如 spi1、spi2,必须在系统中存在

config PKG_IC74HC165_SPI_DEV_NAME
    string "SPI 设备名称"
    default "spi10"
    help
      SPI 设备逻辑名称,推荐使用 spi1x 结构

endif  # PKG_IC74HC165_MODE_SPI

choice
    prompt "版本选择"
    help
        选择使用的 ic74hc165 软件包版本

    config PKG_USING_IC74HC165_LATEST
        bool "latest version (main branch)"
endchoice

config PKG_IC74HC165_VER
    string
    default "latest" if PKG_USING_IC74HC165_LATEST

config PKG_IC74HC165_PATH
    string
    default "/packages/peripherals/ic74hc165"

endif  # PKG_USING_IC74HC165
```

## peripherals/ikun-485/Kconfig
```kconfig
menuconfig PKG_USING_IK485
    bool "ikun-485: A rs485 driver based on char device."
    select RT_USING_SERIAL
    select RT_USING_PIN
    default n

if PKG_USING_IK485

    config PKG_IK485_PATH
        string
        default "/packages/peripherals/ikun-485"

    choice
        prompt "Version"
        default PKG_USING_IK485_LATEST_VERSION
        help
            Select the package version

        config PKG_USING_IK485_LATEST_VERSION
            bool "latest"
    endchoice

    config PKG_IK485_VER
       string
       default "latest" if PKG_USING_IK485_LATEST_VERSION

endif
```
