## arduino/sensors/Seeed-VL53L0X/Kconfig
```kconfig
# Kconfig file for package Seeed-VL53L0X
menuconfig PKG_USING_ARDUINO_SEEED_VL53L0X
    bool "Seeed VL53L0X: Time-of-Flight ranging and gesture detection sensor"
    select PKG_USING_RTDUINO
    select RTDUINO_USING_WIRE
    default n

if PKG_USING_ARDUINO_SEEED_VL53L0X

    config PKG_ARDUINO_SEEED_VL53L0X_PATH
        string
        default "/packages/arduino/sensors/Seeed-VL53L0X"

    choice
        prompt "Version"
        default PKG_USING_ARDUINO_SEEED_VL53L0X_LATEST_VERSION
        help
            Select the package version

        config PKG_USING_ARDUINO_SEEED_VL53L0X_LATEST_VERSION
            bool "latest"
    endchoice

    config PKG_ARDUINO_SEEED_VL53L0X_VER
       string
       default "latest"    if PKG_USING_ARDUINO_SEEED_VL53L0X_LATEST_VERSION

endif
```

## arduino/sensors/Seeed_LIS3DHTR/Kconfig
```kconfig
# Kconfig file for package Seeed_LIS3DHTR
menuconfig PKG_USING_ARDUINO_SEEED_LIS3DHTR
    bool "Seeed_LIS3DHTR: 3-Axis Digital Accelerometer ±2g to 16g Power"
    select PKG_USING_RTDUINO
    default n

if PKG_USING_ARDUINO_SEEED_LIS3DHTR

    config PKG_ARDUINO_SEEED_LIS3DHTR_PATH
        string
        default "/packages/arduino/sensors/Seeed_LIS3DHTR"

    choice
        prompt "Version"
        default PKG_USING_ARDUINO_SEEED_LIS3DHTR_LATEST_VERSION
        help
            Select the package version

        config PKG_USING_ARDUINO_SEEED_LIS3DHTR_LATEST_VERSION
            bool "latest"
    endchoice

    config PKG_ARDUINO_SEEED_LIS3DHTR_VER
       string
       default "latest"    if PKG_USING_ARDUINO_SEEED_LIS3DHTR_LATEST_VERSION

endif
```

## arduino/sensors/sensor-device-drivers/Kconfig
```kconfig
# Kconfig file for package sensor-device-drivers
menuconfig PKG_USING_ARDUINO_SENSOR_DEVICE_DRIVERS
    bool "Enable Arduino Sensor Libraries on RT-Thread Sensor Device Framework"
    select RT_USING_SENSOR
    select RT_USING_SENSOR_V2
    select PKG_USING_RTDUINO
    default n

if PKG_USING_ARDUINO_SENSOR_DEVICE_DRIVERS

    config PKG_ARDUINO_SENSOR_DEVICE_DRIVERS_PATH
        string
        default "/packages/arduino/sensors/sensor-device-drivers"

    choice
        prompt "Version"
        default PKG_USING_ARDUINO_SENSOR_DEVICE_DRIVERS_LATEST_VERSION
        help
            Select the package version

        config PKG_USING_ARDUINO_SENSOR_DEVICE_DRIVERS_LATEST_VERSION
            bool "latest"
    endchoice

    config PKG_ARDUINO_SENSOR_DEVICE_DRIVERS_VER
       string
       default "latest"    if PKG_USING_ARDUINO_SENSOR_DEVICE_DRIVERS_LATEST_VERSION

endif
```

## arduino/signalio/Adafruit-ADS1X15/Kconfig
```kconfig
# Kconfig file for package Adafruit-ADS1X15
menuconfig PKG_USING_ARDUINO_ADAFRUIT_ADS1X15
    bool "Adafruit ADS1015/1115: 12/16-bit Differential or Single-Ended ADCs with PGA and Comparator"
    select PKG_USING_RTDUINO
    select RTDUINO_USING_WIRE
    select PKG_USING_ARDUINO_ADAFRUIT_BUSIO
    default n

if PKG_USING_ARDUINO_ADAFRUIT_ADS1X15

    config PKG_ARDUINO_ADAFRUIT_ADS1X15_PATH
        string
        default "/packages/arduino/signalio/Adafruit-ADS1X15"

    choice
        prompt "Version"
        default PKG_USING_ARDUINO_ADAFRUIT_ADS1X15_LATEST_VERSION
        help
            Select the package version

        config PKG_USING_ARDUINO_ADAFRUIT_ADS1X15_LATEST_VERSION
            bool "latest"
    endchoice

    config PKG_ARDUINO_ADAFRUIT_ADS1X15_VER
       string
       default "latest"    if PKG_USING_ARDUINO_ADAFRUIT_ADS1X15_LATEST_VERSION

endif
```

## arduino/signalio/Adafruit-AW9523/Kconfig
```kconfig
# Kconfig file for package Adafruit-AW9523
menuconfig PKG_USING_ARDUINO_ADAFRUIT_AW9523
    bool "Adafruit AW9523: GPIO Expander and LED driver"
    select PKG_USING_RTDUINO
    select RTDUINO_USING_WIRE
    select PKG_USING_ARDUINO_ADAFRUIT_BUSIO
    default n

if PKG_USING_ARDUINO_ADAFRUIT_AW9523

    config PKG_ARDUINO_ADAFRUIT_AW9523_PATH
        string
        default "/packages/arduino/signalio/Adafruit-AW9523"

    choice
        prompt "Version"
        default PKG_USING_ARDUINO_ADAFRUIT_AW9523_LATEST_VERSION
        help
            Select the package version

        config PKG_USING_ARDUINO_ADAFRUIT_AW9523_LATEST_VERSION
            bool "latest"
    endchoice

    config PKG_ARDUINO_ADAFRUIT_AW9523_VER
       string
       default "latest"    if PKG_USING_ARDUINO_ADAFRUIT_AW9523_LATEST_VERSION

endif
```

## arduino/signalio/Adafruit-BD3491FS/Kconfig
```kconfig
# Kconfig file for package Adafruit-BD3491FS
menuconfig PKG_USING_ARDUINO_ADAFRUIT_BD3491FS
    bool "Adafruit BD3491FS: Sound Processor driver"
    select PKG_USING_RTDUINO
    select RTDUINO_USING_WIRE
    select PKG_USING_ARDUINO_ADAFRUIT_BUSIO
    default n

if PKG_USING_ARDUINO_ADAFRUIT_BD3491FS

    config PKG_ARDUINO_ADAFRUIT_BD3491FS_PATH
        string
        default "/packages/arduino/signalio/Adafruit-BD3491FS"

    choice
        prompt "Version"
        default PKG_USING_ARDUINO_ADAFRUIT_BD3491FS_LATEST_VERSION
        help
            Select the package version

        config PKG_USING_ARDUINO_ADAFRUIT_BD3491FS_LATEST_VERSION
            bool "latest"
    endchoice

    config PKG_ARDUINO_ADAFRUIT_BD3491FS_VER
       string
       default "latest"    if PKG_USING_ARDUINO_ADAFRUIT_BD3491FS_LATEST_VERSION

endif
```
