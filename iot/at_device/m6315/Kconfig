## iot/at_device/m6315/Kconfig
```kconfig
# M6315 AT device configuration
menuconfig AT_DEVICE_USING_M6315
    bool "ChinaMobile M6315"
    default n

if AT_DEVICE_USING_M6315

    config AT_DEVICE_M6315_INIT_ASYN
        bool "Enable initialize by thread"
        default n

    config AT_DEVICE_M6315_SAMPLE
        bool "Enable sample"
        default y

    if AT_DEVICE_M6315_SAMPLE

       config M6315_SAMPLE_POWER_PIN
            int "Power pin"
            default -1

        config M6315_SAMPLE_STATUS_PIN
            int "Power status pin"
            default -1

        config M6315_SAMPLE_CLIENT_NAME
            string "AT client device name"
            default "uart2"

        config M6315_SAMPLE_RECV_BUFF_LEN
            int "The maximum length of receive line buffer"
            default 512

    endif

endif
```

## iot/at_device/me3616/Kconfig
```kconfig
# ME3616 AT device configuration
menuconfig AT_DEVICE_USING_ME3616
    bool "Gosuncn ME3616"
    default n

if AT_DEVICE_USING_ME3616

    config AT_DEVICE_ME3616_INIT_ASYN
        bool "Enable initialize by thread"
        default n

    config AT_DEVICE_ME3616_SAMPLE
        bool "Enable sample"
        default y

    if AT_DEVICE_ME3616_SAMPLE

        config ME3616_SAMPLE_POWER_PIN
            int "Power pin"
            default -1

        config ME3616_SAMPLE_STATUS_PIN
            int "Power status pin"
            default -1

        config ME3616_SAMPLE_CLIENT_NAME
            string "AT client device name"
            default "uart2"

        config ME3616_SAMPLE_RECV_BUFF_LEN
            int "The maximum length of receive line buffer"
            default 512

    endif

endif
```

## iot/at_device/ml305/Kconfig
```kconfig
# ML305 AT device configuration
menuconfig AT_DEVICE_USING_ML305
    bool "Gosuncn ML305"
    default n

if AT_DEVICE_USING_ML305

    config AT_DEVICE_ML305_INIT_ASYN
        bool "Enable initialize by thread"
        default n

    config AT_DEVICE_ML305_SOCKET
        bool "Enable ML305 at socket"
        select AT_USING_SOCKET
        default y

    config AT_DEVICE_ML305_SAMPLE
        bool "Enable sample"
        default y

    if AT_DEVICE_ML305_SAMPLE

        config ML305_SAMPLE_POWER_PIN
            int "Power pin"
            default -1

        config ML305_SAMPLE_STATUS_PIN
            int "Power status pin"
            default -1

        config ML305_SAMPLE_CLIENT_NAME
            string "AT client device name"
            default "uart2"

        config ML305_SAMPLE_RECV_BUFF_LEN
            int "The maximum length of receive line buffer"
            default 2048

    endif

endif
```

## iot/at_device/ml307/Kconfig
```kconfig
# ML307 AT device configuration
menuconfig AT_DEVICE_USING_ML307
    bool "Gosuncn ML307"
    default n

if AT_DEVICE_USING_ML307

    config AT_DEVICE_ML307_INIT_ASYN
        bool "Enable initialize by thread"
        default n

    config AT_DEVICE_ML307_SOCKET
        bool "Enable ML307 at socket"
        select AT_USING_SOCKET
        default y

    config AT_DEVICE_ML307_SAMPLE
        bool "Enable sample"
        default y

    if AT_DEVICE_ML307_SAMPLE

        config ML307_SAMPLE_POWER_PIN
            int "Power pin"
            default -1

        config ML307_SAMPLE_STATUS_PIN
            int "Power status pin"
            default -1

        config ML307_SAMPLE_CLIENT_NAME
            string "AT client device name"
            default "uart2"

        config ML307_SAMPLE_RECV_BUFF_LEN
            int "The maximum length of receive line buffer"
            default 2048

    endif

endif
```

## iot/at_device/n58/Kconfig
```kconfig
# N58 AT device configuration
menuconfig AT_DEVICE_USING_N58
    bool "Neoway N58"
    default n

if AT_DEVICE_USING_N58

    config AT_DEVICE_N58_INIT_ASYN
        bool "Enable initialize by thread"
        default n

    config AT_DEVICE_N58_SOCKET
        bool "Enable N58 at socket"
        select AT_USING_SOCKET
        default y

    config AT_DEVICE_N58_SAMPLE
        bool "Enable sample"
        default y

    if AT_DEVICE_N58_SAMPLE

       config N58_SAMPLE_POWER_PIN
            int "Power pin"
            default -1

        config N58_SAMPLE_STATUS_PIN
            int "Power status pin"
            default -1

        config N58_SAMPLE_CLIENT_NAME
            string "AT client device name"
            default "uart3"

        config N58_SAMPLE_RECV_BUFF_LEN
            int "The maximum length of receive line buffer"
            default 512

    endif

endif
```

## iot/at_device/n720/Kconfig
```kconfig
# N720 AT device configuration
menuconfig AT_DEVICE_USING_N720
    bool "Neoway N720"
    default n

if AT_DEVICE_USING_N720

    config AT_DEVICE_N720_INIT_ASYN
        bool "Enable initialize by thread"
        default n

    config AT_DEVICE_N720_SAMPLE
        bool "Enable sample"
        default y

    if AT_DEVICE_N720_SAMPLE

        config N720_SAMPLE_POWER_PIN
            int "Power pin"
            default -1

        config N720_SAMPLE_STATUS_PIN
            int "Power status pin"
            default -1

        config N720_SAMPLE_WAKEUP_PIN
            int "Wakeup pin"
            default -1
            
        config N720_SAMPLE_CLIENT_NAME
            string "AT client device name"
            default "uart2"

        config N720_SAMPLE_RECV_BUFF_LEN
            int "The maximum length of receive line buffer"
            default 512

    endif

endif
```

## iot/at_device/rw007/Kconfig
```kconfig
# RW007 AT device configuration
menuconfig AT_DEVICE_USING_RW007
    bool "Realthread RW007"
    default n

if AT_DEVICE_USING_RW007

    config AT_DEVICE_RW007_INIT_ASYN
        bool "Enable initialize by thread"
        default n

    config AT_DEVICE_RW007_SAMPLE
        bool "Enable sample"
        default y

    if AT_DEVICE_RW007_SAMPLE

        config RW007_SAMPLE_WIFI_SSID
            string "WIFI ssid"
            default "rtthread"

        config RW007_SAMPLE_WIFI_PASSWORD
            string "WIFI password"
            default "12345678"

        config RW007_SAMPLE_CLIENT_NAME
            string "AT client device name"
            default "uart2"

        config RW007_SAMPLE_RECV_BUFF_LEN
            int "The maximum length of receive line buffer"
            default 512

    endif

endif
```

## iot/at_device/sim800c/Kconfig
```kconfig
# SIM800C AT device configuration
menuconfig AT_DEVICE_USING_SIM800C
    bool "SIMCom SIM800C"
    default n

if AT_DEVICE_USING_SIM800C

    config AT_DEVICE_SIM800C_INIT_ASYN
        bool "Enable initialize by thread"
        default n

    config AT_DEVICE_SIM800C_SAMPLE
        bool "Enable sample"
        default y

    if AT_DEVICE_SIM800C_SAMPLE

       config SIM800C_SAMPLE_POWER_PIN
            int "Power pin"
            default -1

        config SIM800C_SAMPLE_STATUS_PIN
            int "Power status pin"
            default -1

        config SIM800C_SAMPLE_CLIENT_NAME
            string "AT client device name"
            default "uart2"

        config SIM800C_SAMPLE_RECV_BUFF_LEN
            int "The maximum length of receive line buffer"
            default 512

    endif

endif
```

## iot/at_device/usrk7/Kconfig
```kconfig
# USRK7 AT device configuration
menuconfig AT_DEVICE_USING_USRK7
    bool "USR IOT USRK7"
    default n
    depends on AT_CLIENT_PASS_THROUGH
    help
        Since USR-K7 only has pass-through transmission mode， this driver
        depends on the AT Pass-Through support(AT_CLIENT_PASS_THROUGH).
        Because of pass-through, we need to switch the mode between command mode
        and transmission mode, so it currently can not work well with
        SAL(Socket abstraction layer), it will be fixed later. But for now, if
        you wanna use this driver, please reference sample program
        (at_sample_usrk7), and try "usrk7_io" and "usrk7_socket_setup" command.

if AT_DEVICE_USING_USRK7

    config AT_DEVICE_USRK7_INIT_ASYN
        bool "Enable initialize by thread"
        default n

    config AT_DEVICE_USRK7_SAMPLE
        bool "Enable sample"
        default y

    if AT_DEVICE_USRK7_SAMPLE

        config USRK7_SAMPLE_CLIENT_NAME
            string "AT client device name"
            default "uart1"

        config USRK7_SAMPLE_RECV_BUFF_LEN
            int "The maximum length of receive line buffer"
            default 512

    endif

endif
```

## iot/at_device/v1.x.x/Kconfig
```kconfig
# AT device configuretion for V1.X.X
config PKG_AT_INIT_BY_THREAD
    bool "Enable at device init by thread"
    default n

choice
    prompt "AT socket device modules"
    default AT_DEVICE_NOT_SELECTED

    config AT_DEVICE_M26
        bool "Quectel M26/MC20"

    config AT_DEVICE_EC20
        bool "Quectel EC20"

    config AT_DEVICE_ESP8266
        bool "Espressif ESP8266"
if PKG_AT_DEVICE_VER_NUM > 0x10400
    config AT_DEVICE_RW007
        bool "Realthread RW007"

    config AT_DEVICE_SIM800C
        bool "SIMCom SIM800C"

    config AT_DEVICE_SIM76XX
        bool "SIMCom SIM76XX"
endif
    config AT_DEVICE_NOT_SELECTED
        bool "Not selected, please select"
endchoice

config AT_DEVICE_SOCKETS_NUM
    int
    default 6 if AT_DEVICE_M26
    default 12 if AT_DEVICE_EC20
    default 5 if AT_DEVICE_ESP8266
    default 5 if AT_DEVICE_RW007
    default 6 if AT_DEVICE_SIM800C
    default 10 if AT_DEVICE_SIM76XX
    default 0

if AT_DEVICE_ESP8266 || AT_DEVICE_M26 || AT_DEVICE_EC20 || AT_DEVICE_RW007 || AT_DEVICE_SIM800C || AT_DEVICE_SIM76XX

        config AT_DEVICE_NAME
            string "AT client device name"
            default "uart2"

        config AT_DEVICE_RECV_BUFF_LEN
            int "The maximum length of client data accepted"
            default 512

endif

if AT_DEVICE_ESP8266

    config AT_DEVICE_WIFI_SSID
        string "esp8266 wifi ssid"
        default "rtthread"

    config AT_DEVICE_WIFI_PASSWORD
        string "esp8266 wifi password"
        default "12345678"

endif

if AT_DEVICE_RW007

    config AT_DEVICE_WIFI_SSID
        string "rw007 wifi ssid"
        default "rtthread"

    config AT_DEVICE_WIFI_PASSWORD
        string "rw007 wifi password"
        default "12345678"

endif

if AT_DEVICE_SIM800C

    config AT_DEVICE_POWER_PIN
        int "sim800c power pin"
        default 29

    config AT_DEVICE_STATUS_PIN
        int "sim800c status pin"
        default 28

endif

if AT_DEVICE_SIM76XX

    config AT_DEVICE_POWER_PIN
        int "sim76xx power pin"
        default 35

    config AT_DEVICE_STATUS_PIN
        int "sim76xx status pin"
        default 40

endif
```

## iot/at_device/w60x/Kconfig
```kconfig
# W60X AT device configuration
menuconfig AT_DEVICE_USING_W60X
    bool "WinnerMicro W60X"
    default n

if AT_DEVICE_USING_W60X

    config AT_DEVICE_W60X_INIT_ASYN
        bool "Enable initialize by thread"
        default n

    config AT_DEVICE_W60X_SAMPLE
        bool "Enable sample"
        default y

    if AT_DEVICE_W60X_SAMPLE

        config W60X_SAMPLE_WIFI_SSID
            string "WIFI ssid"
            default "rtthread"

        config W60X_SAMPLE_WIFI_PASSWORD
            string "WIFI password"
            default "12345678"

        config W60X_SAMPLE_CLIENT_NAME
            string "AT client device name"
            default "uart1"

        config W60X_SAMPLE_RECV_BUFF_LEN
            int "The maximum length of receive line buffer"
            default 512

    endif

endif
```

## iot/at_server/Kconfig
```kconfig
menuconfig PKG_USING_AT_SERVER
    bool "at_server: AT server with AT commands in common use."
    default n
	select RT_USING_AT
	select AT_USING_SERVER
	select RT_USING_SAL

if PKG_USING_AT_SERVER

    config PKG_AT_SERVER_PATH
        string
        default "/packages/iot/at_server"

    config AT_SERVER_DEVICE
        string "Server device name"

	config AT_SERVER_ENABLE_BASE
        bool
        prompt "Enable base AT command"
        default n
		select AT_SERVER_ENABLE_CMD_AT
		select AT_SERVER_ENABLE_CMD_ATZ
		select AT_SERVER_ENABLE_CMD_RST
		select AT_SERVER_ENABLE_CMD_ATE
		select AT_SERVER_ENABLE_CMD_ATL
		select AT_SERVER_ENABLE_CMD_UART

    config AT_SERVER_ENABLE_CMD_AT
        bool
        prompt "AT: AT test"
        default y
        depends on AT_SERVER_ENABLE_BASE
		
	config AT_SERVER_ENABLE_CMD_ATZ
        bool
        prompt "ATZ: recover to factory setting"
        default y
        depends on AT_SERVER_ENABLE_BASE
		
	config AT_SERVER_ENABLE_CMD_RST
        bool
        prompt "AT+RST: reboot"
        default y
        depends on AT_SERVER_ENABLE_BASE		

	config AT_SERVER_ENABLE_CMD_ATE
        bool
        prompt "ATE: enable/disable echo"
        default y
        depends on AT_SERVER_ENABLE_BASE

	config AT_SERVER_ENABLE_CMD_ATL
        bool
        prompt "AT&L: list all command"
        default y
        depends on AT_SERVER_ENABLE_BASE		

	config AT_SERVER_ENABLE_CMD_UART
        bool
        prompt "AT+UART: UART configuration"
        default y
        depends on AT_SERVER_ENABLE_BASE		

	config AT_SERVER_ENABLE_CMD_GMR
        bool
        prompt "AT+GMR: show the version of AT"
        default n
        depends on AT_SERVER_ENABLE_BASE

	config AT_SERVER_ENABLE_CMD_SYSRAM
        bool
        prompt "AT+SYSRAM: list free memery"
        default n
        depends on AT_SERVER_ENABLE_BASE		

	config AT_SERVER_ENABLE_OTA
        bool
        prompt "Enable OTA AT command"
        default n

	config AT_SERVER_ENABLE_CMD_OTA
        bool
        prompt "AT+OTA: update firmware use OTA"
        default y
        depends on AT_SERVER_ENABLE_OTA		

	config AT_SERVER_ENABLE_WLAN
        bool
        prompt "Enable WLAN AT command"
        default n

	config AT_SERVER_ENABLE_CMD_CWMODE
        bool
        prompt "AT+CWMODE: mode select"
        default y
        depends on AT_SERVER_ENABLE_WLAN			
		
	config AT_SERVER_ENABLE_CMD_CWLAP
        bool
        prompt "AT+CWLAP: scan and list AP"
        default y
        depends on AT_SERVER_ENABLE_WLAN			
		
	config AT_SERVER_ENABLE_CMD_CWJAP
        bool
        prompt "AT+CWJAP: connect to AP"
        default y
        depends on AT_SERVER_ENABLE_WLAN			
		
	config AT_SERVER_ENABLE_CMD_CWQAP
        bool
        prompt "AT+CWQAP: disconnect from AP"
        default y
        depends on AT_SERVER_ENABLE_WLAN	

	config AT_SERVER_ENABLE_TCPIP
        bool
        prompt "Enable TCP/IP AT command"
        default n
		
	config AT_SERVER_ENABLE_CMD_CIPSTATUS
        bool
        prompt "AT+CIPSTATUS: show network status"
        default y
        depends on AT_SERVER_ENABLE_TCPIP	
		
	config AT_SERVER_ENABLE_CMD_CIPMUX
        bool
        prompt "AT+CIPMUX: connect mode setting"
        default y
        depends on AT_SERVER_ENABLE_TCPIP	
		
	config AT_SERVER_ENABLE_CMD_PING
        bool
        prompt "AT+PING: PING"
        default y
        depends on AT_SERVER_ENABLE_TCPIP	
		
	config AT_SERVER_ENABLE_CMD_CIPDOMAIN
        bool
        prompt "AT+CIPDOMAIN: DNS resolution"
        default y
        depends on AT_SERVER_ENABLE_TCPIP	
		
	config AT_SERVER_ENABLE_CMD_CIPSTART
        bool
        prompt "AT+CIPSTART: establish TCP/UDP connection"
        default y
        depends on AT_SERVER_ENABLE_TCPIP	
		
	config AT_SERVER_ENABLE_CMD_CIPCLOSE
        bool
        prompt "AT+CIPCLOSE: close connection"
        default y
        depends on AT_SERVER_ENABLE_TCPIP	
		
	config AT_SERVER_ENABLE_CMD_CIPSEND
        bool
        prompt "AT+CIPSEND: send data to network"
        default y
        depends on AT_SERVER_ENABLE_TCPIP

    choice
        prompt "Version"
        help
            Select the cJSON version

        config PKG_USING_AT_SERVER_V100
            bool "v1.0.0"

        config PKG_USING_AT_SERVER_LATEST_VERSION
            bool "latest"
    endchoice

    config PKG_AT_SERVER_VER
    string
    default "v1.0.0" if PKG_USING_AT_SERVER_V100
    default "latest" if PKG_USING_AT_SERVER_LATEST_VERSION

endif
```
