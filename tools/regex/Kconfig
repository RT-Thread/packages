## tools/regex/Kconfig
```kconfig
# Kconfig file for package regex
menuconfig PKG_USING_REGEX
    bool "regex: A small regex implementation in C."
    default n

if PKG_USING_REGEX

    config PKG_REGEX_PATH
        string
        default "/packages/tools/regex"

    config PKG_USING_REGEX_SAMPLE
            bool "Enable regex sample"
            default n

    choice
        prompt "Version"
        default PKG_USING_REGEX_V100
        help
            Select the package version

        config PKG_USING_REGEX_V100
            bool "v1.0.0"

    endchoice

    config PKG_REGEX_VER
       string
       default "v1.0.0"    if PKG_USING_REGEX_V100

endif
```

## tools/rtt_auto_exe_cmd/Kconfig
```kconfig
# Kconfig file for package rtt_auto_exe_cmd
menuconfig PKG_USING_RTT_AUTO_EXE_CMD
    bool "RTT_AUTO_CMD: Auto exe the cmd of rtthread"
    default n

if PKG_USING_RTT_AUTO_EXE_CMD

    config PKG_RTT_AUTO_EXE_CMD_PATH
        string
        default "/packages/tools/rtt_auto_exe_cmd"

    config RTT_AUTO_CMD_THREAD_STACK_SIZE
        int "The RTT_AUTO_EXE thread stack size"
        default 20480

    config RTT_AUTO_CMD_THREAD_PRIORITY
        int "The RTT_AUTO_EXE thread priority"
        default 10

    config RTT_AUTO_INIT_TIME_MS
        int "[INIT]The RTT_AUTO_EXE thread wait init complete time"
        default 5000

    config RTT_CMD_1_STR
        string "[INIT_CMD1]The RTT_AUTO_EXE thread init cmd 1"
        default "version"
    config RTT_CMD_1_DELAY
        int "MS:The RTT_AUTO_EXE thread init cmd 1 delay time"
        default 1000
    config RTT_CMD_2_STR
        string "[INIT_CMD2] The RTT_AUTO_EXE thread init cmd 2"
        default "ps"
    config RTT_CMD_2_DELAY
        int "MS: The RTT_AUTO_EXE thread init cmd 2 delay time"
        default 1000


    config RTT_CMD_LOOP_FLAG
        bool "The flag of RTT_AUTO_EXE loop cmd"
        default n

    if RTT_CMD_LOOP_FLAG
        config RTT_CMD_LOOP_1_STR
            string "[LOOP_CMD1]The RTT_AUTO_EXE thread loop cmd 1"
            default "ps"
        config RTT_CMD_LOOP_1_DELAY_TIME
            int "MS:The RTT_AUTO_EXE thread loop cmd 1 delay time"
            default 1000
        config RTT_CMD_LOOP_2_STR
            string "[LOOP_CMD2]The RTT_AUTO_EXE thread loop cmd 2"
            default "version"
        config RTT_CMD_LOOP_2_DELAY_TIME
            int "MS:The RTT_AUTO_EXE thread loop cmd 2 delay time"
            default 1000

        config RTT_CMD_LOOP_TIME
            int "TIME:The RTT_AUTO_EXE loop times"
            default 3
    endif
    choice
        prompt "Version"
        default PKG_USING_RTT_AUTO_EXE_CMD_LATEST_VERSION
        help
            Select the package version

        config PKG_USING_RTT_AUTO_EXE_CMD_V100
            bool "v1.0.0"

        config PKG_USING_RTT_AUTO_EXE_CMD_LATEST_VERSION
            bool "latest"
    endchoice

    config PKG_RTT_AUTO_EXE_CMD_VER
       string
       default "v1.0.0"    if PKG_USING_RTT_AUTO_EXE_CMD_V100
       default "latest"    if PKG_USING_RTT_AUTO_EXE_CMD_LATEST_VERSION

endif
```

## tools/snowflake/Kconfig
```kconfig
# Kconfig file for package snowflake
menuconfig PKG_USING_SNOWFLAKE
    bool "Snowflake algorithm is a distributed ID generation algorithm."
    select  RT_USING_RTC
    default n

if PKG_USING_SNOWFLAKE

    config PKG_SNOWFLAKE_PATH
        string
        default "/packages/tools/snowflake"


    config SNOWFLAKE_USING_SAMPLES
        bool "Enable snowflake samples"
        default n


    choice
        prompt "Version"
        default PKG_USING_SNOWFLAKE_LATEST_VERSION
        help
            Select the package version


        config PKG_USING_SNOWFLAKE_LATEST_VERSION
            bool "latest"
    endchoice

    config PKG_SNOWFLAKE_VER
       string
       default "latest"    if PKG_USING_SNOWFLAKE_LATEST_VERSION

endif
```

## tools/solar_terms/Kconfig
```kconfig
# Kconfig file for package solar_terms
menuconfig PKG_USING_SOLAR_TERMS
    bool "solar_terms: judging the relationship of 24 solar terms and date."
    default n

if PKG_USING_SOLAR_TERMS

    config PKG_SOLAR_TERMS_PATH
        string
        default "/packages/tools/solar_terms"

    config SOLAR_TERMS_USING_EXAMPLE
        bool "Enable show solar terms samples"
        default n

    choice
        prompt "Version"
        default PKG_USING_SOLAR_TERMS_LATEST_VERSION
        help
            Select the package version

        config PKG_USING_SOLAR_TERMS_V100
            bool "v1.0.0"

        config PKG_USING_SOLAR_TERMS_LATEST_VERSION
            bool "latest"
    endchoice

    config PKG_SOLAR_TERMS_VER
       string
       default "v1.0.0"    if PKG_USING_SOLAR_TERMS_V100
       default "latest"    if PKG_USING_SOLAR_TERMS_LATEST_VERSION

endif
```

## tools/sorch/Kconfig
```kconfig
# Kconfig file for package sorch
menuconfig PKG_USING_SORCH
    bool "sorch: a set of generalized algorithms, including Merge Sort and Binary Search"
    default n

if PKG_USING_SORCH
    config PKG_SORCH_PATH
        string
        default "/packages/tools/sorch"

    choice
        prompt "Version"
        default PKG_USING_SORCH_LATEST_VERSION
        help
            Select the package version

        config PKG_USING_SORCH_LATEST_VERSION
            bool "latest"

    endchoice

    config PKG_SORCH_VER
       string
       default "latest"    if PKG_USING_SORCH_LATEST_VERSION

endif
```

## tools/thread-metric/Kconfig
```kconfig
# Kconfig file for package thread-metric
menuconfig PKG_USING_THREAD_METRIC
    bool "Thread metrics adapted to RT-Thread."
    default n

if PKG_USING_THREAD_METRIC

    config PKG_THREAD_METRIC_PATH
        string
        default "/packages/tools/thread-metric"

    choice
        prompt "Version"
        help
            Select the package version

        config PKG_USING_THREAD_METRIC_V100
            bool "v1.0.0"

        config PKG_USING_THREAD_METRIC_LATEST_VERSION
            bool "latest"
    endchoice

    config PKG_THREAD_METRIC_VER
       string
       default "v1.0.0"    if PKG_USING_THREAD_METRIC_V100
       default "latest"    if PKG_USING_THREAD_METRIC_LATEST_VERSION

endif
```

## tools/uMCN/Kconfig
```kconfig
# Kconfig file for package uMCN
menuconfig PKG_USING_UMCN
    bool "uMCN is a light-weight and powerful IPC library based on the publisher/subscriber model."
    default n

if PKG_USING_UMCN

    config PKG_UMCN_PATH
        string
        default "/packages/tools/uMCN"

    choice
        prompt "Version"
        default PKG_USING_UMCN_LATEST_VERSION
        help
            Select the package version

        config PKG_USING_UMCN_LATEST_VERSION
            bool "latest"
    endchoice

    config PKG_UMCN_VER
       string
       default "latest"    if PKG_USING_UMCN_LATEST_VERSION

    config UMCN_USING_DEMO
        bool
        prompt "uMCN demo example"
        default n

    config UMCN_USING_CMD
        bool
        prompt "uMCN command"
        select PKG_USING_OPTPARSE
        select RT_USING_POSIX_DELAY
        default n

endif
```

## tools/uORB/Kconfig
```kconfig
# Kconfig file for package uORB
menuconfig PKG_USING_UORB
    bool "uORB is a light-weight and powerful IPC library based on the publisher/subscriber model."
    default n

if PKG_USING_UORB

    config PKG_UORB_PATH
        string
        default "/packages/tools/uORB"

    choice
        prompt "Version"
        default PKG_USING_UORB_LATEST_VERSION
        help
            Select the package version

        config PKG_USING_UORB_LATEST_VERSION
            bool "latest"
    endchoice

    config PKG_UORB_VER
       string
       default "latest"    if PKG_USING_UORB_LATEST_VERSION

endif
```

## tools/ulog_easyflash/Kconfig
```kconfig
# Kconfig file for package ulog_easyflash
menuconfig PKG_USING_ULOG_EASYFLASH
    bool "ulog_easyflash: The ulog flash plugin by EasyFlash."
    select RT_USNG_ULOG
    select PKG_USING_EASYFLASH
    default n

if PKG_USING_ULOG_EASYFLASH

    config PKG_ULOG_EASYFLASH_PATH
        string
        default "/packages/tools/ulog_easyflash"

    config ULOG_EASYFLASH_BACKEND_ENABLE
        bool
        prompt "Enable the flash backend for ulog"
        depends on PKG_EASYFLASH_LOG
        default y

    config ULOG_EASYFLASH_CFG_SAVE_ENABLE
        bool
        prompt "Save the ulog filter configuration to flash"
        depends on ULOG_USING_FILTER
        default y

    choice
        prompt "Version"
        default PKG_USING_ULOG_EASYFLASH_LATEST_VERSION
        help
            Select the package version

        config PKG_USING_ULOG_EASYFLASH_V00100
            bool "v0.1.0"

        config PKG_USING_ULOG_EASYFLASH_LATEST_VERSION
            bool "latest"
    endchoice

    config PKG_ULOG_EASYFLASH_VER
       string
       default "v0.1.0"    if PKG_USING_ULOG_EASYFLASH_V00100
       default "latest"    if PKG_USING_ULOG_EASYFLASH_LATEST_VERSION

endif
```

## tools/ulog_file/Kconfig
```kconfig
# Kconfig file for package ulog_file
menuconfig PKG_USING_ULOG_FILE
    bool "ulog_file: The ulog file backend by filesystem."
    depends on RT_VER_NUM < 0x40100
    default n
    select RT_USING_DFS
    select RT_USING_ULOG

if PKG_USING_ULOG_FILE

    config PKG_ULOG_FILE_PATH
        string
        default "/packages/tools/ulog_file"

    config ULOG_FILE_ROOT_PATH
        string "The root path of the saved file"
        default "/logs"

    config ULOG_FILE_NAME_BASE
        string "The base name of the saved file"
        default "ulog.log"

    config ULOG_FILE_MAX_NUM
        int "The maximum number of the saved file"
        default 5
        range 1 100

     config ULOG_FILE_MAX_SIZE
        int "The maximum size of a file"
        default 524288
        range 1024 104857600

    choice
        prompt "Version"
        default PKG_USING_ULOG_FILE_V100
        help
            Select the package version

        config PKG_USING_ULOG_FILE_V100
            bool "v1.0.0"

        config PKG_USING_ULOG_FILE_LATEST_VERSION
            bool "latest"
    endchoice

    config PKG_ULOG_FILE_VER
       string
       default "v1.0.0"    if PKG_USING_ULOG_FILE_V100
       default "latest"    if PKG_USING_ULOG_FILE_LATEST_VERSION

endif
```

## tools/vconsole/Kconfig
```kconfig
# Kconfig file for package vconsole
menuconfig PKG_USING_VCONSOLE
    bool "vconsole: A virtual console package."
    default n

if PKG_USING_VCONSOLE

    config PKG_VCONSOLE_PATH
        string
        default "/packages/tools/vconsole"

    choice
        prompt "Version"
        default PKG_USING_VCONSOLE_LATEST_VERSION
        help
            Select the package version

        config PKG_USING_VCONSOLE_V100
            bool "v1.0.0"

        config PKG_USING_VCONSOLE_LATEST_VERSION
            bool "latest"
    endchoice

    config PKG_VCONSOLE_VER
       string
       default "v1.0.0"    if PKG_USING_VCONSOLE_V100
       default "latest"    if PKG_USING_VCONSOLE_LATEST_VERSION

endif
```

## tools/vector/Kconfig
```kconfig
# Kconfig file for package vector
menuconfig PKG_USING_VECTOR
    bool "vector: a dynamic, type-agnostic container."
    default n

if PKG_USING_VECTOR
    config PKG_VECTOR_PATH
        string
        default "/packages/tools/vector"

    choice
        prompt "Version"
        default PKG_USING_VECTOR_LATEST_VERSION
        help
            Select the package version

        config PKG_USING_VECTOR_LATEST_VERSION
            bool "latest"

    endchoice

    config PKG_VECTOR_VER
       string
       default "latest"    if PKG_USING_VECTOR_LATEST_VERSION

endif
```

## tools/vofa_plus/Kconfig
```kconfig
# Kconfig file for package vofa_plus
menuconfig PKG_USING_VOFA_PLUS
    bool "Realize serial port waveform function with vfoa+"
    default n

if PKG_USING_VOFA_PLUS

    config PKG_VOFA_PLUS_PATH
        string
        default "/packages/tools/vofa_plus"

    choice
        prompt "Version"
        default PKG_USING_VOFA_PLUS_LATEST_VERSION
        help
            Select the package version

        config PKG_USING_VOFA_PLUS_LATEST_VERSION
            bool "latest"
    endchoice

    config PKG_VOFA_PLUS_VER
       string
       default "latest"    if PKG_USING_VOFA_PLUS_LATEST_VERSION

endif
```

## tools/wamr/Kconfig
```kconfig
# Kconfig file for package wamr
menuconfig PKG_USING_WAMR
    bool "WebAssembly Micro Runtime (WAMR)"
    select RT_USING_LIBC     if RT_VER_NUM < 0x40100
    select RT_USING_DFS      if RT_VER_NUM < 0x40100
    select RT_USING_POSIX_FS if RT_VER_NUM >= 0x40100
    default n

if PKG_USING_WAMR

    config PKG_WAMR_PATH
        string
        default "/packages/tools/wamr"

    choice
        prompt "Version"
        default PKG_USING_WAMR_LATEST_VERSION
        help
            Select the package version

        config PKG_USING_WAMR_LATEST_VERSION
            bool "latest"
    endchoice

    config WAMR_ENABLE_IWASM_PARAMS
        bool
        prompt "Enable testing parameters of iwasm"
        default n

    config WAMR_BUILD_INTERP
        bool
        prompt "Enable Interpter Mode"
        default y

    if WAMR_BUILD_INTERP

        config WAMR_BUILD_FAST_INTERP
            bool
            prompt "Enable Fast Interpter"
            default y

    endif

    config WAMR_BUILD_LIBC_BUILTIN
        bool
        prompt "Use built-libc"
        default y

    config WAMR_BUILD_AOT
        bool
        prompt "Enable AOT"
        default n

    config WAMR_ENABLE_RTT_EXPORT
        bool
        prompt "Export Native Method of RT-Thread"
        default n

    if WAMR_ENABLE_RTT_EXPORT

        config WAMR_RTT_EXPORT_VPRINTF
            bool
            prompt "Export vprintf"
            default n

        config WAMR_RTT_EXPORT_DEVICE_OPS
            bool
            prompt "Export Device Operate Method"
            default n

        if WAMR_RTT_EXPORT_DEVICE_OPS
            config WAMR_RTT_EXPORT_DEVICE_OPS_CPP
                bool
                prompt "Enable WASM Cpp Support of Device Operate Method"
                default n
        endif

    endif

    config PKG_WAMR_VER
       string
       default "latest"    if PKG_USING_WAMR_LATEST_VERSION

endif
```

## tools/zdebug/Kconfig
```kconfig
# Kconfig file for package zdebug
menuconfig PKG_USING_ZDEBUG
    bool "zdebug: print log, set variable data, execute functions."
    default n

if PKG_USING_ZDEBUG

    config PKG_ZDEBUG_PATH
        string
        default "/packages/tools/zdebug"

    config ZDEBUG_LOG
        bool
        prompt "zdebug_log"
        default y

    config ZDEBUG_VAR
        bool
        prompt "zdebug_var"
        default y

    if ZDEBUG_VAR
        config ZDEBUG_FUN
            bool
            prompt "zdebug_fun"
            default n
    endif

    choice
        prompt "Version"
        default PKG_USING_ZDEBUG_LATEST_VERSION
        help
            Select the package version

        config PKG_USING_ZDEBUG_V100
            bool "v1.0.0"

        config PKG_USING_ZDEBUG_LATEST_VERSION
            bool "latest"
    endchoice

    config PKG_ZDEBUG_VER
       string
       default "v1.0.0"    if PKG_USING_ZDEBUG_V100
       default "latest"    if PKG_USING_ZDEBUG_LATEST_VERSION

endif
```
