## misc/CanopenNode/core/Kconfig
```kconfig
# Kconfig for generic CANopenNode protocol and CO_CONFIG options.

menu "CANopenNode CO_CONFIG groups"

menu "Common flags"

config PKG_CANOPENNODE_GLOBAL_CALLBACK_PRE
    bool "Global mainline callback-pre flag"
    default n
    help
        Set CO_CONFIG_GLOBAL_FLAG_CALLBACK_PRE for mainline CANopenNode objects.
        This allows supported objects to call application-registered
        callback-pre functions after fast preprocessing. In RT-Thread this is
        normally used to wake a lower-priority mainline thread after CAN RX or
        other high-priority preprocessing found more work to do.

        Enable this when the port will register callback-pre hooks and use them
        to signal semaphores, events or other non-blocking scheduling objects.

config PKG_CANOPENNODE_GLOBAL_RT_CALLBACK_PRE
    bool "Global realtime callback-pre flag"
    default n
    help
        Set CO_CONFIG_GLOBAL_RT_FLAG_CALLBACK_PRE for realtime objects such as
        SYNC and PDO. This allows supported realtime objects to run custom
        callback-pre functions after their fast preprocessing path.

        Use this when the RT-Thread port needs SYNC/PDO preprocessing to wake a
        realtime worker, update a lightweight event flag or trigger deterministic
        application-side preprocessing. The callback body must remain short and
        must not call blocking APIs.

config PKG_CANOPENNODE_GLOBAL_TIMERNEXT
    bool "Global timerNext_us calculation flag"
    default n
    select PKG_CANOPENNODE_GLOBAL_CALLBACK_PRE
    select RT_USING_EVENT
    help
        Enable the RT-Thread event-driven CANopen mainline scheduler and set
        CO_CONFIG_GLOBAL_FLAG_TIMERNEXT. Supported process functions calculate
        the next recommended processing deadline in timerNext_us, while
        callback-pre hooks wake the mainline thread early when asynchronous CAN
        or runtime work arrives.

        The scheduler uses one per-instance RT-Thread event. Repeated wakeups
        coalesce into a single work-available indication; CANopenNode remains the
        owner of protocol state and receive buffers.

        RT_USING_EVENT and PKG_CANOPENNODE_GLOBAL_CALLBACK_PRE are selected
        automatically because timerNext-based sleeping is unsafe without an
        asynchronous wake path.

config PKG_CANOPENNODE_GLOBAL_OD_DYNAMIC
    bool "Global dynamic Object Dictionary flag"
    default y
    help
        Set CO_CONFIG_GLOBAL_FLAG_OD_DYNAMIC. Supported objects will re-read
        related OD communication parameters when those OD entries are written,
        instead of only applying them during communication reset.

        Keep this enabled for configurable demo and field devices. Disable only
        when the product forbids runtime communication-parameter changes and the
        smaller/static behavior is intentional.

config PKG_CANOPENNODE_USING_MULTIPLE_OD
    bool "Enable multiple Object Dictionary runtime config"
    default n
    help
        Define CO_MULTIPLE_OD and let the RT-Thread wrapper pass a persistent
        CO_config_t initialized from OD_INIT_CONFIG() to CO_new(). Enable this
        when the product needs CANopenNode multiple Object Dictionary support or
        explicit runtime object counts. Leave disabled for the smaller default
        single Object Dictionary build.

endmenu

menu "CiA 301 NMT and heartbeat"

config PKG_CANOPENNODE_NMT_CALLBACK_CHANGE
    bool "NMT callback on state change"
    default n
    help
        Add CO_CONFIG_NMT_CALLBACK_CHANGE to CO_CONFIG_NMT. This enables an
        application callback when the local NMT state changes, for example when
        the node enters pre-operational, operational or stopped state.

        Enable this when the application needs to start/stop process I/O,
        update LEDs, notify diagnostics or gate PDO processing based on NMT
        state transitions.

config PKG_CANOPENNODE_NMT_STATE_LOG
    bool "Log local NMT state changes"
    default y
    depends on PKG_CANOPENNODE_USING_DEBUG
    select PKG_CANOPENNODE_NMT_CALLBACK_CHANGE
    help
        Register the RT-Thread wrapper callback with CO_NMT_initCallbackChanged()
        and log each local NMT state transition. The callback is registered again
        after every successful Communication Reset because CO_NMT_init() clears
        the CANopenNode NMT object.

        CANopenNode provides a single NMT state-change callback slot. Disable
        this option if product code needs to own that callback directly; the
        callback capability can still be enabled separately above.

config PKG_CANOPENNODE_NMT_MASTER
    bool "Enable simple NMT master"
    default n
    help
        Add CO_CONFIG_NMT_MASTER to CO_CONFIG_NMT. This enables simple NMT master
        support so the local node can transmit NMT commands to other nodes, such
        as start remote node, stop remote node or reset communication.

        Leave disabled for a normal slave-only device.

menuconfig PKG_CANOPENNODE_USING_HB_CONS
    bool "Enable heartbeat consumer"
    default y
    help
        Enable CO_HBconsumer and add CO_CONFIG_HB_CONS_ENABLE to
        CO_CONFIG_HB_CONS. A heartbeat consumer monitors heartbeat producer
        messages from configured remote nodes, detects timeouts, remote reset and
        NMT state changes, and reports those states to the stack/application.

        Keep enabled when the device depends on one or more remote CANopen nodes
        and must detect loss of communication.

if PKG_CANOPENNODE_USING_HB_CONS

choice
    prompt "Heartbeat consumer NMT-change callback mode"
    default PKG_CANOPENNODE_HB_CONS_CALLBACK_NONE
    help
        Select how heartbeat consumer state changes are reported to the
        application. Use no callback for polling-only applications, one common
        callback for simple supervision, or multiple callbacks when per-node
        start/timeout/reset handling is required.

        CANopenNode does not allow the common and multi callback bits to be set
        at the same time.

config PKG_CANOPENNODE_HB_CONS_CALLBACK_NONE
    bool "No heartbeat consumer change callback"
    help
        Do not add heartbeat-consumer state-change callback flags. The
        application can still inspect heartbeat consumer state through normal
        processing or query functions if enabled.

config PKG_CANOPENNODE_HB_CONS_CALLBACK_CHANGE
    bool "Common heartbeat consumer change callback"
    help
        Add CO_CONFIG_HB_CONS_CALLBACK_CHANGE. One common callback is invoked
        when a monitored node's NMT state changes.

config PKG_CANOPENNODE_HB_CONS_CALLBACK_MULTI
    bool "Multiple heartbeat consumer callbacks"
    help
        Add CO_CONFIG_HB_CONS_CALLBACK_MULTI. Separate callbacks can be
        registered for per-node NMT change, heartbeat started, timeout and remote
        reset events.

endchoice

config PKG_CANOPENNODE_HB_CONS_QUERY_FUNCT
    bool "Enable heartbeat consumer query functions"
    default n
    help
        Add CO_CONFIG_HB_CONS_QUERY_FUNCT to CO_CONFIG_HB_CONS. This exposes
        query helpers for the heartbeat/NMT state of monitored nodes.

        Enable this when application code wants to poll the supervision result
        instead of relying only on callbacks.

endif

endmenu

menu "CiA 301 legacy node guarding"

comment "Node guarding is legacy and is not covered by demo CI profiles; prefer heartbeat supervision."

menuconfig PKG_CANOPENNODE_USING_NODE_GUARDING
    bool "Enable legacy node guarding"
    default n
    help
        Enable CANopen node guarding support. Node guarding is the legacy
        error-control method where a master polls a node and checks the returned
        state/toggle information.

        This package does not need node guarding for the default demo or CI
        profiles. For new designs, prefer NMT plus heartbeat producer/consumer
        and configure heartbeat timing, for example with
        PKG_CANOPENNODE_APP_FIRST_HB_TIME_MS and heartbeat consumer settings.

        Enable node guarding only for older CANopen networks, older masters, or
        devices that explicitly require node/life guarding compatibility. The
        slave path also requires Object Dictionary entries 0x100C Guard Time and
        0x100D Lifetime Factor; the bundled demo OD does not define them.

if PKG_CANOPENNODE_USING_NODE_GUARDING

config PKG_CANOPENNODE_NODE_GUARDING_SLAVE
    bool "Enable node guarding slave"
    default n
    help
        Add CO_CONFIG_NODE_GUARDING_SLAVE_ENABLE. The local device can respond
        to node guarding requests from an external master.

        Enable this only when the product Object Dictionary defines 0x100C Guard
        Time and 0x100D Lifetime Factor. Prefer heartbeat supervision for new
        products.

config PKG_CANOPENNODE_NODE_GUARDING_MASTER
    bool "Enable node guarding master"
    default n
    help
        Add CO_CONFIG_NODE_GUARDING_MASTER_ENABLE. The local device can poll
        other nodes using the legacy node guarding mechanism.

        Enable only when this RT-Thread node must act as the compatibility
        master for legacy nodes.

config PKG_CANOPENNODE_NODE_GUARDING_MASTER_COUNT
    int
    prompt "Node guarding master count" if PKG_CANOPENNODE_NODE_GUARDING_MASTER
    range 0 127
    default 127
    help
        Maximum number of nodes monitored by the node guarding master. The value
        remains defined even when the prompt is hidden, so CO_driver_target.h can
        keep a stable CO_CONFIG_NODE_GUARDING_MASTER_COUNT mapping.

endif

endmenu

menu "CiA 301 emergency object"

config PKG_CANOPENNODE_EM_PRODUCER
    bool "Emergency producer"
    default y
    help
        Add CO_CONFIG_EM_PRODUCER to CO_CONFIG_EM. The local node can transmit
        EMCY messages when CO_errorReport() or CO_errorReset() changes the active
        error state.

config PKG_CANOPENNODE_EM_PROD_CONFIGURABLE
    bool "Configurable emergency COB-ID"
    default n
    depends on PKG_CANOPENNODE_EM_PRODUCER
    help
        Add CO_CONFIG_EM_PROD_CONFIGURABLE. OD object 0x1014 can configure the
        emergency producer COB-ID. When disabled, the default EMCY COB-ID is
        derived from the node ID and 0x1014 is effectively fixed/read-only.

config PKG_CANOPENNODE_EM_PROD_INHIBIT
    bool "Emergency inhibit timer"
    default n
    depends on PKG_CANOPENNODE_EM_PRODUCER
    help
        Add CO_CONFIG_EM_PROD_INHIBIT. OD object 0x1015 limits the minimum time
        between produced EMCY messages, reducing bursts when an error toggles or
        multiple faults are reported quickly.

config PKG_CANOPENNODE_EM_HISTORY
    bool "Emergency history"
    default y
    help
        Add CO_CONFIG_EM_HISTORY. Store recent emergency error codes in the
        predefined error field, OD object 0x1003, so diagnostic tools can read
        fault history after the fault was reported.

config PKG_CANOPENNODE_EM_STATUS_BITS
    bool "Expose emergency status bits through OD"
    default n
    help
        Add CO_CONFIG_EM_STATUS_BITS. Expose CO_EM_errorStatusBits_t through the
        Object Dictionary for diagnostics or manufacturer-specific inspection.

        Enable only when OD access to raw error status bits is required.

config PKG_CANOPENNODE_EM_CONSUMER
    bool "Emergency consumer"
    default n
    help
        Add CO_CONFIG_EM_CONSUMER. The local node can receive EMCY messages from
        other nodes and report them to an application callback.

        Enable this for supervisors, gateways, masters or devices that must react
        to remote node faults.

config PKG_CANOPENNODE_EM_ERR_STATUS_BITS_COUNT
    int "Emergency status bit count"
    range 48 256
    default 80
    help
        Number of local emergency status bits. CANopenNode uses the first 48 bits
        internally; the remaining bits can be used by manufacturer/application
        errors. The value must be a multiple of 8 because CANopenNode stores and
        checks the status as whole bytes. The stack default manufacturer error
        condition reads status bytes 8 and 9, so
        PKG_CANOPENNODE_ERR_CONDITION_MANUFACTURER_STACK requires this value to
        be at least 80. CANopenNode default is 80.

config PKG_CANOPENNODE_ERR_CONDITION_GENERIC_STACK
    bool "Generic error condition uses stack default"
    default y
    help
        Define CO_CONFIG_ERR_CONDITION_GENERIC using the stack default condition.
        It maps stack generic error status bits into bit 0 of CANopen error
        register object 0x1001.

config PKG_CANOPENNODE_ERR_CONDITION_COMMUNICATION_STACK
    bool "Communication error condition uses stack default"
    default y
    help
        Define CO_CONFIG_ERR_CONDITION_COMMUNICATION using stack communication
        error status bits. This feeds the communication error bit in CANopen
        error register object 0x1001.

config PKG_CANOPENNODE_ERR_CONDITION_MANUFACTURER_STACK
    bool "Manufacturer error condition uses stack default"
    depends on PKG_CANOPENNODE_EM_ERR_STATUS_BITS_COUNT >= 80
    default y
    help
        Define CO_CONFIG_ERR_CONDITION_MANUFACTURER using the stack default
        manufacturer error bits. This feeds the manufacturer-specific error bit
        in CANopen error register object 0x1001. This option requires at least
        80 emergency status bits because it reads errorStatusBits[8] and
        errorStatusBits[9].

config PKG_CANOPENNODE_ERR_CONDITION_CURRENT_ZERO
    bool "Define current error condition as false"
    default n
    help
        Define CO_CONFIG_ERR_CONDITION_CURRENT as 0. Use this when the product
        does not report current-related errors through the CANopen error
        register. Leave disabled if the application will provide its own macro.

config PKG_CANOPENNODE_ERR_CONDITION_VOLTAGE_ZERO
    bool "Define voltage error condition as false"
    default n
    help
        Define CO_CONFIG_ERR_CONDITION_VOLTAGE as 0. Use this when the product
        does not report voltage-related errors through the CANopen error
        register. Leave disabled if the application will provide its own macro.

config PKG_CANOPENNODE_ERR_CONDITION_TEMPERATURE_ZERO
    bool "Define temperature error condition as false"
    default n
    help
        Define CO_CONFIG_ERR_CONDITION_TEMPERATURE as 0. Use this when the
        product does not report temperature-related errors through the CANopen
        error register. Leave disabled if the application will provide its own
        macro.

config PKG_CANOPENNODE_ERR_CONDITION_DEV_PROFILE_ZERO
    bool "Define device-profile error condition as false"
    default n
    help
        Define CO_CONFIG_ERR_CONDITION_DEV_PROFILE as 0. Use this when the
        selected CANopen device profile does not map any profile-specific error
        into the CANopen error register. Leave disabled if the application will
        provide its own macro.

endmenu

menu "CiA 301 SDO"

comment "SDO provides Object Dictionary upload/download for configuration and diagnostics."
comment "Most slave devices need SDO server; SDO client is for masters/gateways/tools."

menuconfig PKG_CANOPENNODE_USING_SDO_SERVER
    bool "Enable SDO server"
    default y
    help
        Enable CO_SDOserver.c and CO_CONFIG_SDO_SRV. The SDO server lets another
        node or configuration tool read/write this device's Object Dictionary.

        Keep enabled for most CANopen devices.

if PKG_CANOPENNODE_USING_SDO_SERVER

config PKG_CANOPENNODE_SDO_SRV_SEGMENTED
    bool "SDO server segmented transfer"
    default y
    help
        Add CO_CONFIG_SDO_SRV_SEGMENTED. Segmented transfer allows OD entries
        larger than one expedited SDO frame to be transferred in several CAN
        frames.

config PKG_CANOPENNODE_SDO_SRV_BLOCK
    bool "SDO server block transfer"
    default n
    depends on PKG_CANOPENNODE_SDO_SRV_SEGMENTED
    select PKG_CANOPENNODE_USING_CRC16
    help
        Add CO_CONFIG_SDO_SRV_BLOCK. Block transfer improves throughput for large
        objects but needs segmented transfer and a larger SDO buffer.

config PKG_CANOPENNODE_SDO_SRV_BUFFER_SIZE
    int "SDO server buffer size"
    range 900 4096 if PKG_CANOPENNODE_SDO_SRV_BLOCK
    range 20 4096 if !PKG_CANOPENNODE_SDO_SRV_BLOCK
    default 1000 if PKG_CANOPENNODE_SDO_SRV_BLOCK
    default 32
    help
        Internal SDO server buffer size in bytes. Segmented server transfer
        requires at least 20 bytes; block transfer requires at least 900 bytes
        because CANopenNode verifies that constraint at compile time. Increase
        the value for large OD entries or higher block-transfer throughput.

endif

menuconfig PKG_CANOPENNODE_USING_SDO_CLIENT
    bool "Enable SDO client"
    default n
    select PKG_CANOPENNODE_USING_FIFO
    help
        Enable CO_SDOclient.c and add CO_CONFIG_SDO_CLI_ENABLE to
        CO_CONFIG_SDO_CLI. SDO client lets this node read/write Object
        Dictionary entries on remote nodes.

        Enable for NMT masters, gateways, commissioning tools or devices that
        configure other CANopen nodes. It selects FIFO support because the SDO
        client uses a circular buffer.

if PKG_CANOPENNODE_USING_SDO_CLIENT

config PKG_CANOPENNODE_SDO_CLI_SEGMENTED
    bool "SDO client segmented transfer"
    default y
    help
        Add CO_CONFIG_SDO_CLI_SEGMENTED. The client can transfer data larger than
        an expedited SDO frame by exchanging several segments.

config PKG_CANOPENNODE_SDO_CLI_BLOCK
    bool "SDO client block transfer"
    default n
    depends on PKG_CANOPENNODE_SDO_CLI_SEGMENTED
    select PKG_CANOPENNODE_FIFO_ALT_READ
    select PKG_CANOPENNODE_FIFO_CRC16_CCITT
    help
        Add CO_CONFIG_SDO_CLI_BLOCK. Block transfer improves throughput for large
        uploads/downloads. It also requires FIFO alternate read and CRC16-CCITT
        support, which are selected automatically.

config PKG_CANOPENNODE_SDO_CLI_LOCAL
    bool "SDO client local transfer"
    default n
    help
        Add CO_CONFIG_SDO_CLI_LOCAL. If the SDO client targets the same node ID
        as the local SDO server, data can be transferred locally without sending
        CAN frames.

config PKG_CANOPENNODE_SDO_CLI_BUFFER_SIZE
    int "SDO client buffer size"
    range 1000 4096 if PKG_CANOPENNODE_SDO_CLI_BLOCK
    range 7 4096 if !PKG_CANOPENNODE_SDO_CLI_BLOCK
    default 1000 if PKG_CANOPENNODE_SDO_CLI_BLOCK
    default 32
    help
        Internal SDO client circular buffer size in bytes. Segmented transfer can
        work with a buffer as small as 7 bytes if the application services it
        frequently. Block transfer requires at least 1000 bytes so the maximum
        block size can be used, matching CANopenNode's upstream configuration.

endif

endmenu

menuconfig PKG_CANOPENNODE_USING_TIME
    bool "CiA 301 TIME object"
    default y
    help
        Enable CO_TIME.c and CO_CONFIG_TIME. TIME transfers a CANopen time stamp
        object, allowing a node to consume network time or produce a time stamp
        for other nodes.

        Default mode enables TIME consumer. Enable producer only on the node that
        owns or distributes the network time base.

if PKG_CANOPENNODE_USING_TIME

config PKG_CANOPENNODE_TIME_PRODUCER
    bool "TIME producer"
    default n
    help
        Add CO_CONFIG_TIME_PRODUCER. The local node can transmit TIME messages
        using the COB-ID and enable bits configured by OD object 0x1012.

endif

menu "CiA 301 SYNC and PDO"

comment "SYNC provides a network synchronization event; PDO transfers process data."
comment "RPDO receives process data; TPDO transmits process data."

menuconfig PKG_CANOPENNODE_USING_SYNC
    bool "Enable SYNC object"
    default y
    help
        Enable CO_SYNC.c and CO_CONFIG_SYNC. SYNC consumer detects network SYNC
        messages. SYNC producer sends SYNC messages when this node is selected as
        the network synchronizer.

if PKG_CANOPENNODE_USING_SYNC

config PKG_CANOPENNODE_SYNC_PRODUCER
    bool "SYNC producer"
    default y
    help
        Add CO_CONFIG_SYNC_PRODUCER. The local node can produce SYNC messages
        according to OD objects such as 0x1005 and 0x1006.

endif

menuconfig PKG_CANOPENNODE_USING_PDO
    bool "Enable PDO objects"
    default y
    help
        Enable CO_PDO.c and CO_CONFIG_PDO. PDOs are the normal fast process-data
        channel in CANopen. RPDO writes received mapped values into the local OD
        or application access functions; TPDO sends mapped local values to the
        CAN bus.

if PKG_CANOPENNODE_USING_PDO

config PKG_CANOPENNODE_RPDO
    bool "Receive PDO"
    default y
    help
        Add CO_CONFIG_RPDO_ENABLE. Enable receive PDO objects, used for process
        data consumed by this node.

config PKG_CANOPENNODE_TPDO
    bool "Transmit PDO"
    default y
    help
        Add CO_CONFIG_TPDO_ENABLE. Enable transmit PDO objects, used for process
        data produced by this node.

config PKG_CANOPENNODE_RPDO_TIMERS
    bool "RPDO timers"
    default y
    depends on PKG_CANOPENNODE_RPDO
    help
        Add CO_CONFIG_RPDO_TIMERS_ENABLE. Enable RPDO timeout/event-timer related
        processing so missing or late received PDOs can be detected according to
        OD configuration.

config PKG_CANOPENNODE_TPDO_TIMERS
    bool "TPDO timers"
    default y
    depends on PKG_CANOPENNODE_TPDO
    help
        Add CO_CONFIG_TPDO_TIMERS_ENABLE. Enable TPDO inhibit time and event
        timer handling. This controls minimum send spacing and periodic/event
        driven TPDO transmission.

config PKG_CANOPENNODE_PDO_SYNC
    bool "PDO SYNC support"
    default y
    depends on PKG_CANOPENNODE_USING_SYNC
    help
        Add CO_CONFIG_PDO_SYNC_ENABLE. PDO objects can use synchronous
        transmission types and the SYNC counter/window rules from the OD.

config PKG_CANOPENNODE_PDO_OD_IO_ACCESS
    bool "PDO OD IO access"
    default y
    help
        Add CO_CONFIG_PDO_OD_IO_ACCESS. PDO mapping uses OD_IO_t read/write
        accessors instead of direct memory access. This is more flexible for
        application variables, hardware-backed values and validation hooks, but
        uses slightly more code/data than direct memory mapping.

config PKG_CANOPENNODE_PDO_BITWISE_MAPPING
    bool "PDO bitwise mapping"
    default n
    depends on PKG_CANOPENNODE_PDO_OD_IO_ACCESS
    help
        Add CO_CONFIG_PDO_BITWISE_MAPPING. PDO mapped lengths are tracked in bits
        instead of bytes, allowing bit-level mapping. Requires PDO OD IO access.

endif

endmenu

menuconfig PKG_CANOPENNODE_USING_STORAGE
    bool "CiA 301 parameter storage"
    default n
    help
        Enable CO_storage.c and CO_CONFIG_STORAGE_ENABLE. Storage implements
        parameter save/restore support for OD objects 0x1010 and 0x1011.

        Each CANopenNodeRTT instance owns its storage object and entry table.
        The selected OD_PERSIST_* groups are initialized automatically after
        CO_CANinit() and before CO_CANopenInit(). Select one RT-Thread storage
        implementation below: built-in DFS, built-in EEPROM/AT24CXX, or a
        user-provided backend.

if PKG_CANOPENNODE_USING_STORAGE

config PKG_CANOPENNODE_STORAGE_MAX_ENTRIES_COUNT
    int "CANopenNode storage maximum entry count"
    range 1 255
    default 1
    help
        Maximum number of CO_storage_entry_t objects supported by CANopenNode
        storage. Increase this when more than one OD_PERSIST_* group is enabled
        or when the application supplies additional storage entries.

config PKG_CANOPENNODE_STORAGE_PERSIST_COMM
    bool "Persist CANopen communication parameters"
    default y
    help
        Add OD_PERSIST_COMM to the RT-Thread storage table.
        This maps communication parameters to sub-index 2 of OD 0x1010 Store
        parameters and OD 0x1011 Restore default parameters. The generated OD.h
        must provide OD_PERSIST_COMM.

config PKG_CANOPENNODE_STORAGE_PERSIST_APP
    bool "Persist CANopen application parameters"
    default n
    help
        Add OD_PERSIST_APP to the RT-Thread storage table.
        This maps application parameters to sub-index 3 of OD 0x1010 and OD
        0x1011. Enable this only when the generated OD.h provides
        OD_PERSIST_APP.

config PKG_CANOPENNODE_STORAGE_PERSIST_MANU
    bool "Persist CANopen manufacturer parameters"
    default n
    help
        Add OD_PERSIST_MANU to the RT-Thread storage table.
        This maps manufacturer parameters to sub-index 4 of OD 0x1010 and OD
        0x1011. Enable this only when the generated OD.h provides
        OD_PERSIST_MANU.

rsource "../port/rtthread/storage/Kconfig"

endif

menuconfig PKG_CANOPENNODE_USING_LEDS
    bool "CiA 303-3 CANopen LED indicators"
    default y
    help
        Enable CO_LEDs.c and CO_CONFIG_LEDS_ENABLE. This calculates CANopen run
        and error LED states from NMT and error-control state. Board code can map
        the calculated states to real GPIO LEDs later, or the package can drive
        RT-Thread PIN outputs when PKG_CANOPENNODE_LEDS_USING_RTT_PIN is enabled.

if PKG_CANOPENNODE_USING_LEDS

config PKG_CANOPENNODE_LEDS_USING_RTT_PIN
    bool "Drive CANopen LEDs with RT-Thread PIN"
    default n
    depends on RT_USING_PIN
    help
        Configure RT-Thread PIN outputs for the CiA 303-3 CANopen run and error
        LED states calculated by CO_LEDs. Disable this when the application maps
        CANopen LED states itself through CANopenNodeRTT::outStatusLEDGreen and
        CANopenNodeRTT::outStatusLEDRed.

config PKG_CANOPENNODE_LEDS_RTT_PIN_RUN
    int "CANopen run LED pin number"
    default -1
    depends on PKG_CANOPENNODE_LEDS_USING_RTT_PIN
    help
        RT-Thread PIN number for the CANopen run/green LED. Set to -1 to leave
        the run LED unbound.

config PKG_CANOPENNODE_LEDS_RTT_PIN_ERROR
    int "CANopen error LED pin number"
    default -1
    depends on PKG_CANOPENNODE_LEDS_USING_RTT_PIN
    help
        RT-Thread PIN number for the CANopen error/red LED. Set to -1 to leave
        the error LED unbound.

config PKG_CANOPENNODE_LEDS_RTT_PIN_RUN_ACTIVE_HIGH
    bool "CANopen run LED pin is active high"
    default y
    depends on PKG_CANOPENNODE_LEDS_USING_RTT_PIN
    help
        Select the electrical polarity for the configured run/green LED pin.
        Enable for active-high LEDs and disable for active-low LEDs.

config PKG_CANOPENNODE_LEDS_RTT_PIN_ERROR_ACTIVE_HIGH
    bool "CANopen error LED pin is active high"
    default y
    depends on PKG_CANOPENNODE_LEDS_USING_RTT_PIN
    help
        Select the electrical polarity for the configured error/red LED pin.
        Enable for active-high LEDs and disable for active-low LEDs.

endif

menu "CiA 304 safety-related objects"

menuconfig PKG_CANOPENNODE_USING_GFC
    bool "Enable GFC object"
    default n
    help
        Enable CO_GFC.c and CO_CONFIG_GFC. GFC is the Global Fail-safe Command
        object used with safety-related communication.

        Leave disabled for ordinary CiA 301 devices.

if PKG_CANOPENNODE_USING_GFC

config PKG_CANOPENNODE_GFC_CONSUMER
    bool "GFC consumer"
    default n
    help
        Add CO_CONFIG_GFC_CONSUMER. The local node can consume Global Fail-safe
        Command messages.

config PKG_CANOPENNODE_GFC_PRODUCER
    bool "GFC producer"
    default n
    help
        Add CO_CONFIG_GFC_PRODUCER. The local node can produce Global Fail-safe
        Command messages.

endif

menuconfig PKG_CANOPENNODE_USING_SRDO
    bool "Enable SRDO object"
    default n
    select PKG_CANOPENNODE_USING_CRC16
    help
        Enable CO_SRDO.c and CO_CONFIG_SRDO. SRDO is Safety Related Data Object
        communication. Enable only when the whole safety design, OD entries,
        timing and validation requirements are intentionally implemented.

if PKG_CANOPENNODE_USING_SRDO

config PKG_CANOPENNODE_SRDO_CHECK_TX
    bool "SRDO TX data check"
    default n
    help
        Add CO_CONFIG_SRDO_CHECK_TX. Check SRDO transmit data before sending the
        safety-related message pair.

config PKG_CANOPENNODE_SRDO_MINIMUM_DELAY
    int "SRDO minimum delay in us"
    range 0 1000000
    default 0
    help
        Minimum delay in microseconds between the first and second transmitted
        SRDO CANopen message.

endif

endmenu

menu "CiA 305 LSS"

comment "LSS discovers/configures node ID and bitrate during commissioning."
comment "LSS slave is for configurable devices; LSS master is for tools/gateways/managers."

menuconfig PKG_CANOPENNODE_USING_LSS_SLAVE
    bool "Enable LSS slave"
    default y
    help
        Enable CO_LSSslave.c and add CO_CONFIG_LSS_SLAVE to CO_CONFIG_LSS. The
        local node can be discovered/configured by an LSS master.

if PKG_CANOPENNODE_USING_LSS_SLAVE

config PKG_CANOPENNODE_LSS_SLAVE_FASTSCAN_DIRECT_RESPOND
    bool "LSS slave fastscan direct respond"
    default n
    help
        Add CO_CONFIG_LSS_SLAVE_FASTSCAN_DIRECT_RESPOND. The LSS slave sends the
        fastscan response directly from the receive path.

        Use only after checking the target driver's realtime constraints; keep
        receive-path processing short.

endif

menuconfig PKG_CANOPENNODE_USING_LSS_MASTER
    bool "Enable LSS master"
    default n
    help
        Enable CO_LSSmaster.c and add CO_CONFIG_LSS_MASTER to CO_CONFIG_LSS. The
        local node can scan and configure LSS slaves.

        Enable for commissioning tools or gateways, not for a simple fixed-ID
        device.

endmenu

menuconfig PKG_CANOPENNODE_USING_GATEWAY_ASCII
    bool "CiA 309-3 ASCII gateway"
    default n
    select PKG_CANOPENNODE_USING_FIFO
    select PKG_CANOPENNODE_FIFO_ASCII_COMMANDS
    help
        Enable CO_gateway_ascii.c and CO_CONFIG_GTW_ASCII. This option compiles
        CANopenNode ASCII gateway support and related helpers. The RT-Thread
        wrapper schedules Gateway processing from its CANopen mainline. No
        command transport is registered unless the MSH console bridge under
        RT-Thread runtime options is also enabled.

        Applications that do not use the MSH bridge may register another
        transport with CO_GTWA_write() and CO_GTWA_initRead().

        Gateway command groups depend on SDO client, NMT master and/or LSS master
        options below.

if PKG_CANOPENNODE_USING_GATEWAY_ASCII

config PKG_CANOPENNODE_GATEWAY_MULTI_NET
    bool "Gateway multi-network flag"
    default n
    help
        Add CO_CONFIG_GTW_MULTI_NET to CO_CONFIG_GTW. CANopenNode documents this
        flag as currently not implemented; keep it disabled unless testing that
        code path explicitly.

config PKG_CANOPENNODE_GATEWAY_ASCII_SDO
    bool "Gateway ASCII SDO commands"
    default y
    depends on PKG_CANOPENNODE_USING_SDO_CLIENT
    select PKG_CANOPENNODE_FIFO_ASCII_DATATYPES
    help
        Add CO_CONFIG_GTW_ASCII_SDO. Enable ASCII commands that perform SDO
        uploads/downloads through the SDO client.

config PKG_CANOPENNODE_GATEWAY_ASCII_NMT
    bool "Gateway ASCII NMT commands"
    default n
    depends on PKG_CANOPENNODE_NMT_MASTER
    help
        Add CO_CONFIG_GTW_ASCII_NMT. Enable ASCII commands that transmit NMT
        master commands.

config PKG_CANOPENNODE_GATEWAY_ASCII_LSS
    bool "Gateway ASCII LSS commands"
    default n
    depends on PKG_CANOPENNODE_USING_LSS_MASTER
    help
        Add CO_CONFIG_GTW_ASCII_LSS. Enable ASCII commands for LSS master scan
        and configuration operations.

config PKG_CANOPENNODE_GATEWAY_ASCII_LOG
    bool "Gateway ASCII log"
    default n
    help
        Add CO_CONFIG_GTW_ASCII_LOG. Enable the gateway message log buffer for
        diagnostic output.

config PKG_CANOPENNODE_GATEWAY_ASCII_ERROR_DESC
    bool "Gateway ASCII error descriptions"
    default n
    help
        Add CO_CONFIG_GTW_ASCII_ERROR_DESC. Include textual error descriptions
        in gateway output where supported.

config PKG_CANOPENNODE_GATEWAY_ASCII_PRINT_HELP
    bool "Gateway ASCII help command"
    default n
    help
        Add CO_CONFIG_GTW_ASCII_PRINT_HELP. Enable the non-standard "help"
        command for interactive gateway sessions.

config PKG_CANOPENNODE_GATEWAY_ASCII_PRINT_LEDS
    bool "Gateway ASCII LED status print"
    default n
    depends on PKG_CANOPENNODE_USING_LEDS
    help
        Add CO_CONFIG_GTW_ASCII_PRINT_LEDS. Enable the non-standard "led"
        Gateway command, which prints the calculated CANopen run/error LED
        states on the Gateway output. It does not control physical LED GPIOs.

config PKG_CANOPENNODE_GTW_BLOCK_DL_LOOP
    int "Gateway SDO block download loop count"
    range 1 127
    default 1
    help
        Number of CO_SDOclientDownload() loops performed during one gateway block
        download processing pass. Increase only after measuring mainline latency.

config PKG_CANOPENNODE_GTWA_COMM_BUF_SIZE
    int "Gateway ASCII command buffer size"
    range 32 8192
    default 200
    help
        ASCII gateway command buffer size in bytes. Increase if commands or data
        payloads are truncated.

config PKG_CANOPENNODE_GTWA_LOG_BUF_SIZE
    int "Gateway ASCII log buffer size"
    range 0 65536
    default 2000
    help
        ASCII gateway message log buffer size in bytes. Set to 0 only if gateway
        logging is intentionally unused.

endif

menu "Helper and debug objects"

comment "FIFO/CRC16 are helpers for optional modules; trace/debug are bring-up aids."

config PKG_CANOPENNODE_USING_CRC16
    bool "Enable CRC16 helper"
    default n
    help
        Enable CO_CONFIG_CRC16_ENABLE and compile crc16-ccitt.c unless an
        external CRC16 implementation is selected. Required by SDO block transfer
        and FIFO CRC16-CCITT support.

config PKG_CANOPENNODE_CRC16_EXTERNAL
    bool "Use external CRC16 implementation"
    default n
    depends on PKG_CANOPENNODE_USING_CRC16
    help
        Add CO_CONFIG_CRC16_EXTERNAL. CANopenNode will expect the target/application
        to provide the CRC16 implementation instead of compiling its internal
        crc16-ccitt.c source.

config PKG_CANOPENNODE_USING_FIFO
    bool "Enable FIFO helper"
    default n
    help
        Enable CO_fifo.c and CO_CONFIG_FIFO_ENABLE. FIFO provides circular-buffer
        utilities used by SDO client, ASCII gateway and related data paths. This
        option may be selected automatically by features that need it.

config PKG_CANOPENNODE_FIFO_ALT_READ
    bool "FIFO alternate read"
    default n
    depends on PKG_CANOPENNODE_USING_FIFO
    help
        Add CO_CONFIG_FIFO_ALT_READ. Enables alternate-read support in the FIFO,
        used by SDO block-transfer paths that need to read data while preserving
        buffer state until the transfer is confirmed.

config PKG_CANOPENNODE_FIFO_CRC16_CCITT
    bool "FIFO CRC16-CCITT support"
    default n
    depends on PKG_CANOPENNODE_USING_FIFO
    select PKG_CANOPENNODE_USING_CRC16
    help
        Add CO_CONFIG_FIFO_CRC16_CCITT. Enables CRC16-CCITT calculation over FIFO
        data. This also causes the CRC16 source to be compiled unless an external
        CRC implementation is selected.

config PKG_CANOPENNODE_FIFO_ASCII_COMMANDS
    bool "FIFO ASCII command support"
    default n
    depends on PKG_CANOPENNODE_USING_FIFO
    help
        Add CO_CONFIG_FIFO_ASCII_COMMANDS. Enables FIFO helpers used for ASCII
        command parsing in the CiA 309-3 gateway.

config PKG_CANOPENNODE_FIFO_ASCII_DATATYPES
    bool "FIFO ASCII datatype support"
    default n
    depends on PKG_CANOPENNODE_USING_FIFO
    help
        Add CO_CONFIG_FIFO_ASCII_DATATYPES. Enables ASCII datatype conversion
        helpers used by gateway SDO commands.

config PKG_CANOPENNODE_TRACE_AVAILABLE
    bool
    default n

menuconfig PKG_CANOPENNODE_USING_TRACE
    bool "Enable trace recorder (unavailable)"
    default n
    depends on PKG_CANOPENNODE_TRACE_AVAILABLE
    help
        Do not enable CO_trace.c or CO_CONFIG_TRACE_ENABLE. The current
        CANopenNode trace module is not ported to the SDO server and Object
        Dictionary APIs used by this package. Upstream keeps CO_CONFIG_TRACE
        disabled for the same reason; enabling it references obsolete symbols
        such as CO_t::SDO and CO_SDO_t and can break the build.

        Keep this disabled until CO_trace.c/.h are ported to the current
        CO_SDOserver_t and OD_* APIs and trace=y is covered by build tests.

if PKG_CANOPENNODE_USING_TRACE

config PKG_CANOPENNODE_TRACE_OWN_INTTYPES
    bool "Trace owns inttypes format macros"
    default n
    help
        Add CO_CONFIG_TRACE_OWN_INTTYPES. Let the trace module define the integer
        format macros it needs when the target C library does not provide them
        correctly.

endif

menuconfig PKG_CANOPENNODE_USING_DEBUG
    bool "Enable CANopenNode RT-Thread debug logs"
    default n
    depends on RT_USING_ULOG
    help
        Enable RT-Thread ulog diagnostics for the CANopenNode RT-Thread port and
        expose CANopenNode internal debug macros through CO_DEBUG_COMMON(msg).
        The port uses LOG_E, LOG_W, LOG_I and LOG_D according to runtime event
        severity.

        Use for bring-up and troubleshooting. Leave disabled for normal release
        builds unless the project has a defined debug logging policy.

if PKG_CANOPENNODE_USING_DEBUG

config PKG_CANOPENNODE_DEBUG_COMMON
    bool "Default common debug macro"
    default y
    help
        Add CO_CONFIG_DEBUG_COMMON. Enable common CANopenNode debug output paths.
        This option also provides the CO_DEBUG_COMMON(msg) ulog sink used by
        target-specific debug output.

config PKG_CANOPENNODE_DEBUG_SDO_CLIENT
    bool "SDO client debug output"
    default n
    depends on PKG_CANOPENNODE_USING_SDO_CLIENT
    help
        Add CO_CONFIG_DEBUG_SDO_CLIENT. Enable additional SDO client debug output
        during uploads/downloads and error handling. Messages are routed through
        the same CO_DEBUG_COMMON(msg) ulog sink.

config PKG_CANOPENNODE_DEBUG_SDO_SERVER
    bool "SDO server debug output"
    default n
    depends on PKG_CANOPENNODE_USING_SDO_SERVER
    help
        Add CO_CONFIG_DEBUG_SDO_SERVER. Enable additional SDO server debug output
        during OD access and transfer state handling. Messages are routed through
        the same CO_DEBUG_COMMON(msg) ulog sink.

config PKG_CANOPENNODE_USING_FRAME_TRACE
    bool "Trace CAN RX/TX frames with ulog"
    default n
    help
        Emit debug logs for each CAN frame submitted to or received from the
        RT-Thread CAN device. The trace prints frame metadata with LOG_D and the
        payload with LOG_HEX(). This is intended for bring-up and bus-level
        diagnostics.

endif

endmenu

endmenu
```
