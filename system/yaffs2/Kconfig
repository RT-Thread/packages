## tools/anv_bench/Kconfig
```kconfig
# Kconfig file for package anv_bench
menuconfig PKG_USING_ANV_BENCH
    select RT_USING_LIBC        if RT_VER_NUM < 0x40100
    select RT_USING_POSIX       if RT_VER_NUM < 0x40100
    select RT_USING_POSIX_FS    if RT_VER_NUM >= 0x40100
    select RT_USING_POSIX_DEVIO if RT_VER_NUM >= 0x40100
    bool "anv_bench: quick-and-dirty benchmarking system for quick prototyping."
    default n

if PKG_USING_ANV_BENCH

    config PKG_ANV_BENCH_PATH
        string
        default "/packages/tools/anv_bench"

    config ANV_BENCH_USING_EXAMPLE
        bool "anv_bench      : single bench example"
        help
            anv_bench      : single bench example.
        default n

    config ANV_BENCH_USING_GROUP_EXAMPLE
        bool "anv_bench_group: group bench example"
        help
            anv_bench_group: group bench example.
        default n

    choice
        prompt "Version"
        default PKG_USING_ANV_BENCH_LATEST_VERSION
        help
            Select the package version

        config PKG_USING_ANV_BENCH_LATEST_VERSION
            bool "latest"
    endchoice

    config PKG_ANV_BENCH_VER
       string
       default "latest"    if PKG_USING_ANV_BENCH_LATEST_VERSION

endif
```

## tools/anv_memleak/Kconfig
```kconfig
# Kconfig file for package anv_memleak
menuconfig PKG_USING_ANV_MEMLEAK
    select RT_USING_LIBC        if RT_VER_NUM < 0x40100
    select RT_USING_POSIX       if RT_VER_NUM < 0x40100
    select RT_USING_POSIX_FS    if RT_VER_NUM >= 0x40100
    bool "anv_memleak: check if there are memleaks"
    default n

if PKG_USING_ANV_MEMLEAK

    config PKG_ANV_MEMLEAK_PATH
        string
        default "/packages/tools/anv_memleak"

    config ANV_MEMLEAK_USING_EXAMPLE
        bool "anv_memleak: usage example"
        help
            anv_memleak: usage example.
        default n

    choice
        prompt "Version"
        default PKG_USING_ANV_MEMLEAK_LATEST_VERSION
        help
            Select the package version

        config PKG_USING_ANV_MEMLEAK_LATEST_VERSION
            bool "latest"
    endchoice

    config PKG_ANV_MEMLEAK_VER
       string
       default "latest"    if PKG_USING_ANV_MEMLEAK_LATEST_VERSION

endif
```

## tools/anv_testsuit/Kconfig
```kconfig
# Kconfig file for package anv_testsuit
menuconfig PKG_USING_ANV_TESTSUIT
    select RT_USING_LIBC        if RT_VER_NUM < 0x40100
    select RT_USING_POSIX       if RT_VER_NUM < 0x40100
    select RT_USING_POSIX_FS    if RT_VER_NUM >= 0x40100
    bool "anv_testsuit: minimalist C/C++ unit test framework."
    default n

if PKG_USING_ANV_TESTSUIT

    config PKG_ANV_TESTSUIT_PATH
        string
        default "/packages/tools/anv_testsuit"

    config ANV_TESTSUIT_USING_EXAMPLE
        bool "anv_testsuit: usage example"
        help
            anv_testsuit: usage example.
        default n

    choice
        prompt "Version"
        default PKG_USING_ANV_TESTSUIT_LATEST_VERSION
        help
            Select the package version

        config PKG_USING_ANV_TESTSUIT_LATEST_VERSION
            bool "latest"
    endchoice

    config PKG_ANV_TESTSUIT_VER
       string
       default "latest"    if PKG_USING_ANV_TESTSUIT_LATEST_VERSION

endif
```

## tools/anv_trace/Kconfig
```kconfig
# Kconfig file for package anv_trace
menuconfig PKG_USING_ANV_TRACE
    select RT_USING_LIBC        if RT_VER_NUM < 0x40100
    select RT_USING_POSIX       if RT_VER_NUM < 0x40100
    select RT_USING_POSIX_FS    if RT_VER_NUM >= 0x40100
    bool "anv_trace: trace the program flow."
    default n

if PKG_USING_ANV_TRACE

    config PKG_ANV_TRACE_PATH
        string
        default "/packages/tools/anv_trace"

    config ANV_TRACE_USING_EXAMPLE
        bool "anv_trace: usage example"
        help
            anv_trace: usage example.
        default n

    choice
        prompt "Version"
        default PKG_USING_ANV_TRACE_LATEST_VERSION
        help
            Select the package version

        config PKG_USING_ANV_TRACE_LATEST_VERSION
            bool "latest"
    endchoice

    config PKG_ANV_TRACE_VER
       string
       default "latest"    if PKG_USING_ANV_TRACE_LATEST_VERSION

endif
```

## tools/armv7m_DWT/Kconfig
```kconfig
# Kconfig file for package ARMV7_DWT

menuconfig PKG_USING_ARMV7M_DWT_TOOL
    bool "armv7m_DWT"
    default n

if PKG_USING_ARMV7M_DWT_TOOL

    config PKG_ARMV7M_DWT_TOOL_PATH
        string
        default "/packages/tools/armv7m_DWT"

    config PKG_USING_ARMV7M_DWT_TOOL_DEMO
        bool "Enable demo for rtt"
        default y

    choice
        prompt "Version"
        default PKG_USING_ARMV7M_DWT_TOOL_LATEST_VERSION
        help
            Select the package version

        config PKG_USING_ARMV7M_DWT_TOOL_LATEST_VERSION
            bool "latest"
    endchoice

    config PKG_ARMV7M_DWT_TOOL_VER
       string
       default "latest"    if PKG_USING_ARMV7M_DWT_TOOL_LATEST_VERSION

endif
```

## tools/blackmagic/Kconfig
```kconfig
# Kconfig file for package blackmagic
menuconfig PKG_USING_BLACKMAGIC
    bool "black magic probe: firmware download tool"
    default n

if PKG_USING_BLACKMAGIC

    config PKG_BLACKMAGIC_PATH
        string
        default "/packages/tools/blackmagic"

    config BLACKMAGIC_ENABLE_RTT
        bool "rtt support"
        default y
        help
            rtt (real-time terminal) allows terminal input/output between target and host

    config BLACKMAGIC_ENABLE_RTT_IDENT
        bool "rtt ident"
        depends on BLACKMAGIC_ENABLE_RTT
        default n
        help
            set optional rtt secret.

    config BLACKMAGIC_RTT_IDENT
        string "rtt ident"
        depends on BLACKMAGIC_ENABLE_RTT_IDENT
        default ""
        help
            optional rtt secret. '%' is converted to ' ' space.

    config BLACKMAGIC_ENABLE_DEBUG
        bool "debug output"
        default n
        help
            If enabled, debug output is written to the aux port.
            Useful when debugging blackmagic probe.

    choice
        prompt "Version"
        help
            Select the package version

        config PKG_USING_BLACKMAGIC_LATEST_VERSION
            bool "latest"
    endchoice

    config PKG_BLACKMAGIC_VER
       string
       default "v1.10.2"   if PKG_USING_BLACKMAGIC_V1_10_2
       default "latest"    if PKG_USING_BLACKMAGIC_LATEST_VERSION

    config BLACKMAGIC_VERSION
        string
        default PKG_BLACKMAGIC_VER
        help
            hidden string, follows PKG_BLACKMAGIC_VER, used in version.h

endif
```

## tools/bs8116a/Kconfig
```kconfig
# Kconfig file for package bs8116a
menuconfig PKG_USING_BS8116A
    bool "bs8116a: Touch key of HOLTEK BS8116A-3."
    default n

if PKG_USING_BS8116A

    config PKG_BS8116A_PATH
        string
        default "/packages/tools/bs8116a"

    config PKG_USING_BS8116A_EXAMPLE
        bool "use BS8116A-3 example."
        default y

    choice
        prompt "Version"
        default PKG_USING_BS8116A_LATEST_VERSION
        help
            Select the package version

        config PKG_USING_BS8116A_V010
            bool "v0.1.0"

        config PKG_USING_BS8116A_LATEST_VERSION
            bool "latest"
    endchoice
          
    config PKG_BS8116A_VER
       string
       default "v0.1.0"    if PKG_USING_BS8116A_V010
       default "latest"    if PKG_USING_BS8116A_LATEST_VERSION

endif
```
