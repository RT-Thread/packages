## system/aUnity/Kconfig
```kconfig
# Kconfig file for package aUnity
menuconfig PKG_USING_AUNITY
    bool "a unity pkgs support for all Libs."
    default n

if PKG_USING_AUNITY

    config PKG_AUNITY_PATH
        string
        default "/packages/system/aUnity"

    choice
        prompt "Version"
        help
            Select the package version

        config PKG_USING_AUNITY_LATEST_VERSION
            bool "latest"
    endchoice

    config PKG_AUNITY_VER
       string
       default "latest"    if PKG_USING_AUNITY_LATEST_VERSION

endif
```

## system/acceleration/Kconfig
```kconfig
menu "acceleration: Assembly language or algorithmic acceleration packages"

rsource "Qfplib_M0_full/Kconfig"
rsource "Qfplib_M0_tiny/Kconfig"
rsource "Qfplib_M3/Kconfig"

endmenu
```

## system/acceleration/Qfplib_M0_full/Kconfig
```kconfig
# Kconfig file for package Qfplib_M0_full
menuconfig PKG_USING_QFPLIB_M0_FULL
    bool "Qfplib-M0-full: a free, fast and compact ARM Cortex-M0 floating-point library"
    default n

if PKG_USING_QFPLIB_M0_FULL

    config PKG_QFPLIB_M0_FULL_PATH
        string
        default "/packages/system/acceleration/Qfplib_M0_full"

    choice
        prompt "Version"
        default PKG_USING_QFPLIB_M0_FULL_LATEST_VERSION
        help
            Select the package version

        config PKG_USING_QFPLIB_M0_FULL_LATEST_VERSION
            bool "latest"
    endchoice

    config PKG_QFPLIB_M0_FULL_VER
       string
       default "latest"    if PKG_USING_QFPLIB_M0_FULL_LATEST_VERSION

endif
```

## system/acceleration/Qfplib_M0_tiny/Kconfig
```kconfig
# Kconfig file for package Qfplib_M0_tiny
menuconfig PKG_USING_QFPLIB_M0_TINY
    bool "Qfplib-M0-tiny: a free ARM Cortex-M0 floating-point library in 1 kbyte"
    default n

if PKG_USING_QFPLIB_M0_TINY

    config PKG_QFPLIB_M0_TINY_PATH
        string
        default "/packages/system/acceleration/Qfplib_M0_tiny"

    choice
        prompt "Version"
        default PKG_USING_QFPLIB_M0_TINY_LATEST_VERSION
        help
            Select the package version

        config PKG_USING_QFPLIB_M0_TINY_LATEST_VERSION
            bool "latest"
    endchoice

    config PKG_QFPLIB_M0_TINY_VER
       string
       default "latest"    if PKG_USING_QFPLIB_M0_TINY_LATEST_VERSION

endif
```

## system/acceleration/Qfplib_M3/Kconfig
```kconfig
# Kconfig file for package Qfplib_M3
menuconfig PKG_USING_QFPLIB_M3
    bool "Qfplib-M3: a free, fast and accurate ARM Cortex-M3 floating-point library"
    default n

if PKG_USING_QFPLIB_M3

    config PKG_QFPLIB_M3_PATH
        string
        default "/packages/system/acceleration/Qfplib_M3"

    choice
        prompt "Version"
        default PKG_USING_QFPLIB_M3_LATEST_VERSION
        help
            Select the package version

        config PKG_USING_QFPLIB_M3_LATEST_VERSION
            bool "latest"
    endchoice

    config PKG_QFPLIB_M3_VER
       string
       default "latest"    if PKG_USING_QFPLIB_M3_LATEST_VERSION

endif
```

## system/agile_upgrade/Kconfig
```kconfig
# Kconfig file for package agile_upgrade
menuconfig PKG_USING_AGILE_UPGRADE
    bool "agile_upgrade: Middleware for fast building bootloader."
    default n

if PKG_USING_AGILE_UPGRADE

    config PKG_AGILE_UPGRADE_PATH
        string
        default "/packages/system/agile_upgrade"

    config AGILE_UPGRADE_ENABLE_LOG
        bool "Enable debug log output"
        default y

    config AGILE_UPGRADE_ENABLE_AES
        bool "Enable AES decrypt"
        default n
        select PKG_USING_TINYCRYPT
        select TINY_CRYPT_AES

    if AGILE_UPGRADE_ENABLE_AES

        config AGILE_UPGRADE_AES_IV
            string "Set AES Initialization vector, 16 characters"
            default "0123456789ABCDEF"

        config AGILE_UPGRADE_AES_KEY
            string "Set AES keys, 32 characters"
            default "0123456789ABCDEF0123456789ABCDEF"

    endif

    config AGILE_UPGRADE_ENABLE_FASTLZ
        bool "Enable fastlz decompress"
        default n
        select PKG_USING_FASTLZ

    config AGILE_UPGRADE_ENABLE_QUICKLZ
        bool "Enable quicklz decompress"
        default n
        select PKG_USING_QUICKLZ

    config AGILE_UPGRADE_ENABLE_FAL
        bool "Enable fal adapter"
        default n
        select PKG_USING_FAL if RT_VER_NUM < 0x40100
        select RT_USING_FAL if RT_VER_NUM >= 0x40100

    config AGILE_UPGRADE_ENABLE_FILE
        bool "Enable file adapter"
        default n
        select RT_USING_DFS if RT_VER_NUM < 0x40100
        select RT_USING_LIBC if RT_VER_NUM < 0x40100
        select RT_USING_POSIX_FS if RT_VER_NUM >= 0x40100

    config AGILE_UPGRADE_ENABLE_VERSION_COMPARE
        bool "Enable version compare"
        default n

    choice
        prompt "Version"
        default PKG_USING_AGILE_UPGRADE_LATEST_VERSION
        help
            Select the package version

        config PKG_USING_AGILE_UPGRADE_LATEST_VERSION
            bool "latest"
    endchoice

    config PKG_AGILE_UPGRADE_VER
       string
       default "latest"    if PKG_USING_AGILE_UPGRADE_LATEST_VERSION

    config PKG_AGILE_UPGRADE_VER_NUM
        hex
        default 0x99999    if PKG_USING_AGILE_UPGRADE_LATEST_VERSION

endif
```

## system/cairo/Kconfig
```kconfig
menuconfig PKG_USING_CAIRO
    bool "Cairo - Multi-platform 2D graphics library"
    select PKG_USING_PIXMAN
    select RT_USING_PTHREADS
    default n

if PKG_USING_CAIRO

    config PKG_CAIRO_PATH
        string
        default "/packages/system/cairo"

    choice
        prompt "version"
        help
            Select the persimmon version

        config PKG_USING_CAIRO_LATEST_VERSION
            bool "latest"

        config PKG_USING_CAIRO_V1102
            bool "v1.10.2"
        config PKG_USING_CAIRO_V11412
            bool "v1.14.12"
    endchoice

    config PKG_CAIRO_VER
        string
        default "v1.10.2" if PKG_USING_CAIRO_V1102
        default "v1.14.12" if PKG_USING_CAIRO_V11412
        default "latest" if PKG_USING_CAIRO_LATEST_VERSION
endif
```

## system/enhanced-kservice/Kconfig
```kconfig
menu "enhanced kernel services"

source "$PKGS_DIR/packages/system/enhanced-kservice/rt_memcpy_cm/Kconfig"
source "$PKGS_DIR/packages/system/enhanced-kservice/rt_kprintf_threadsafe/Kconfig"
source "$PKGS_DIR/packages/system/enhanced-kservice/rt_vsnprintf_full/Kconfig"

endmenu
```

## system/enhanced-kservice/rt_kprintf_threadsafe/Kconfig
```kconfig
# Kconfig file for package rt_kprintf_threadsafe
menuconfig PKG_USING_RT_KPRINTF_THREADSAFE
    bool "rt_kprintf_threadsafe: thread-safe version of rt_kprintf"
    default n

if PKG_USING_RT_KPRINTF_THREADSAFE

    config PKG_RT_KPRINTF_THREADSAFE_PATH
        string
        default "/packages/system/enhanced-kservice/rt_kprintf_threadsafe"

    choice
        prompt "Version"
        help
            Select the package version

        config PKG_USING_RT_KPRINTF_THREADSAFE_LATEST_VERSION
            bool "latest"
    endchoice

    config PKG_RT_KPRINTF_THREADSAFE_VER
       string
       default "latest"    if PKG_USING_RT_KPRINTF_THREADSAFE_LATEST_VERSION

endif
```

## system/enhanced-kservice/rt_memcpy_cm/Kconfig
```kconfig
# Kconfig file for package rt_memcpy_cm
menuconfig PKG_USING_RT_MEMCPY_CM
    bool "rt_memcpy_cm: Cortex-M kernel assembly accelerated version of rt_memcpy function"
    select RT_KLIBC_USING_USER_MEMCPY if RT_VER_NUM >= 0x50200
    default n

if PKG_USING_RT_MEMCPY_CM

    config PKG_RT_MEMCPY_CM_PATH
        string
        default "/packages/system/enhanced-kservice/rt_memcpy_cm"

    choice
        prompt "Version"
        default PKG_USING_RT_MEMCPY_CM_LATEST_VERSION
        help
            Select the package version

        config PKG_USING_RT_MEMCPY_CM_LATEST_VERSION
            bool "latest"
    endchoice

    config PKG_RT_MEMCPY_CM_VER
       string
       default "latest"    if PKG_USING_RT_MEMCPY_CM_LATEST_VERSION

endif
```

## system/enhanced-kservice/rt_vsnprintf_full/Kconfig
```kconfig
# Kconfig file for package rt_vsnprintf_full
menuconfig PKG_USING_RT_VSNPRINTF_FULL
    bool "rt_vsnprintf_full: fully functional version of rt_vsnprintf"
    depends on RT_VER_NUM < 0x50200
    default n

if PKG_USING_RT_VSNPRINTF_FULL

    config PKG_RT_VSNPRINTF_FULL_PATH
        string
        default "/packages/system/enhanced-kservice/rt_vsnprintf_full"

    config PKG_VSNPRINTF_SUPPORT_DECIMAL_SPECIFIERS
        bool "Support decimal notation floating point conversion specifiers (%f, %F)"
        default y
        help
            Support for the decimal notation floating point conversion specifiers (%f, %F)

    config PKG_VSNPRINTF_SUPPORT_EXPONENTIAL_SPECIFIERS
        bool "Support exponential notation floating point conversion specifiers (%e, %g, %E, %G)"
        default y
        help
            Support for the exponential notation floating point conversion specifiers (%e, %g, %E, %G)

    config PKG_VSNPRINTF_SUPPORT_WRITEBACK_SPECIFIER
        bool "Support length write-back specifier (%n)"
        default y
        help
            Support for the length write-back specifier (%n)

    config PKG_VSNPRINTF_SUPPORT_LONG_LONG
        bool "Support long long integral types"
        default y
        help
            Support for the long long integral types (with the ll, z and t length modifiers for specifiers
            %d,%i,%o,%x,%X,%u, and with the %p specifier). Note: 'L' (long double) is not supported.

    config PKG_VSNPRINTF_CHECK_FOR_NUL_IN_FORMAT_SPECIFIER
        bool "saft check: no NULL end string"
        default y
        help
            Be extra-safe, and don't assume format specifiers are completed correctly
            before the format string end.

    config PKG_VSNPRINTF_SUPPORT_MSVC_STYLE_INTEGER_SPECIFIERS
        bool "Support MSVC style integer specifiers"
        default n
        help
            the integer format specifiers used in Microsoft's Visual C++ (MSVC) compiler.
            These specifiers, like %I64d for 64-bit integers, deviate slightly from the standard
            C format specifiers and are specific to MSVC. They allow for controlled formatting of
            integers in printf()-like functions, accommodating different integer sizes and ensuring
            compatibility with MSVC's environment. It's important to note that these specifiers might
            not be recognized or function in other compilers due to their MSVC-specific nature.

    config PKG_VSNPRINTF_INTEGER_BUFFER_SIZE
        int "'ntoa' conversion buffer size"
        default 32
        help
            'ntoa' conversion buffer size, this must be big enough to hold one converted
            numeric number including padded zeros (dynamically created on stack)

    config PKG_VSNPRINTF_DECIMAL_BUFFER_SIZE
        int "printing individual decimal numbers buffer size"
        default 32
        help
            size of the fixed (on-stack) buffer for printing individual decimal numbers.
            this must be big enough to hold one converted floating-point value including
            padded zeros.

    config PKG_VSNPRINTF_DEFAULT_FLOAT_PRECISION
        int "floating point conversion specifiers"
        default 6
        help
            Default precision for the floating point conversion specifiers (the C standard sets this at 6)

    config PKG_VSNPRINTF_MAX_INTEGRAL_DIGITS_FOR_DECIMAL
        int "integral nums printed as float in rt_vsnprint"
        default 9
        help
            According to the C languages standard, printf() and related functions must be able to print any
            integral number in floating-point notation, regardless of length, when using the %f specifier -
            possibly hundreds of characters, potentially overflowing your buffers. In this implementation,
            all values beyond this threshold are switched to exponential notation.

    config PKG_VSNPRINTF_LOG10_TAYLOR_TERMS
        int "the number of terms in a Taylor series expansion of log_10(x)"
        default 4
        range 2 99
        help
            The number of terms in a Taylor series expansion of log_10(x) to
            use for approximation - including the power-zero term (i.e. the
            value at the point of expansion).

    if RT_VER_NUM >= 0x40100
        config RT_VSNPRINTF_FULL_REPLACING_SPRINTF
            bool "Enable to take over 'sprintf'"
            default n

        config RT_VSNPRINTF_FULL_REPLACING_SNPRINTF
            bool "Enable to take over 'snprintf'"
            default n

        config RT_VSNPRINTF_FULL_REPLACING_PRINTF
            bool "Enable to take over 'printf'"
            default n

        config RT_VSNPRINTF_FULL_REPLACING_VSPRINTF
            bool "Enable to take over 'vsprintf'"
            default n

        config RT_VSNPRINTF_FULL_REPLACING_VSNPRINTF
            bool "Enable to take over 'vsnprintf'"
            default n
    endif

    choice
        prompt "Version"
        default PKG_USING_RT_VSNPRINTF_FULL_LATEST_VERSION
        help
            Select the package version

        config PKG_USING_RT_VSNPRINTF_FULL_LATEST_VERSION
            bool "latest"
    endchoice

    config PKG_RT_VSNPRINTF_FULL_VER
       string
       default "latest"    if PKG_USING_RT_VSNPRINTF_FULL_LATEST_VERSION

endif
```

## system/event_loop/Kconfig
```kconfig
# Kconfig file for package event_loop
menuconfig PKG_USING_EVENT_LOOP
    bool "Event loop (delayed dispatch: mq + soft one-shot timer)"
    default n
    select RT_USING_MESSAGEQUEUE
    select RT_USING_MUTEX
    select RT_USING_TIMER_SOFT
    help
        Delay table processing runs only in the soft-timer callback (system timer thread):
        RT_TIMER_FLAG_ONE_SHOT | RT_TIMER_FLAG_SOFT_TIMER. No extra el_tmr worker thread.
        Public API: evt_loop_push_delayed / evt_loop_remove_delayed and
        macros EVT_LOOP_PUSH, EVT_LOOP_REMOVE, EVT_LOOP_REMOVE_WITH_ARGS.

if PKG_USING_EVENT_LOOP

    config PKG_EVENT_LOOP_PATH
        string
        default "/packages/system/event_loop"

    config EVENT_LOOP_MAX_EVENT_CNT
        int "Maximum delayed slots in table"
        default 32
        help
          Fixed table size for pending delayed events.

    config EVENT_LOOP_MSGQ_DEPTH
        int "Message queue depth (immediate + due callbacks)"
        default 15
        help
          rt_mq capacity for evt_loop_handle_t messages.

    config EVENT_LOOP_THREAD_STACK_SIZE
        int "Event loop thread stack size (bytes)"
        default 3072

    config EVENT_LOOP_THREAD_PRIORITY
        int "Event loop thread priority (smaller = higher)"
        default 12
        range 0 31
        help
          Must be strictly greater than RT_TIMER_THREAD_PRIO in rtconfig.h so the
          soft-timer daemon (lower number) preempts evt_loop. Example: timer prio 4,
          use 12 here.

    config EVENT_LOOP_USING_SAMPLES
        bool "Build event_loop sample (event_loop_test.c)"
        default n
        help
          Registers MSH command event_loop_test (when FINSH enabled).

    choice
        prompt "Version"
        default PKG_USING_EVENT_LOOP_V100
        help
            Select the package version

        config PKG_USING_EVENT_LOOP_V100
            bool "v1.0.0"

        config PKG_USING_EVENT_LOOP_LATEST_VERSION
            bool "latest"
    endchoice

    config PKG_EVENT_LOOP_VER
       string
       default "v1.0.0"    if PKG_USING_EVENT_LOOP_V100
       default "latest"    if PKG_USING_EVENT_LOOP_LATEST_VERSION

endif
```
