## iot/lssdp/Kconfig
```kconfig
# Kconfig file for package lssdp
menuconfig PKG_USING_LSSDP
    bool "Lssdp: SSDP protocol implemented on rt-thread"
    default n
    select RT_USING_SAL
    select SAL_USING_POSIX

if PKG_USING_LSSDP

    config PKG_LSSDP_PATH
        string
        default "/packages/iot/lssdp"

    config LSSDP_USING_SAMPLES
        bool "Enable LSSDP add/del samples"
        default n

    config LSSDP_ENABLE_DEBUG_MESSAGES
        bool "Enable LSSDP debug messages"
        default n

    choice
        prompt "Version"
        default PKG_USING_LSSDP_LATEST_VERSION
        help
            Select the package version

        config PKG_USING_LSSDP_V010
            bool "v0.1.0"

        config PKG_USING_LSSDP_LATEST_VERSION
            bool "latest"
    endchoice

    config PKG_LSSDP_VER
       string
       default "v0.1.0"    if PKG_USING_LSSDP_V010
       default "latest"    if PKG_USING_LSSDP_LATEST_VERSION

endif
```

## iot/lwip/Kconfig
```kconfig
config PKG_USING_LWIP
    bool
    depends on RT_VER_NUM >= 0x50000
    default n

if PKG_USING_LWIP
    config PKG_LWIP_PATH
        string
        default "/packages/iot/lwip"

    config PKG_LWIP_VER
        string
        default "latest" if RT_USING_LWIP_LATEST
        default "v1.4.1" if RT_USING_LWIP141
        default "v2.0.3" if RT_USING_LWIP203
        default "v2.1.3" if RT_USING_LWIP213
endif
```

## iot/matter-adaptation-layer/Kconfig
```kconfig
# Kconfig file for package MATTER-Adaptation_Layer
menuconfig PKG_USING_MATTER_ADAPTATION_LAYER
    bool "Matter protocol stack porting on RT-Thread based on guidance from Connectivity Standards Alliance (CSA) Working Group."
    default n

if PKG_USING_MATTER_ADAPTATION_LAYER

    config PKG_MATTER_ADAPTATION_LAYER_PATH
        string
        default "/packages/iot/matter-adaptation-layer"

    choice
        prompt "Version"
        default PKG_USING_MATTER_ADAPTATION_LAYER_LATEST_VERSION
        help
            Select the package version

        config PKG_USING_MATTER_ADAPTATION_LAYER_LATEST_VERSION
            bool "latest"
    endchoice

    config PKG_MATTER_ADAPTATION_LAYER_VER
       string
       default "latest" if PKG_USING_MATTER_ADAPTATION_LAYER_LATEST_VERSION

endif
```

## iot/mavlink/Kconfig
```kconfig
# Kconfig file for package mavlink
menuconfig PKG_USING_MAVLINK
    bool "MAVLink: A very lightweight messaging protocol for communicating."
    default n

if PKG_USING_MAVLINK

    config PKG_MAVLINK_PATH
        string
        default "/packages/iot/mavlink"

    choice
        prompt "Version"
        default PKG_USING_MAVLINK_LATEST_VERSION
        help
            Select the package version

        config PKG_USING_MAVLINK_LATEST_VERSION
            bool "latest"
    endchoice

    choice
        prompt "Dialect"
        default PKG_USING_MAVLINK_DIALECT_standard
        help
            Select the dialect you want to use

        config PKG_USING_MAVLINK_DIALECT_minimal
            bool "minimal"
        config PKG_USING_MAVLINK_DIALECT_common
            bool "common"
        config PKG_USING_MAVLINK_DIALECT_standard
            bool "standard"
        config PKG_USING_MAVLINK_DIALECT_test
            bool "test"
        config PKG_USING_MAVLINK_DIALECT_uAvionix
            bool "uAvionix"
        config PKG_USING_MAVLINK_DIALECT_matrixpilot
            bool "matrixpilot"
        config PKG_USING_MAVLINK_DIALECT_icarous
            bool "icarous"
        config PKG_USING_MAVLINK_DIALECT_autoquad
            bool "autoquad"
        config PKG_USING_MAVLINK_DIALECT_ASLUAV
            bool "ASLUAV"
        config PKG_USING_MAVLINK_DIALECT_ardupilotmega
            bool "ardupilotmega"
    endchoice

    config PKG_MAVLINK_VER
       string
       default "latest"           if PKG_USING_MAVLINK_LATEST_VERSION

endif
```

## iot/mongoose/Kconfig
```kconfig
menuconfig PKG_USING_MONGOOSE
    bool "mongoose: Embedded Web Server / Embedded Networking Library"
    default n

if PKG_USING_MONGOOSE

    config PKG_MONGOOSE_PATH
        string
        default "/packages/iot/mongoose"

    config PKG_MONGOOSE_ENABLE_HTTP_WEBSOCKET
        bool
        prompt "Enable WebSocket extension to HTTP"
        default y

    config PKG_MONGOOSE_ENABLE_FILESYSTEM
        bool
        prompt "Enable filesystem for file serves, file uploader and other file features"
        default y
        select RT_USING_DFS      if RT_VER_NUM < 0x40100
        select RT_USING_POSIX_FS if RT_VER_NUM >= 0x40100

    config PKG_MONGOOSE_ENABLE_HTTP_STREAMING_MULTIPART
        bool
        prompt "Enable multipart events when using http multipart file uploader"
        default n

    config PKG_MONGOOSE_ENABLE_MQTT
        bool
        prompt "Enable MQTT protocol"
        default n

    config PKG_MONGOOSE_ENABLE_COAP
        bool
        prompt "Enable CoAP protocol"
        default n

    config PKG_MONGOOSE_ENABLE_DEBUG
        bool
        prompt "Enable show more debug informaiton"
        default n

    config PKG_MONGOOSE_ENABLE_HEXDUMP
        bool
        prompt "Dump hex formation debug informaiton"
        default n
        depends on PKG_MONGOOSE_ENABLE_DEBUG

    choice
        prompt "Version"
        help
            Select the mongoose version

        config PKG_USING_MONGOOSE_V607
            bool "v6.7"

        config PKG_USING_MONGOOSE_LATEST_VERSION
            bool "latest"
    endchoice

    config PKG_MONGOOSE_VER
        string
        default "v6.7" if PKG_USING_MONGOOSE_V607
        default "latest" if PKG_USING_MONGOOSE_LATEST_VERSION
endif
```

## iot/mqttclient/Kconfig
```kconfig
# Kconfig file for package mqttclient
menuconfig PKG_USING_MQTTCLIENT
    bool "mqttclient: A mqttclient based on the socket API, support QoS2, mbedtls."
    default n

if PKG_USING_MQTTCLIENT

    config PKG_MQTTCLIENT_PATH
        string
        default "/packages/iot/mqttclient"
    
    config MQTT_NETWORK_TYPE_TLS
        bool "enable mbedtls"
        default n

    if MQTT_NETWORK_TYPE_TLS
        config MQTT_TLS_HANDSHAKE_TIMEOUT
            int "mbedtls handshake timeout"
            default 5000
    endif

    config LOG_IS_SALOF
        bool "enable salof"
        default y
    
    if LOG_IS_SALOF
        config USE_LOG
            bool "use log"
            default y
        
        if USE_LOG
            config USE_SALOF
                bool "use salof"
                default y
            
            if !USE_IDLE_HOOK
                if USE_SALOF
                    config SALOF_BUFF_SIZE
                        int "salof buff size"
                        default 512

                    config SALOF_FIFO_SIZE
                        int "salof fifo size"
                        default 2048
                    
                    config SALOF_THREAD_STACK_SIZE
                        int "salof thread size"
                        default 2048

                    config SALOF_THREAD_TICK
                        int "salof thread tick"
                        default 50
                endif 
            endif

            config LOG_COLOR
                bool "use color"
                default n

            config LOG_TS
                bool "use timestamp"
                default n

            config LOG_TAR
                bool "use tar"
                default n
            
            config USE_IDLE_HOOK
                bool "use idle thread hook"
                default n
        endif
    endif

    config LOG_LEVEL
        int "select output log level"
        default 5
        help
            1 : ASSERT_LEVEL
            2 : ERR_LEVEL
            3 : WARN_LEVEL
            4 : INFO_LEVEL
            5 : DEBUG_LEVEL

    config MQTT_VERSION
        int "mqtt version, 4 is mqtt 3.1.1, 3 is mqtt 3.1"
        default 4

    config MQTT_KEEP_ALIVE_INTERVAL
        int "mqtt keep alive interver, unit: second"
        default 100

    config MQTT_THREAD_STACK_SIZE
        int "mqtt thread stack size"
        default 4096

    config MQTT_THREAD_PRIO
        int "mqtt thread priority"
        default 5

    config MQTT_THREAD_TICK
        int "mqtt thread tick"
        default 50

    config MQTT_MAX_PACKET_ID
        int "mqtt max packet id"
        default 0xFFFE

    config MQTT_TOPIC_LEN_MAX
        int "mqtt max topic len"
        default 64

    config MQTT_ACK_HANDLER_NUM_MAX
        int "mqtt max handler number"
        default 64

    config MQTT_DEFAULT_BUF_SIZE
        int "mqtt default buffer size"
        default 1024

    config MQTT_DEFAULT_CMD_TIMEOUT
        int "mqtt default cmd timeout"
        default 4000

    config MQTT_MAX_CMD_TIMEOUT
        int "mqtt max cmd timeout"
        default 20000

    config MQTT_MIN_CMD_TIMEOUT
        int "mqtt min cmd timeout"
        default 1000

    config MQTT_RECONNECT_DEFAULT_DURATION
        int "mqtt default reconnect duratton"
        default 1000


    config PKG_USING_MQTTCLIENT_TEST
        bool "enable mqttclient test"
        default n
    
    choice
        prompt "Version"
        default PKG_USING_MQTTCLIENT_LATEST_VERSION
        help
            Select the package version

        config PKG_USING_MQTTCLIENT_V100
            bool "v1.0.0"

        config PKG_USING_MQTTCLIENT_LATEST_VERSION
            bool "latest"
    endchoice
          
    config PKG_MQTTCLIENT_VER
       string
       default "v1.0.0"    if PKG_USING_MQTTCLIENT_V100
       default "latest"    if PKG_USING_MQTTCLIENT_LATEST_VERSION

endif
```

## iot/mymqtt/Kconfig
```kconfig
# Kconfig file for package mymqtt
menuconfig PKG_USING_MYMQTT
    bool "MY MQTT：Eclipse Paho MQTT C/C++ client, A new efficient and stable way to realize for rt-thread."
    default n

if PKG_USING_MYMQTT

    config PKG_MYMQTT_PATH
        string
        default "/packages/iot/mymqtt"

    choice
        prompt "Version"
        default PKG_USING_MYMQTT_LATEST_VERSION
        help
            Select the package version

        config PKG_USING_MYMQTT_LATEST_VERSION
            bool "latest"
    endchoice
	
	config PKG_USING_MYMQTT_EXAMPLE
        bool "Enable MQTT example"
        default n

    config PKG_USING_MYMQTT_TEST
        bool "Enable MQTT test"
        default n

    config MQTT_USING_TLS
        bool "Enable support tls protocol"
        default n
        select PKG_USING_MBEDTLS

    config MQTT_MAX_MESSAGE_HANDLERS
        int "Max mymqtt subscribe topic handlers"
        default 1
        help
            Max mymqtt subscribe topic handlers

    config MQTT_DEBUG
        bool "Enable debug log output"
        default y
          
    config PKG_MYMQTT_VER
       string
       default "v1.0.0"    if PKG_USING_MYMQTT_V100
       default "latest"    if PKG_USING_MYMQTT_LATEST_VERSION

endif
```

## iot/nanopb/Kconfig
```kconfig
menuconfig PKG_USING_NANOPB
    bool "nanopb: Protocol Buffers for Embedded Systems"
    default n

if PKG_USING_NANOPB

    config PKG_NANOPB_PATH
        string
        default "/packages/iot/nanopb"

    config PKG_NANOPB_VER
        string
        default "v1.0.0"

endif
```

## iot/net_server/Kconfig
```kconfig
# Kconfig file for package net_server
menuconfig PKG_USING_NET_SERVER
    bool "net_server:TCP/TLS server,support wolfssl"
    select RT_USING_SAL             if RT_VER_NUM < 0x40100
    select SAL_USING_POSIX          if RT_VER_NUM < 0x40100
    select RT_USING_DFS             if RT_VER_NUM < 0x40100
    select RT_USING_POSIX_FS        if RT_VER_NUM >= 0x40100
    select RT_USING_POSIX_SOCKET    if RT_VER_NUM >= 0x40100
    default n

if PKG_USING_NET_SERVER

    config PKG_NET_SERVER_PATH
        string
        default "/packages/iot/net_server"

    choice
        prompt "Version"
        default PKG_USING_NET_SERVER_V102
        help
            Select the package version
        config PKG_USING_NET_SERVER_V102
            bool "v1.0.2"

        config PKG_USING_NET_SERVER_V101
            bool "v1.0.1"

        config PKG_USING_NET_SERVER_V100
            bool "v1.0.0"

        config PKG_USING_NET_SERVER_LATEST_VERSION
            bool "latest"
    endchoice

    config NET_SERVER_TCP_EXAMPLE
        bool "Use TCP Server example"
        default n

    config NET_SERVER_USING_TLS
        bool "Enable TLS support"
        default n

    if NET_SERVER_USING_TLS
        choice
            prompt "tls port file"
            help
                Select which tls port file to use

            config NET_SERVER_WOLFSSL
                bool "wolfSSL port"
        endchoice


        config NET_SERVER_TLS_EXAMPLE
        bool "Use tls server example"
        default n

    endif

    config PKG_NET_SERVER_VER
       string
       default "v1.0.2"    if PKG_USING_NET_SERVER_V102
       default "v1.0.1"    if PKG_USING_NET_SERVER_V101
       default "v1.0.0"    if PKG_USING_NET_SERVER_V100
       default "latest"    if PKG_USING_NET_SERVER_LATEST_VERSION

endif
```
