## arduino/sensors/Adafruit-LSM303DLH-Mag/Kconfig
```kconfig
# Kconfig file for package Adafruit-LSM303DLH-Mag
menuconfig PKG_USING_ARDUINO_ADAFRUIT_LSM303DLH_MAG
    bool "Adafruit LSM303DLH: Magnetometer Sensor"
    select PKG_USING_RTDUINO
    select RTDUINO_USING_WIRE
    select PKG_USING_ARDUINO_ADAFRUIT_SENSOR
    select PKG_USING_ARDUINO_ADAFRUIT_BUSIO
    default n

if PKG_USING_ARDUINO_ADAFRUIT_LSM303DLH_MAG

    config PKG_ARDUINO_ADAFRUIT_LSM303DLH_MAG_PATH
        string
        default "/packages/arduino/sensors/Adafruit-LSM303DLH-Mag"

    choice
        prompt "Version"
        default PKG_USING_ARDUINO_ADAFRUIT_LSM303DLH_MAG_LATEST_VERSION
        help
            Select the package version

        config PKG_USING_ARDUINO_ADAFRUIT_LSM303DLH_MAG_LATEST_VERSION
            bool "latest"
    endchoice

    config PKG_ARDUINO_ADAFRUIT_LSM303DLH_MAG_VER
       string
       default "latest"    if PKG_USING_ARDUINO_ADAFRUIT_LSM303DLH_MAG_LATEST_VERSION

endif
```

## arduino/sensors/Adafruit-LSM303DLHC/Kconfig
```kconfig
# Kconfig file for package Adafruit-LSM303DLHC
menuconfig PKG_USING_ARDUINO_ADAFRUIT_LSM303DLHC
    bool "Adafruit LSM303DLHC: Accelerometer and Magnetometer Sensor"
    select PKG_USING_RTDUINO
    select PKG_USING_ARDUINO_ADAFRUIT_SENSOR
    default n

if PKG_USING_ARDUINO_ADAFRUIT_LSM303DLHC

    config PKG_ARDUINO_ADAFRUIT_LSM303DLHC_PATH
        string
        default "/packages/arduino/sensors/Adafruit-LSM303DLHC"

    choice
        prompt "Version"
        default PKG_USING_ARDUINO_ADAFRUIT_LSM303DLHC_LATEST_VERSION
        help
            Select the package version

        config PKG_USING_ARDUINO_ADAFRUIT_LSM303DLHC_LATEST_VERSION
            bool "latest"
    endchoice

    config PKG_ARDUINO_ADAFRUIT_LSM303DLHC_VER
       string
       default "latest"    if PKG_USING_ARDUINO_ADAFRUIT_LSM303DLHC_LATEST_VERSION

endif
```

## arduino/sensors/Adafruit-LSM6DS/Kconfig
```kconfig
# Kconfig file for package Adafruit-LSM6DS
menuconfig PKG_USING_ARDUINO_ADAFRUIT_LSM6DS
    bool "Adafruit LSM6DS 6-DoF Accelerometer and Gyroscope Sensor"
    select PKG_USING_RTDUINO
    select RTDUINO_USING_WIRE
    select PKG_USING_ARDUINO_ADAFRUIT_SENSOR
    select PKG_USING_ARDUINO_ADAFRUIT_BUSIO
    default n

if PKG_USING_ARDUINO_ADAFRUIT_LSM6DS

    config PKG_ARDUINO_ADAFRUIT_LSM6DS_PATH
        string
        default "/packages/arduino/sensors/Adafruit-LSM6DS"

    choice
        prompt "Version"
        default PKG_USING_ARDUINO_ADAFRUIT_LSM6DS_LATEST_VERSION
        help
            Select the package version

        config PKG_USING_ARDUINO_ADAFRUIT_LSM6DS_LATEST_VERSION
            bool "latest"
    endchoice

    config PKG_ARDUINO_ADAFRUIT_LSM6DS_VER
       string
       default "latest"    if PKG_USING_ARDUINO_ADAFRUIT_LSM6DS_LATEST_VERSION

endif
```

## arduino/sensors/Adafruit-LSM9DS0-Library/Kconfig
```kconfig
# Kconfig file for package Adafruit-LSM9DS0-Library
menuconfig PKG_USING_ARDUINO_ADAFRUIT_LSM9DS0_LIBRARY
    bool "Adafruit triaxial accelerometer/magnetometer/gyroscope LSM9DS0 library"
    select PKG_USING_RTDUINO
    select RTDUINO_USING_WIRE
    select RTDUINO_USING_SPI
    select PKG_USING_ARDUINO_ADAFRUIT_SENSOR
    default n

if PKG_USING_ARDUINO_ADAFRUIT_LSM9DS0_LIBRARY

    config PKG_ARDUINO_ADAFRUIT_LSM9DS0_LIBRARY_PATH
        string
        default "/packages/arduino/sensors/Adafruit-LSM9DS0-Library"

    choice
        prompt "Version"
        default PKG_USING_ARDUINO_ADAFRUIT_LSM9DS0_LIBRARY_LATEST_VERSION
        help
            Select the package version

        config PKG_USING_ARDUINO_ADAFRUIT_LSM9DS0_LIBRARY_LATEST_VERSION
            bool "latest"
    endchoice

    config PKG_ARDUINO_ADAFRUIT_LSM9DS0_LIBRARY_VER
       string
       default "latest"    if PKG_USING_ARDUINO_ADAFRUIT_LSM9DS0_LIBRARY_LATEST_VERSION

endif
```

## arduino/sensors/Adafruit-LSM9DS0/Kconfig
```kconfig
# Kconfig file for package Adafruit-LSM9DS0
menuconfig PKG_USING_ARDUINO_ADAFRUIT_LSM9DS0
    bool "Adafruit LSM9DS0 triaxial accelerometer/magnetometer/gyroscope sensor driver"
    select PKG_USING_RTDUINO
    select RTDUINO_USING_WIRE
    select RTDUINO_USING_SPI
    select PKG_USING_ARDUINO_ADAFRUIT_SENSOR
    default n

if PKG_USING_ARDUINO_ADAFRUIT_LSM9DS0

    config PKG_ARDUINO_ADAFRUIT_LSM9DS0_PATH
        string
        default "/packages/arduino/sensors/Adafruit-LSM9DS0"

    choice
        prompt "Version"
        default PKG_USING_ARDUINO_ADAFRUIT_LSM9DS0_LATEST_VERSION
        help
            Select the package version

        config PKG_USING_ARDUINO_ADAFRUIT_LSM9DS0_LATEST_VERSION
            bool "latest"
    endchoice

    config PKG_ARDUINO_ADAFRUIT_LSM9DS0_VER
       string
       default "latest"    if PKG_USING_ARDUINO_ADAFRUIT_LSM9DS0_LATEST_VERSION

endif
```

## arduino/sensors/Adafruit-LSM9DS1/Kconfig
```kconfig
# Kconfig file for package Adafruit-LSM9DS1
menuconfig PKG_USING_ARDUINO_ADAFRUIT_LSM9DS1
    bool "Adafruit LSM9DS1 triple-axis accelerometer/magnetometer/gyroscope sensor"
    select PKG_USING_RTDUINO
    select RTDUINO_USING_WIRE
    select RTDUINO_USING_SPI
    select PKG_USING_ARDUINO_ADAFRUIT_SENSOR
    select PKG_USING_ARDUINO_ADAFRUIT_BUSIO
    select PKG_USING_ARDUINO_ADAFRUIT_LIS3MDL
    default n

if PKG_USING_ARDUINO_ADAFRUIT_LSM9DS1

    config PKG_ARDUINO_ADAFRUIT_LSM9DS1_PATH
        string
        default "/packages/arduino/sensors/Adafruit-LSM9DS1"

    choice
        prompt "Version"
        default PKG_USING_ARDUINO_ADAFRUIT_LSM9DS1_LATEST_VERSION
        help
            Select the package version

        config PKG_USING_ARDUINO_ADAFRUIT_LSM9DS1_LATEST_VERSION
            bool "latest"
    endchoice

    config PKG_ARDUINO_ADAFRUIT_LSM9DS1_VER
       string
       default "latest"    if PKG_USING_ARDUINO_ADAFRUIT_LSM9DS1_LATEST_VERSION

endif
```

## arduino/sensors/Adafruit-LTR329-LTR303/Kconfig
```kconfig
# Kconfig file for package Adafruit-LTR329-LTR303
menuconfig PKG_USING_ARDUINO_ADAFRUIT_LTR329_LTR303
    bool "Adafruit LTR329-LTR303: Light Sensor"
    select PKG_USING_RTDUINO
    select RTDUINO_USING_WIRE
    select PKG_USING_ARDUINO_ADAFRUIT_SENSOR
    select PKG_USING_ARDUINO_ADAFRUIT_BUSIO
    default n

if PKG_USING_ARDUINO_ADAFRUIT_LTR329_LTR303

    config PKG_ARDUINO_ADAFRUIT_LTR329_LTR303_PATH
        string
        default "/packages/arduino/sensors/Adafruit-LTR329-LTR303"

    choice
        prompt "Version"
        default PKG_USING_ARDUINO_ADAFRUIT_LTR329_LTR303_LATEST_VERSION
        help
            Select the package version

        config PKG_USING_ARDUINO_ADAFRUIT_LTR329_LTR303_LATEST_VERSION
            bool "latest"
    endchoice

    config PKG_ARDUINO_ADAFRUIT_LTR329_LTR303_VER
       string
       default "latest"    if PKG_USING_ARDUINO_ADAFRUIT_LTR329_LTR303_LATEST_VERSION

endif
```

## arduino/sensors/Adafruit-LTR390/Kconfig
```kconfig
# Kconfig file for package Adafruit-LTR390
menuconfig PKG_USING_ARDUINO_ADAFRUIT_LTR390
    bool "Adafruit LTR390: UV Sensor"
    select PKG_USING_RTDUINO
    select RTDUINO_USING_WIRE
    select PKG_USING_ARDUINO_ADAFRUIT_BUSIO
    default n

if PKG_USING_ARDUINO_ADAFRUIT_LTR390

    config PKG_ARDUINO_ADAFRUIT_LTR390_PATH
        string
        default "/packages/arduino/sensors/Adafruit-LTR390"

    choice
        prompt "Version"
        default PKG_USING_ARDUINO_ADAFRUIT_LTR390_LATEST_VERSION
        help
            Select the package version

        config PKG_USING_ARDUINO_ADAFRUIT_LTR390_LATEST_VERSION
            bool "latest"
    endchoice

    config PKG_ARDUINO_ADAFRUIT_LTR390_VER
       string
       default "latest"    if PKG_USING_ARDUINO_ADAFRUIT_LTR390_LATEST_VERSION

endif
```
