## iot/rtt_lorawan_driver/Kconfig
```kconfig
# Kconfig file for package rtt_lorawan_driver
menuconfig PKG_USING_RTT_LORAWAN_DRIVER
    bool "RTT_LoRaWAN_Driver : Support for LoRaWAN Network(Semtech)"
    default n

if PKG_USING_RTT_LORAWAN_DRIVER

    config PKG_RTT_LORAWAN_DRIVER_PATH
        string
        default "/packages/iot/rtt_lorawan_driver"

	choice
        prompt "Work Mode"
        default ClassA
        help
            Select the Work Mode
        config BSP_USING_LoRaWAN_ClassA
            bool ClassA
        config BSP_USING_LoRaWAN_ClassC
            bool ClassC
    endchoice
	choice
        prompt "Join Mode"
        default ABP
        help
            Select the Join Mode
        config BSP_USING_LoRaWAN_OTAA
            bool OTAA

        config BSP_USING_LoRaWAN_ABP
            bool ABP
    endchoice
	choice
	prompt "Select the RF frequency"
	default REGION_CN470
	help
		Select the RF frequency

	config REGION_EU433
		bool "LORAMAC_REGION_EU433"

	config REGION_CN470
		bool "LORAMAC_REGION_CN470"

	config REGION_EU868
		bool "LORAMAC_Region EU868"

	endchoice

	config LORAWAN_DEFAULT_DATARATE
	int "LORAWAN_DEFAULT_DATARATE"
    range 1 5
    default 5

	config LORAWAN_APP_PORT
	int "LORAWAN_APP_PORT"
    range 0 255
    default 3

	config BSP_USING_LoRaWAN_Example
    bool "Enable Example"
    default y
	
    choice
        prompt "Version"
        default PKG_USING_RTT_LORAWAN_DRIVER_LATEST_VERSION
        help
            Select the package version

        config PKG_USING_RTT_LORAWAN_DRIVER_V100
            bool "v1.0.0"

        config PKG_USING_RTT_LORAWAN_DRIVER_LATEST_VERSION
            bool "latest"
    endchoice
          
    config PKG_RTT_LORAWAN_DRIVER_VER
       string
       default "v1.0.0"    if PKG_USING_RTT_LORAWAN_DRIVER_V100
       default "latest"    if PKG_USING_RTT_LORAWAN_DRIVER_LATEST_VERSION

endif
```

## iot/small_modbus/Kconfig
```kconfig
# Kconfig file for package small_modbus
menuconfig PKG_USING_SMALL_MODBUS
    bool "small modbus"
    default n

if PKG_USING_SMALL_MODBUS

    config PKG_SMALL_MODBUS_PATH
        string
        default "/packages/iot/small_modbus"

    choice
        prompt "Version"
        default PKG_SMALL_MODBUS_LATEST_VERSION
        help
            Select the package version

        config PKG_SMALL_MODBUS_V100
            bool "v1.0.0"

        config PKG_SMALL_MODBUS_LATEST_VERSION
            bool "latest"
    endchoice

    config PKG_SMALL_MODBUS_VER
       string
       default "v1.0.0"    if PKG_SMALL_MODBUS_V100
       default "latest"    if PKG_SMALL_MODBUS_LATEST_VERSION
endif
```

## iot/smtp_client/Kconfig
```kconfig
menuconfig PKG_USING_SMTP_CLIENT
    bool "smtp_client:smtp client package for rt-thread"
    default n
    select RT_USING_SAL
    select SAL_USING_POSIX
    select RT_USING_DFS

if PKG_USING_SMTP_CLIENT

    config PKG_SMTP_CLIENT_PATH
        string
        default "/packages/iot/smtp_client"

    choice
        prompt "Version"
        default PKG_USING_SMTP_CLIENT_LATEST_VERSION
        help
            Select the package version

        config PKG_USING_SMTP_CLIENT_V100
            bool "v1.0.0"

        config PKG_USING_SMTP_CLIENT_LATEST_VERSION
            bool "latest"
    endchoice

    config SMTP_CLIENT_USING_TLS
        bool "use 465/587 port(encrypted port)"
        default n
        select PKG_USING_MBEDTLS
        select PKG_USING_MBEDTLS_DIGICERT_ROOT_CA

    config SMTP_CLIENT_ENABLE_DEBUG_LOG
        bool "enable debug log information"
        default n

    config PKG_SMTP_CLIENT_VER
       string
       default "v1.0.0"    if PKG_USING_SMTP_CLIENT_V100
       default "latest"    if PKG_USING_SMTP_CLIENT_LATEST_VERSION

    menu "smtp_client Options"
        config SMTP_CLIENT_USING_SAMPLE
            bool
            prompt "smtp client example"
            default n
    endmenu       

endif
```

## iot/tcpserver/Kconfig
```kconfig
# Kconfig file for package tcpserver
menuconfig PKG_USING_TCPSERVER
    bool "TCP Server:A TCP server that supports multiple clients"
    select RT_USING_SAL
    select SAL_USING_POSIX
    default n

if PKG_USING_TCPSERVER

    config TCPSERVER_NAME
        string "tcpserver name"
        default "tcpserv"
    config TCPSERVER_STACK_SIZE
        int "tcpserver stack size"
        default 4096
    config TCPSERVER_PRIO
        int "tcpserver thread priority"
        default 12
    config TCPSERVER_SOCKET_MAX
        int "Maximum possible socket usage"
        default 512
    config TCPSERVER_CLI_NUM
        int "Number of clients supported"
        default 5
    config PKG_TCPSERVER_DEBUG
        bool "Enable debugging features"
        default n
    config PKG_TCPSERVER_SAMPLE
        bool "Enable sample"
        default n
    config PKG_TCPSERVER_PATH
        string
        default "/packages/iot/tcpserver"

    choice
        prompt "Version"
        default PKG_USING_TCPSERVER_LATEST_VERSION
        help
            Select the package version

        config PKG_USING_TCPSERVER_V001
            bool "v0.0.1"

        config PKG_USING_TCPSERVER_LATEST_VERSION
            bool "latest"
    endchoice
          
    config PKG_TCPSERVER_VER
       string
       default "v0.0.1"    if PKG_USING_TCPSERVER_V001
       default "latest"    if PKG_USING_TCPSERVER_LATEST_VERSION

endif
```

## iot/umqtt/Kconfig
```kconfig
# Kconfig file for package umqtt
menuconfig PKG_USING_UMQTT
    bool "umqtt: A light weight, powerful, customizable, easy-to-use and embeddable mqtt client for RT-Thread"
    default n
    select RT_USING_TIMER_SOFT
    select RT_USING_SAL

if PKG_USING_UMQTT

    config PKG_USING_UMQTT_EXAMPLE
        bool "Enable MQTT example"
        default n

    config PKG_UMQTT_SUBRECV_DEF_LENGTH
        int "subtopic name list numbers"
        default 4
    config PKG_UMQTT_INFO_DEF_SENDSIZE
        int "send buffer size"
        default 1024
    config PKG_UMQTT_INFO_DEF_RECVSIZE
        int "receive buffer size"
        default 1024
    config PKG_UMQTT_USING_DEBUG
        bool "Enable using umqtt debug"
        default n
    config PKG_UMQTT_INFO_DEF_RECONNECT_MAX_NUM
        int "reconnect max count"
        default 5
    config PKG_UMQTT_INFO_DEF_RECONNECT_INTERVAL
        int  "reconnect time interval, uint:Sec"
        default 60
    config PKG_UMQTT_INFO_DEF_KEEPALIVE_MAX_NUM
        int "keepalive func, max count"
        default 5
    config PKG_UMQTT_INFO_DEF_HEARTBEAT_INTERVAL
        int "heartbeat interval, uint:Sec"
        default 30
    config PKG_UMQTT_INFO_DEF_CONNECT_TIMEOUT
        int "connect timeout, uint:Sec"
        default 4
    config PKG_UMQTT_INFO_DEF_RECV_TIMEOUT_MS
        int "receive timeout, uint:mSec"
        default 100
    config PKG_UMQTT_INFO_DEF_SEND_TIMEOUT
        int "send timeout, uint:Sec"
        default 4
    config PKG_UMQTT_INFO_DEF_THREAD_STACK_SIZE
        int "receive thread stask size, (2048, 32767)"
        range 2048 32767
        default 2048
    config PKG_UMQTT_INFO_DEF_THREAD_PRIORITY
        int "thread priority"
        default 8
    config PKG_UMQTT_MSG_QUEUE_ACK_DEF_SIZE
        int "async message ack queue count"
        default 4
    config PKG_UMQTT_CONNECT_KEEPALIVE_DEF_TIME
        hex "connect information, keepalive interval, uint:Sec"
        default 0xffff

    if PKG_USING_UMQTT_TEST
        config PKG_UMQTT_TEST_SHORT_KEEPALIVE_TIME
            bool "Enable change connect keepalive time, uint:Sec"
            default n
    endif

    config PKG_UMQTT_PATH
        string
        default "/packages/iot/umqtt"

    config PKG_UMQTT_PUBLISH_RECON_MAX
        int "republish qos2 max times, (1, 32767)"
        range 1 32767
        default 3

    config PKG_UMQTT_QOS2_QUE_MAX
        int "qos2 publish buffer size, (1, 32767)"
        range 1 32767
        default 1

    choice
        prompt "Version"
        default PKG_USING_UMQTT_V100
        help
            Select the package version

        config PKG_USING_UMQTT_V100
            bool "v1.0.0"

        config PKG_USING_UMQTT_LATEST_VERSION
            bool "latest"
    endchoice

    config PKG_UMQTT_VER
       string
       default "v1.0.0"    if PKG_USING_UMQTT_V100
       default "latest"    if PKG_USING_UMQTT_LATEST_VERSION

endif
```

## iot/web_terminal/Kconfig
```kconfig
config PKG_USING_WEB_TERMINAL
    bool "Terminal runs in a Web browser"
    default n

if PKG_USING_WEB_TERMINAL

    config PKG_WEB_TERMINAL_PATH
        string
        default "/packages/iot/web_terminal"
    
    config PKG_WEB_TERMINAL_VER
        string
        default "0.1.2"

    select PKG_USING_MONGOOSE

    config PKG_WEB_TERMINAL_PORT
        string
        prompt "The port number for Web terminal"
        default "8090"

endif
```

## iot/webclient/Kconfig
```kconfig
menuconfig PKG_USING_WEBCLIENT
    bool "WebClient: A HTTP/HTTPS Client for RT-Thread"
    default n

if PKG_USING_WEBCLIENT

    config PKG_WEBCLIENT_PATH
        string
        default "/packages/iot/webclient"

    if PKG_WEBCLIENT_VER_NUM > 0x10000

        config WEBCLIENT_DEBUG
            bool "Enable debug log output"
            default n

        config WEBCLIENT_USING_SAMPLES
            bool "Enable webclient GET/POST samples"
            default n

    endif

    if PKG_WEBCLIENT_VER_NUM > 0x20100

        config WEBCLIENT_USING_FILE_DOWMLOAD
            bool "Enable file download feature support"
            default n
            select RT_USING_DFS

    endif

    if PKG_WEBCLIENT_VER_NUM >= 0x20100

        choice

            prompt "Select TLS mode"
            default WEBCLIENT_NOT_USE_TLS

            config WEBCLIENT_NOT_USE_TLS
                bool "Not support"

            config WEBCLIENT_USING_SAL_TLS
                bool "SAL TLS support"
                select SAL_USING_TLS

            config WEBCLIENT_USING_MBED_TLS
                bool "MbedTLS support"
                select PKG_USING_MBEDTLS

        endchoice

    endif

    if (PKG_WEBCLIENT_VER_NUM >= 0x10000) && (PKG_WEBCLIENT_VER_NUM <= 0x20001)

        config WEBCLIENT_USING_TLS
            bool "Enable support tls protocol"
            default n
            select PKG_USING_MBEDTLS

    endif

    choice

        prompt "Version"
        help
            Select the webclient version
        default PKG_USING_WEBCLIENT_V212
        
        config PKG_USING_WEBCLIENT_V212
            bool "v2.1.2"

        config PKG_USING_WEBCLIENT_V211
            bool "v2.1.1"

        config PKG_USING_WEBCLIENT_V210
            bool "v2.1.0"

        config PKG_USING_WEBCLIENT_V201
            bool "v2.0.1"

        config PKG_USING_WEBCLIENT_V200
            bool "v2.0.0"

        config PKG_USING_WEBCLIENT_V100
            bool "v1.0.0"

        config PKG_USING_WEBCLIENT_LATEST_VERSION
            bool "latest"

    endchoice

    config PKG_WEBCLIENT_VER
       string
       default "v2.1.2"    if PKG_USING_WEBCLIENT_V212
       default "v2.1.1"    if PKG_USING_WEBCLIENT_V211
       default "v2.1.0"    if PKG_USING_WEBCLIENT_V210
       default "v2.0.1"    if PKG_USING_WEBCLIENT_V201
       default "v2.0.0"    if PKG_USING_WEBCLIENT_V200
       default "v1.0.0"    if PKG_USING_WEBCLIENT_V100
       default "latest"    if PKG_USING_WEBCLIENT_LATEST_VERSION

   config PKG_WEBCLIENT_VER_NUM
        hex
        default 0x99999    if PKG_USING_WEBCLIENT_LATEST_VERSION
        default 0x20102    if PKG_USING_WEBCLIENT_V212
        default 0x20101    if PKG_USING_WEBCLIENT_V211
        default 0x20100    if PKG_USING_WEBCLIENT_V210
        default 0x20001    if PKG_USING_WEBCLIENT_V201
        default 0x20000    if PKG_USING_WEBCLIENT_V200
        default 0x10000    if PKG_USING_WEBCLIENT_V100

endif
```

## iot/webnet/Kconfig
```kconfig
# Kconfig file for package webnet
menuconfig PKG_USING_WEBNET
    bool "WebNet: A lightweight, customizable, embeddable Web Server for RT-Thread"
    select RT_USING_SAL             if RT_VER_NUM < 0x40100
    select SAL_USING_POSIX          if RT_VER_NUM < 0x40100
    select RT_USING_DFS             if RT_VER_NUM < 0x40100
    select RT_USING_POSIX_FS        if RT_VER_NUM >= 0x40100
    select RT_USING_POSIX_SOCKET    if RT_VER_NUM >= 0x40100
    default n

if PKG_USING_WEBNET

    config PKG_WEBNET_PATH
        string
        default "/packages/iot/webnet"

    config WEBNET_PORT
        int "Server listen port"
        default 80
        range 0 65535

    config WEBNET_CONN_MAX
        int "Maximum number of server connections"
        default 16
        range 1 100

    config WEBNET_ROOT
        string "Server root directory"
        default "/webnet"

    menu "Select supported modules"

        config WEBNET_USING_LOG
            bool "LOG: Enable output log support"
            default n

        config WEBNET_USING_AUTH
            bool "AUTH: Enable basic HTTP authentication support"
            default n

        config WEBNET_USING_CGI
            bool "CGI: Enable Common Gateway Interface support"
            default n

        config WEBNET_USING_ASP
            bool "ASP: Enable Active Server Pages support"
            default n

        config WEBNET_USING_SSI
            bool "SSI: Enable Server Side Includes support"
            default n

        config WEBNET_USING_INDEX
            bool "INDEX: Enable list all the file in the directory support"
            default n

        config WEBNET_USING_ALIAS
            bool "ALIAS: Enable alias support"
            default n

        config WEBNET_USING_DAV
            bool "DAV: Enable Web-based Distributed Authoring and Versioning support"
            default n

        config WEBNET_USING_UPLOAD
            bool "UPLOAD: Enable upload file support"
            default n

        config WEBNET_USING_GZIP
            bool "GZIP: Enable compressed file support by GZIP"
            default n

        config WEBNET_CACHE_LEVEL
            int "CACHE: Configure cache level(0:disable 1:use Last-Modified 2:use Cache-Control)"
            default 0
            range 0 2

        if WEBNET_CACHE_LEVEL = 2

            config WEBNET_CACHE_MAX_AGE
            int "Cache-Control time in seconds"
            default 1800

        endif

        if WEBNET_USING_SSI

            config WEBNET_USING_SSI_VIRTUAL_HANDLER
                bool "SSI: Enable Virtual callback handler"
                depends on WEBNET_USING_SSI
                default n

        endif

    endmenu

    config WEBNET_USING_SAMPLES
        bool "Enable webnet samples"
        default n
        select WEBNET_USING_ASP
        select WEBNET_USING_AUTH
        select WEBNET_USING_CGI
        select WEBNET_USING_INDEX
        select WEBNET_USING_ALIAS
        select WEBNET_USING_SSI
        select WEBNET_USING_UPLOAD

    choice
        prompt "Version"
        help
            Select the webnet version
        default PKG_USING_WEBNET_V203

        config PKG_USING_WEBNET_V203
            bool "v2.0.3"

        config PKG_USING_WEBNET_V202
            bool "v2.0.2"

        config PKG_USING_WEBNET_V201
            bool "v2.0.1"

        config PKG_USING_WEBNET_V200
            bool "v2.0.0"

        config PKG_USING_WEBNET_LATEST_VERSION
            bool "latest"
    endchoice

    config PKG_WEBNET_VER
       string
       default "v2.0.3"    if PKG_USING_WEBNET_V203
       default "v2.0.2"    if PKG_USING_WEBNET_V202
       default "v2.0.1"    if PKG_USING_WEBNET_V201
       default "v2.0.0"    if PKG_USING_WEBNET_V200
       default "latest"    if PKG_USING_WEBNET_LATEST_VERSION

    config PKG_WEBNET_VER_NUM
        hex
        default 0x99999    if PKG_USING_WEBNET_LATEST_VERSION
        default 0x20000    if PKG_USING_WEBNET_V200
        default 0x20001    if PKG_USING_WEBNET_V201
        default 0x20002    if PKG_USING_WEBNET_V202
        default 0x20003    if PKG_USING_WEBNET_V203

endif
```
