## misc/samples/Kconfig
```kconfig
menu "samples: kernel and components samples"

rsource "kernel_samples/Kconfig"
rsource "filesystem_samples/Kconfig"
rsource "network_samples/Kconfig"
rsource "peripheral_samples/Kconfig"

endmenu
```

## misc/samples/filesystem_samples/Kconfig
```kconfig
# Kconfig file for package filesystem_samples
menuconfig PKG_USING_FILESYSTEM_SAMPLES
    bool "a filesystem_samples package for rt-thread"
    default n
    select RT_USING_DFS      if RT_VER_NUM < 0x40100
    select RT_USING_POSIX_FS if RT_VER_NUM >= 0x40100

if PKG_USING_FILESYSTEM_SAMPLES

    config PKG_FILESYSTEM_SAMPLES_PATH
        string
        default "/packages/misc/samples/filesystem_samples"

    choice
        prompt "Version"
        default PKG_USING_FILESYSTEM_SAMPLES_LATEST_VERSION
        help
            Select the package version

        config PKG_USING_FILESYSTEM_SAMPLES_V020
            bool "v0.2.0"

        config PKG_USING_FILESYSTEM_SAMPLES_LATEST_VERSION
            bool "latest"
    endchoice

    config PKG_FILESYSTEM_SAMPLES_VER
       string
       default "v0.2.0"    if PKG_USING_FILESYSTEM_SAMPLES_V020
       default "latest"    if PKG_USING_FILESYSTEM_SAMPLES_LATEST_VERSION

    config FILESYSTEM_SAMPLES_USING_READWRITE
        bool "[filesystem] readwrite"

    config FILESYSTEM_SAMPLES_USING_STAT
        bool "[filesystem] stat"

    config FILESYSTEM_SAMPLES_USING_RENAME
        bool "[filesystem] rename"

    config FILESYSTEM_SAMPLES_USING_MKDIR
        bool "[filesystem] mkdir"

    config FILESYSTEM_SAMPLES_USING_OPENDIR
        bool "[filesystem] opendir"

    config FILESYSTEM_SAMPLES_USING_READDIR
        bool "[filesystem] readdir"

    config FILESYSTEM_SAMPLES_USING_TELL_SEEK_DIR
        bool "[filesystem] tell_seek_dir"

endif
```

## misc/samples/kernel/Kconfig
```kconfig
config PKG_USING_KERNEL_SAMPLES
    bool "A kernel sample package"
    default n

if PKG_USING_KERNEL_SAMPLES

    menu "kernel"
    config PKG_KERNEL_SAMPLES_PATH
        string
        default "/packages/misc/samples/kernel"

    config RT_USING_SAMPLE_THREAD
        bool "[kernel] thread"

    config RT_USING_SAMPLE_INTERRUPT
        bool "[kernel] interrupt and critical"

    config RT_USING_SAMPLE_SEMPHORE
        bool "[kernel] semphore"

    config RT_USING_SAMPLE_MUTEX
        bool "[kernel] mutex"

    config RT_USING_SAMPLE_MAILBOX
        bool "[kernel] mailbox"

    config RT_USING_SAMPLE_EVENT
        bool "[kernel] event"

    config RT_USING_SAMPLE_MESSAGEQUEUE
        bool "[kernel] message queue"

    config RT_USING_SAMPLE_TIMER
        bool "[kernel] timer"

    config RT_USING_SAMPLE_HEAP
        bool "[kernel] heap"

    config RT_USING_SAMPLE_MEMHEAP
        bool "[kernel] memheap"

    config RT_USING_SAMPLE_MEMPOOL
        bool "[kernel] mempool"

    config RT_USING_SAMPLE_IDLEHOOK
        bool "[kernel] idle hook"

    config RT_USING_SAMPLE_PRODUCER_CONSUMER
        bool "[kernel] producer_consumer"

    config RT_USING_SAMPLE_SIGNAL
        bool "[kernel] signal"

    choice
        prompt "samples version"
        help
            Select the samples version

        config PKG_USING_KERNEL_SAMPLES_LATEST_VERSION
            bool "latest"

    endchoice

    if PKG_USING_KERNEL_SAMPLES_LATEST_VERSION
       config PKG_KERNEL_SAMPLES_VER
       string
       default "latest"
    endif

    endmenu

endif
```

## misc/samples/kernel_samples/Kconfig
```kconfig
# Kconfig file for package kernel_samples
menuconfig PKG_USING_KERNEL_SAMPLES
    bool "a kernel_samples package for rt-thread"
    default n

if PKG_USING_KERNEL_SAMPLES

    config PKG_KERNEL_SAMPLES_PATH
        string
        default "/packages/misc/samples/kernel_samples"

    choice
        prompt "Version"
        default PKG_USING_KERNEL_SAMPLES_LATEST_VERSION
        help
            Select the package version

        config PKG_USING_KERNEL_SAMPLES_V030
            bool "v0.3.0"

        config PKG_USING_KERNEL_SAMPLES_V040
            bool "v0.4.0"

        config PKG_USING_KERNEL_SAMPLES_LATEST_VERSION
            bool "latest"
    endchoice

    config PKG_KERNEL_SAMPLES_VER
       string
       default "v0.3.0"    if PKG_USING_KERNEL_SAMPLES_V030
       default "v0.4.0"    if PKG_USING_KERNEL_SAMPLES_V040
       default "latest"    if PKG_USING_KERNEL_SAMPLES_LATEST_VERSION

    choice
        prompt "Comment language"
        default PKG_USING_KERNEL_SAMPLES_EN
        help
            Select the comment language

        config PKG_USING_KERNEL_SAMPLES_EN
            bool "English"

        config PKG_USING_KERNEL_SAMPLES_ZH
            bool "Chinese"
    endchoice

    config KERNEL_SAMPLES_USING_THREAD
        bool "[kernel] thread"

    config KERNEL_SAMPLES_USING_SEMAPHORE
        bool "[kernel] semphore"

    config KERNEL_SAMPLES_USING_MUTEX
        bool "[kernel] mutex"

    config KERNEL_SAMPLES_USING_MAILBOX
        bool "[kernel] mailbox"

    config KERNEL_SAMPLES_USING_EVENT
        bool "[kernel] event"

    config KERNEL_SAMPLES_USING_MESSAGEQUEUE
        bool "[kernel] message queue"

    config KERNEL_SAMPLES_USING_TIMER
        bool "[kernel] timer"

    config KERNEL_SAMPLES_USING_HEAP
        bool "[kernel] heap"

    config KERNEL_SAMPLES_USING_MEMPOOL
        bool "[kernel] mempool"

    config KERNEL_SAMPLES_USING_IDLEHOOK
        bool "[kernel] idle hook"

    config KERNEL_SAMPLES_USING_SIGNAL
        bool "[kernel] signal"
        select RT_USING_SIGNALS

    config KERNEL_SAMPLES_USING_INTERRUPT
        bool "[kernel] interrupt"

    config KERNEL_SAMPLES_USING_PRI_INVERSION
    bool "[kernel] priority inversion"

    config KERNEL_SAMPLES_USING_TIME_SLICE
    bool "[kernel] time slice"

    config KERNEL_SAMPLES_USING_SCHEDULER_HOOK
    bool "[kernel] sheduler hook"

    config KERNEL_SAMPLES_USING_PRODUCER_CONSUMER
    bool "[kernel] producer consumer model"

endif
```

## misc/samples/network_samples/Kconfig
```kconfig
# Kconfig file for package network_samples
menuconfig PKG_USING_NETWORK_SAMPLES
    bool "a network_samples package for rt-thread"
    select PKG_USING_CJSON
    select PKG_USING_WEBCLIENT
    select WEBCLIENT_USING_SAMPLES
    default n

if PKG_USING_NETWORK_SAMPLES

    config PKG_NETWORK_SAMPLES_PATH
        string
        default "/packages/misc/samples/network_samples"

    choice
        prompt "Version"
        default PKG_USING_NETWORK_SAMPLES_LATEST_VERSION
        help
            Select the package version

        config PKG_USING_NETWORK_SAMPLES_V030
            bool "v0.3.0"

        config PKG_USING_NETWORK_SAMPLES_LATEST_VERSION
            bool "latest"
    endchoice

    config PKG_NETWORK_SAMPLES_VER
       string
       default "v0.3.0"    if PKG_USING_NETWORK_SAMPLES_V030
       default "latest"    if PKG_USING_NETWORK_SAMPLES_LATEST_VERSION

    config NETWORK_SAMPLES_USING_TCP_CLIENT
        bool "[network] tcp client"

    config NETWORK_SAMPLES_USING_TCP_SERVER
        bool "[network] tcp server"

    config NETWORK_SAMPLES_USING_UDP_CLIENT
        bool "[network] udp client"

    config NETWORK_SAMPLES_USING_UDP_SERVER
        bool "[network] udp server"

    config NETWORK_SAMPLES_USING_TCP_CLIENT_SELECT
        bool "[network] tcp client by select api"
        select RT_USING_POSIX_FS
        select RT_USING_POSIX_SOCKET

    config NETWORK_SAMPLES_USING_HTTP_CLIENT
        bool "[network] http client"
        select PKG_USING_WEBCLIENT
        select PKG_USING_CJSON
endif
```

## misc/samples/peripheral_samples/Kconfig
```kconfig
# Kconfig file for package peripheral_samples
menuconfig PKG_USING_PERIPHERAL_SAMPLES
    bool "a peripheral_samples package for rt-thread"
    default n
    select RT_USING_DEVICE

if PKG_USING_PERIPHERAL_SAMPLES

    config PKG_PERIPHERAL_SAMPLES_PATH
        string
        default "/packages/misc/samples/peripheral_samples"

    choice
        prompt "Version"
        default PKG_USING_PERIPHERAL_SAMPLES_V040
        help
            Select the package version

        config PKG_USING_PERIPHERAL_SAMPLES_V040
            bool "v0.4.0"

        config PKG_USING_PERIPHERAL_SAMPLES_LATEST_VERSION
            bool "latest"
    endchoice
          
    config PKG_PERIPHERAL_SAMPLES_VER
       string
       default "v0.4.0"    if PKG_USING_PERIPHERAL_SAMPLES_V040
       default "latest"    if PKG_USING_PERIPHERAL_SAMPLES_LATEST_VERSION

    config PERIPHERAL_SAMPLES_USING_ADC
        bool "[peripheral] adc device"
        select RT_USING_ADC

    config PERIPHERAL_SAMPLES_USING_HWTIMER
        bool "[peripheral] hwtimer device"
        select RT_USING_HWTIMER

    config PERIPHERAL_SAMPLES_USING_I2C
        bool "[peripheral] i2c device"
        select RT_USING_I2C

    config PERIPHERAL_SAMPLES_USING_IWDG
        bool "[peripheral] watchdog device"
        select RT_USING_WDT

    config PERIPHERAL_SAMPLES_USING_LED_BLINK
        bool "[peripheral] led blink"
        select RT_USING_PIN

    config PERIPHERAL_SAMPLES_USING_PIN
        bool "[peripheral] pin device"
        select RT_USING_PIN

    config PERIPHERAL_SAMPLES_USING_PWM
        bool "[peripheral] pwm device"
        select RT_USING_PWM

    config PERIPHERAL_SAMPLES_USING_RTC
        bool "[peripheral] rtc device"
        select RT_USING_RTC

    config PERIPHERAL_SAMPLES_USING_SD
        bool "[peripheral] block device sd card"

    config PERIPHERAL_SAMPLES_USING_SERIAL
        bool "[peripheral] serial device INT RX"
        select RT_USING_SERIAL

    config PERIPHERAL_SAMPLES_USING_SERIAL_DMA
        bool "[peripheral] serial device DMA RX"
        select RT_USING_SERIAL

    config PERIPHERAL_SAMPLES_USING_SPI
        bool "[peripheral] spi device"
        select RT_USING_SPI

    config PERIPHERAL_SAMPLES_USING_CAN
        bool "[peripheral] can device"
        select RT_USING_CAN
endif
```

## misc/signal_led/Kconfig
```kconfig
# Kconfig file for package signal_led
menuconfig PKG_USING_SIGNAL_LED
    bool "signal_led:a signal_led package for rt-thread"
    default n

if PKG_USING_SIGNAL_LED

    config PKG_SIGNAL_LED_PATH
        string
        default "/packages/misc/signal_led"

    choice
        prompt "Version"
        default PKG_USING_SIGNAL_LED_LATEST_VERSION
        help
            Select the package version

        config PKG_USING_SIGNAL_LED_V100
            bool "v1.0.0"

        config PKG_USING_SIGNAL_LED_LATEST_VERSION
            bool "latest"
    endchoice
          
    config PKG_SIGNAL_LED_VER
       string
       default "v1.0.0"    if PKG_USING_SIGNAL_LED_V100
       default "latest"    if PKG_USING_SIGNAL_LED_LATEST_VERSION

endif
```

## misc/slcan2rtt/Kconfig
```kconfig
# Kconfig file for package slcan2rtt
menuconfig PKG_USING_SLCAN2RTT
    bool "Serial / USB serial CAN Adapter (slcan) on RT-Thread."
    default n

if PKG_USING_SLCAN2RTT

    config PKG_SLCAN2RTT_PATH
        string
        default "/packages/misc/slcan2rtt"

    choice
        prompt "Version"
        default PKG_USING_SLCAN2RTT_LATEST_VERSION
        help
            Select the package version

        config PKG_USING_SLCAN2RTT_V001
            bool "v0.0.1"

        config PKG_USING_SLCAN2RTT_LATEST_VERSION
            bool "latest"
    endchoice

    config PKG_SLCAN2RTT_VER
       string
       default "v0.0.1"    if PKG_USING_SLCAN2RTT_V001
       default "latest"    if PKG_USING_SLCAN2RTT_LATEST_VERSION

endif
```

## misc/soem/Kconfig
```kconfig
# Kconfig file for package soem
menuconfig PKG_USING_SOEM
    bool "SOEM(Simple Open EtherCAT Master Library)."
    default n

if PKG_USING_SOEM

    config PKG_SOEM_PATH
        string
        default "/packages/misc/soem"

    choice
        prompt "Version"
        default PKG_USING_SOEM_LATEST_VERSION
        help
            Select the package version

        config PKG_USING_SOEM_V140
            bool "v1.4.0"

        config PKG_USING_SOEM_LATEST_VERSION
            bool "latest"
    endchoice

    config PKG_SOEM_VER
       string
       default "v1.4.0"    if PKG_USING_SOEM_V140
       default "latest"    if PKG_USING_SOEM_LATEST_VERSION

endif
```

## misc/state_machine/Kconfig
```kconfig
# Kconfig file for package state_machine
menuconfig PKG_USING_STATE_MACHINE
    bool "state_machine: A feature-rich, yet simple finite state machine (FSM) implementation in C"
    default n


if PKG_USING_STATE_MACHINE

    config PKG_STATE_MACHINE_PATH
        string
        default "/packages/misc/state_machine"

    config PKG_STATE_MACHINE_USING_EXAMPLE
        bool "Enable state_machine example"
        default n

    choice
        prompt "Version"
        default PKG_USING_STATE_MACHINE_LATEST_VERSION
        help
            Select the package version

        config PKG_USING_STATE_MACHINE_LATEST_VERSION
            bool "latest"
    endchoice

    config PKG_STATE_MACHINE_VER
       string
       default "latest"    if PKG_USING_STATE_MACHINE_LATEST_VERSION

endif
```

## misc/termbox/Kconfig
```kconfig
# Kconfig file for package termbox
menuconfig PKG_USING_TERMBOX
    bool "termbox: library for writing text-based user interfaces"
    select PKG_USING_WCWIDTH
    default n

if PKG_USING_TERMBOX

    config PKG_TERMBOX_PATH
        string
        default "/packages/misc/termbox"

    config TERMBOX_USING_DEMOS
        bool "Enable demos"
        default n

    choice
        prompt "Version"
        default PKG_USING_TERMBOX_LATEST_VERSION
        help
            Select the package version

        config PKG_USING_TERMBOX_LATEST_VERSION
            bool "latest"
    endchoice
  
    config PKG_TERMBOX_VER
       string
       default "latest"    if PKG_USING_TERMBOX_LATEST_VERSION

endif
```

## misc/threes/Kconfig
```kconfig
# Kconfig file for package threes
menuconfig PKG_USING_THREES
    bool "threes: An indie puzzle video game which was very popular in the year of 2014."
    select RT_USING_DFS
    select RT_USING_LIBC
    select RT_USING_POSIX
    select RT_USING_POSIX_TERMIOS
    default n


if PKG_USING_THREES

    config PKG_THREES_PATH
        string
        default "/packages/misc/threes"

    choice
        prompt "Version"
        default PKG_USING_THREES_LATEST_VERSION
        help
            Select the package version

        config PKG_USING_THREES_LATEST_VERSION
            bool "latest"
    endchoice
          
    config PKG_THREES_VER
       string
       default "latest"    if PKG_USING_THREES_LATEST_VERSION

endif
```

## misc/ukal/Kconfig
```kconfig
# Kconfig file for package ukal
menuconfig PKG_USING_UKAL
    select RT_USING_LIBC
    select PKG_USING_ULAPACK
    bool "ukal: Kalman filter based on ulapack."
    default n

if PKG_USING_UKAL

    config PKG_UKAL_PATH
        string
        default "/packages/misc/ukal"

    config UKAL_MAX_STATE_VECTOR_SIZE
        int "Maximum state vcector size"
        default "5"

    config UKAL_MAX_MEASUREMENT_VECTOR_SIZE
        int "Maximum state vector size"
        default "5"

    config UKAL_USING_EKAL
        bool "Extended Kalman filter example"
        help
            Extended Kalman filter example
        default n

    if ULAPACK_USE_DYNAMIC_ALLOC
        comment "Dymamic memory allocation selected from ulapack"
    endif

    if ULAPACK_USE_STATIC_ALLOC
        comment "Static memory allocation selected from ulapack"
    endif

    if ULAPACK_USE_STATIC_ALLOC
        config ULAPACK_MAX_MATRIX_N_ROWS
            int "Matrix maximum number of rows"
            default "20"

        config ULAPACK_MAX_MATRIX_N_COLS
            int "Matrix maximum number of columns"
            default "20"
    endif

    choice
        prompt "Version"
        default PKG_USING_UKAL_LATEST_VERSION
        help
            Select the package version
        config PKG_USING_UKAL_LATEST_VERSION
            bool "latest"
    endchoice

    config PKG_UKAL_VER
       string
       default "latest"    if PKG_USING_UKAL_LATEST_VERSION

    config PKG_UKAL_VER_NUM
        hex
        default 0x99999 if PKG_USING_UKAL_LATEST_VERSION

endif
```
