## system/yaffs2/Kconfig
```kconfig
menuconfig PKG_USING_DFS_YAFFS
    bool "yaffs: Yet Another Flash File System"
    default n

if PKG_USING_DFS_YAFFS

    config PKG_YAFFS_PATH
        string
        default "/packages/system/yaffs2"

    choice
        prompt "yaffs version"
        help
            Select the yaffs version

        config PKG_USING_YAFFS_LATEST_VERSION
            bool "latest"

        config PKG_USING_YAFFS_V100
            bool "v1.0.0"
    endchoice

    config PKG_YAFFS_VER
       string
       default "v1.0.0" if PKG_USING_YAFFS_V100
       default "latest" if PKG_USING_YAFFS_LATEST_VERSION

endif
```

## tools/Chinese_font_library/Kconfig
```kconfig
# Kconfig file for package Chinese_font_library
menuconfig PKG_USING_CHINESE_FONT_LIBRARY
    bool "Chinese_Font_Library: a Chinese font library for rt-thread"
    default n
select PKG_USING_FAL
select FAL_USING_SFUD_PORT
if PKG_USING_CHINESE_FONT_LIBRARY

    config PKG_CHINESE_FONT_LIBRARY_PATH
        string
        default "/packages/tools/Chinese_font_library"

    choice
        prompt "Version"
        default PKG_USING_CHINESE_FONT_LIBRARY_LATEST_VERSION
        help
            Select the package version

        config PKG_USING_CHINESE_FONT_LIBRARY_V100
            bool "v1.0.0"

        config PKG_USING_CHINESE_FONT_LIBRARY_LATEST_VERSION
            bool "latest"
    endchoice
          
    config PKG_CHINESE_FONT_LIBRARY_VER
       string
       default "v1.0.0"    if PKG_USING_CHINESE_FONT_LIBRARY_V100
       default "latest"    if PKG_USING_CHINESE_FONT_LIBRARY_LATEST_VERSION

endif
```

## tools/CmBacktrace/Kconfig
```kconfig
menuconfig PKG_USING_CMBACKTRACE
    bool "CmBacktrace: Advanced fault backtrace library for ARM Cortex-M series MCU."
    default n

if PKG_USING_CMBACKTRACE

    config CMBACKTRACE_FIRMWARE_NAME
        string "Firmware name for CmBacktrace log identification"
        default "rt-thread"

    config CMBACKTRACE_HARDWARE_VER
        string "Hardware version for CmBacktrace log identification"
        default "1.0"

    config CMBACKTRACE_SOFTWARE_VER
        string "Software version for CmBacktrace log identification"
        default "1.0"

    choice
        prompt "CPU Platform"
        default PKG_CMBACKTRACE_PLATFORM_M0_M0PLUS if ARCH_ARM_CORTEX_M0
        default PKG_CMBACKTRACE_PLATFORM_M3 if ARCH_ARM_CORTEX_M3
        default PKG_CMBACKTRACE_PLATFORM_M4 if ARCH_ARM_CORTEX_M4
        default PKG_CMBACKTRACE_PLATFORM_M7 if ARCH_ARM_CORTEX_M7
        default PKG_CMBACKTRACE_PLATFORM_M33 if ARCH_ARM_CORTEX_M33
        default PKG_CMBACKTRACE_PLATFORM_NOT_SELECTED
        help
          Select the ARM Cortex-M CPU Platform of your device
        config PKG_CMBACKTRACE_PLATFORM_M0_M0PLUS
            bool "Cortex-M0/M0+"
        config PKG_CMBACKTRACE_PLATFORM_M3
            bool "Cortex-M3"
        config PKG_CMBACKTRACE_PLATFORM_M4
            bool "Cortex-M4"
        config PKG_CMBACKTRACE_PLATFORM_M7
            bool "Cortex-M7"
        config PKG_CMBACKTRACE_PLATFORM_M33
            bool "Cortex-M33"
        config PKG_CMBACKTRACE_PLATFORM_NOT_SELECTED
            bool "Not selected, please select"
    endchoice

    config PKG_CMBACKTRACE_DUMP_STACK
        bool
        prompt "Dump the thread or main stack info"
        default y
        help
          Dump the stack information when a fault occurs. It will add a lot of print information.

    choice
        prompt "Language of print information"
        default PKG_CMBACKTRACE_PRINT_ENGLISH
        help
          Select the language of print information when a fault occurs
        config PKG_CMBACKTRACE_PRINT_ENGLISH
            bool "Engish"
        config PKG_CMBACKTRACE_PRINT_CHINESE
            bool "Chinese (zh_CN.GB18030)"
        if PKG_CMBACKTRACE_VER_NUM > 0x10400
            config PKG_CMBACKTRACE_PRINT_CHINESE_UTF8
                bool "Chinese (zh_CN.UTF-8)"
        endif
    endchoice

    if PKG_CMBACKTRACE_VER_NUM > 0x10300
        config CMB_USING_FAL_FLASH_LOG
            bool
            prompt "Save the log to FAL flash partition"
            default n
            select PKG_USING_FAL if RT_VER_NUM < 0x40100
            select RT_USING_FAL if RT_VER_NUM >= 0x40100
            help
              The log will save to the FAL flash partition when case hardfault and assert.

        config CMB_USING_FAL_BACKUP_LOG_TO_FILE
            bool
            prompt "Backup the flash log to file when next reboot"
            default y
            depends on CMB_USING_FAL_FLASH_LOG
            select RT_USING_DFS      if RT_VER_NUM < 0x40100

        config CMB_FAL_FLASH_LOG_PART
            string "The flash partition name for saving log"
            default "cmb_log"
            depends on CMB_USING_FAL_FLASH_LOG
            help
                The patition name is defined in FAL partiton table. Please make sure it has enough space.

        config CMB_FLASH_LOG_PART_WG
            int "Flash log partition write granularity (in bytes)"
            default 8
            help
                Specifies the write granularity of the flash memory used for the log partition.
                This value must be a power of 2 (e.g., 1, 2, 4, 8, 16) and should match the
                'write_gran' property of your flash device in the FAL configuration.
                Check your MCU's datasheet or BSP's FAL setup for the correct value.

        config CMB_LOG_FILE_PATH
            string "The backup log file's path"
            default "/log/cmb.log"
            depends on CMB_USING_FAL_BACKUP_LOG_TO_FILE
    endif

    config PKG_CMBACKTRACE_ENABLE_TEST
    bool "Enable MSH test commands for CmBacktrace"
    default n
    help
        If you select this option, MSH commands like 'cmb_test' will be
        compiled. This allows you to trigger faults (e.g., division by
        zero, unaligned access) from the console to test the backtrace
        functionality.
        Disable this for release versions to save code size.

    config PKG_CMBACKTRACE_PATH
        string
        default "/packages/tools/CmBacktrace"

    choice
        prompt "Version"
        default PKG_USING_CMBACKTRACE_V10401
        help
            Select the this package version

        config PKG_USING_CMBACKTRACE_V10401
            bool "v1.4.1"

        config PKG_USING_CMBACKTRACE_V10400
            bool "v1.4.0"

        config PKG_USING_CMBACKTRACE_V10300
            bool "v1.3.0"

        config PKG_USING_CMBACKTRACE_V10202
            bool "v1.2.2"

        config PKG_USING_CMBACKTRACE_V10200
            bool "v1.2.0"

        config PKG_USING_CMBACKTRACE_LATEST_VERSION
            bool "latest"
    endchoice

    config PKG_CMBACKTRACE_VER
        string
        default "v1.4.1" if PKG_USING_CMBACKTRACE_V10401
        default "v1.4.0" if PKG_USING_CMBACKTRACE_V10400
        default "v1.3.0" if PKG_USING_CMBACKTRACE_V10300
        default "v1.2.2" if PKG_USING_CMBACKTRACE_V10202
        default "v1.2.0" if PKG_USING_CMBACKTRACE_V10200
        default "latest" if PKG_USING_CMBACKTRACE_LATEST_VERSION

    config PKG_CMBACKTRACE_VER_NUM
        hex
        default 0x10401    if PKG_USING_CMBACKTRACE_V10401
        default 0x10400    if PKG_USING_CMBACKTRACE_V10400
        default 0x10300    if PKG_USING_CMBACKTRACE_V10300
        default 0x10202    if PKG_USING_CMBACKTRACE_V10202
        default 0x10200    if PKG_USING_CMBACKTRACE_V10200
        default 0x99999    if PKG_USING_CMBACKTRACE_LATEST_VERSION

endif
```

## tools/CoreMark/Kconfig
```kconfig
menuconfig PKG_USING_COREMARK
    bool "COREMARK : a benchmark that measures the performance of MCUs and CPUs."
    default n

if PKG_USING_COREMARK

    config COREMARK_USE_FLOAT
        select RT_USING_LIBC
        bool "Show benchmark result in float number"
        help
            Show benchmark result in float number.
        default n

    config COREMARK_ITERATIONS
        int "Run the benchmark for a specified number of iterations."
        default "3600"
    comment "You may ajust this number to make sure the benchmark runs for at least 10s"

    config PKG_COREMARK_PATH
        string
        default "/packages/tools/CoreMark"

    choice
        prompt "Version"
        default PKG_USING_COREMARK_LATEST_VERSION
        help
            Select the this package version
            
        config PKG_USING_COREMARK_LATEST_VERSION
            bool "latest"
    endchoice

    config PKG_COREMARK_VER
        string
        default "latest" if PKG_USING_COREMARK_LATEST_VERSION

    config CORE_MARK_HAS_FLOAT
        int
        default 1 if COREMARK_USE_FLOAT
        default 0
endif
```

## tools/EasyFlash/Kconfig
```kconfig
menuconfig PKG_USING_EASYFLASH
    bool "EasyFlash: Lightweight embedded flash memory library."
    default n

if PKG_USING_EASYFLASH

    config PKG_EASYFLASH_PATH
        string
        default "/packages/tools/EasyFlash"

    config PKG_EASYFLASH_ENV
        bool
        prompt "ENV: Environment variables"
        default y

    if PKG_EASYFLASH_ENV

        if PKG_EASYFLASH_VER_NUM < 0x40000
            choice
                prompt "ENV mode"
                default PKG_EASYFLASH_ENV_USING_NORMAL
                    config PKG_EASYFLASH_ENV_USING_NORMAL
                    bool "Normal mode"

                config PKG_EASYFLASH_ENV_USING_WL_MODE
                    bool "Wear leveling mode"

                config PKG_EASYFLASH_ENV_USING_PFS_MODE
                    bool "Power fail safeguard mode"

                config PKG_EASYFLASH_ENV_USING_WL_PFS_MODE
                    bool "Wear leveling and power fail safeguard mode"

            endchoice

            config PKG_EASYFLASH_ENV_SETTING_SIZE
                int
                prompt "ENV setting size. MUST be word alignment"
                default 2048
        endif

        config PKG_EASYFLASH_ENV_AUTO_UPDATE
            bool
            prompt "Auto update ENV to latest default when current ENV version number is changed."
            default n

        if PKG_EASYFLASH_ENV_AUTO_UPDATE
            config PKG_EASYFLASH_ENV_VER_NUM
                int
                prompt "Setting current ENV version number"
                default 0
        endif

    endif

    config PKG_EASYFLASH_LOG
        bool
        prompt "LOG: Save logs on flash"
        default n

        if PKG_EASYFLASH_LOG
            config PKG_EASYFLASH_LOG_AREA_SIZE
            int
            prompt "Saved log area size. MUST be aligned by erase minimum granularity"
            default 0
    endif

    config PKG_EASYFLASH_IAP
        bool
        prompt "IAP: In Application Programming"
        default n

    config PKG_EASYFLASH_ERASE_GRAN
        int
        prompt "Erase minimum granularity"
        default 4096

    if PKG_EASYFLASH_VER_NUM >= 0x40000
        choice
            prompt "Write minimum granularity"
            default PKG_EASYFLASH_WRITE_GRAN_1BIT
            config PKG_EASYFLASH_WRITE_GRAN_1BIT
                bool "1bit   such as Nor Flash"

            config PKG_EASYFLASH_WRITE_GRAN_8BITS
                bool "8bits  such as STM32F2/F4"

            config PKG_EASYFLASH_WRITE_GRAN_32BITS
                bool "32bits such as STM32F1"
        endchoice

        config PKG_EASYFLASH_WRITE_GRAN
            int
            default 1 if PKG_EASYFLASH_WRITE_GRAN_1BIT
            default 8 if PKG_EASYFLASH_WRITE_GRAN_8BITS
            default 32 if PKG_EASYFLASH_WRITE_GRAN_32BITS
    endif

    config PKG_EASYFLASH_START_ADDR
        int
        prompt "Start addr on flash or partition"
        default 0

    config PKG_EASYFLASH_DEBUG
        bool "Enable debug log output"
        default y

    choice
        prompt "Version"
        default PKG_USING_EASYFLASH_V400
        help
            Select the this package version

        config PKG_USING_EASYFLASH_V400
            bool "v4.0.0"

        config PKG_USING_EASYFLASH_V330
            bool "v3.3.0"

        config PKG_USING_EASYFLASH_V321
            bool "v3.2.1"

        config PKG_USING_EASYFLASH_V310
            bool "v3.1.0"

        config PKG_USING_EASYFLASH_V300
            bool "v3.0.0"

        config PKG_USING_EASYFLASH_LATEST_VERSION
            bool "latest"
    endchoice

    config PKG_EASYFLASH_VER
        string
        default "v4.0.0" if PKG_USING_EASYFLASH_V400
        default "v3.3.0" if PKG_USING_EASYFLASH_V330
        default "v3.2.1" if PKG_USING_EASYFLASH_V321
        default "v3.1.0" if PKG_USING_EASYFLASH_V310
        default "v3.0.0" if PKG_USING_EASYFLASH_V300
        default "latest" if PKG_USING_EASYFLASH_LATEST_VERSION

    config PKG_EASYFLASH_VER_NUM
        hex
        default 0x40000 if PKG_USING_EASYFLASH_V400
        default 0x30300 if PKG_USING_EASYFLASH_V330
        default 0x30201 if PKG_USING_EASYFLASH_V321
        default 0x30100 if PKG_USING_EASYFLASH_V310
        default 0x30000 if PKG_USING_EASYFLASH_V300
        default 0x99999 if PKG_USING_EASYFLASH_LATEST_VERSION

endif
```
