## arduino/sensors/Adafruit-ADXL345/Kconfig
```kconfig
# Kconfig file for package Adafruit_ADXL345
menuconfig PKG_USING_ARDUINO_ADAFRUIT_ADXL345
    bool "Adafruit ADXL345: 3-Axis ±2g/±4g/±8g/±16g Digital Accelerometer"
     select PKG_USING_RTDUINO
     select RTDUINO_USING_WIRE
     select RTDUINO_USING_SPI
     select PKG_USING_ARDUINO_ADAFRUIT_SENSOR
     select PKG_USING_ARDUINO_ADAFRUIT_BUSIO
     default n

if PKG_USING_ARDUINO_ADAFRUIT_ADXL345

    config PKG_ARDUINO_ADAFRUIT_ADXL345_PATH
        string
        default "/packages/arduino/sensors/Adafruit-ADXL345"

    choice
        prompt "Version"
        default PKG_USING_ARDUINO_ADAFRUIT_ADXL345_LATEST_VERSION
        help
            Select the package version

        config PKG_USING_ARDUINO_ADAFRUIT_ADXL345_LATEST_VERSION
            bool "latest"
    endchoice

    config PKG_ARDUINO_ADAFRUIT_ADXL345_VER
       string
       default "latest"    if PKG_USING_ARDUINO_ADAFRUIT_ADXL345_LATEST_VERSION

endif
```

## arduino/sensors/Adafruit-ADXL375/Kconfig
```kconfig
# Kconfig file for package Adafruit-ADXL375
menuconfig PKG_USING_ARDUINO_ADAFRUIT_ADXL375
    bool "Adafruit ADXL375: 3-Axis ±2g/±4g/±8g/±16g Digital MEMS Accelerometer"
    select PKG_USING_RTDUINO
    select RTDUINO_USING_WIRE
    select RTDUINO_USING_SPI
    select PKG_USING_ARDUINO_ADAFRUIT_ADXL343
    default n

if PKG_USING_ARDUINO_ADAFRUIT_ADXL375

    config PKG_ARDUINO_ADAFRUIT_ADXL375_PATH
        string
        default "/packages/arduino/sensors/Adafruit-ADXL375"

    choice
        prompt "Version"
        default PKG_USING_ARDUINO_ADAFRUIT_ADXL375_LATEST_VERSION
        help
            Select the package version

        config PKG_USING_ARDUINO_ADAFRUIT_ADXL375_LATEST_VERSION
            bool "latest"
    endchoice

    config PKG_ARDUINO_ADAFRUIT_ADXL375_VER
       string
       default "latest"    if PKG_USING_ARDUINO_ADAFRUIT_ADXL375_LATEST_VERSION

endif
```

## arduino/sensors/Adafruit-AHTX0/Kconfig
```kconfig
# Kconfig file for package Adafruit_AHTX0
menuconfig PKG_USING_ARDUINO_ADAFRUIT_AHTX0
    bool "Adafruit AHT10 & AHT20: Humidity and Temperature Sensor"
    select PKG_USING_RTDUINO
    select RTDUINO_USING_WIRE
    select PKG_USING_ARDUINO_ADAFRUIT_SENSOR
    select PKG_USING_ARDUINO_ADAFRUIT_BUSIO
    default n

if PKG_USING_ARDUINO_ADAFRUIT_AHTX0

    config PKG_ARDUINO_ADAFRUIT_AHTX0_PATH
        string
        default "/packages/arduino/sensors/Adafruit-AHTX0"

    config ARDUINO_ADAFRUIT_AHTX0_USING_SENSOR_DEVICE
        bool "Use RT-Thread Sensor Device Framework"
        select PKG_USING_ARDUINO_SENSOR_DEVICE_DRIVERS
        default n

    choice
        prompt "Version"
        default PKG_USING_ARDUINO_ADAFRUIT_AHTX0_LATEST_VERSION
        help
            Select the package version

        config PKG_USING_ARDUINO_ADAFRUIT_AHTX0_LATEST_VERSION
            bool "latest"
    endchoice

    config PKG_ARDUINO_ADAFRUIT_AHTX0_VER
       string
       default "latest"    if PKG_USING_ARDUINO_ADAFRUIT_AHTX0_LATEST_VERSION

endif
```

## arduino/sensors/Adafruit-AM2315/Kconfig
```kconfig
# Kconfig file for package Adafruit-AM2315
menuconfig PKG_USING_ARDUINO_ADAFRUIT_AM2315
    bool "Adafruit AM2315: Humidity & Temperature sensor"
    select PKG_USING_RTDUINO
    select RTDUINO_USING_WIRE
    select PKG_USING_ARDUINO_ADAFRUIT_BUSIO
    default n

if PKG_USING_ARDUINO_ADAFRUIT_AM2315

    config PKG_ARDUINO_ADAFRUIT_AM2315_PATH
        string
        default "/packages/arduino/sensors/Adafruit-AM2315"

    choice
        prompt "Version"
        default PKG_USING_ARDUINO_ADAFRUIT_AM2315_LATEST_VERSION
        help
            Select the package version

        config PKG_USING_ARDUINO_ADAFRUIT_AM2315_LATEST_VERSION
            bool "latest"
    endchoice

    config PKG_ARDUINO_ADAFRUIT_AM2315_VER
       string
       default "latest"    if PKG_USING_ARDUINO_ADAFRUIT_AM2315_LATEST_VERSION

endif
```

## arduino/sensors/Adafruit-AM2320/Kconfig
```kconfig
# Kconfig file for package Adafruit-AM2320
menuconfig PKG_USING_ARDUINO_ADAFRUIT_AM2320
    bool "Adafruit AM2320 : Temperature & Humidity Unified Sensor"
    select PKG_USING_RTDUINO
    select RTDUINO_USING_WIRE
    select PKG_USING_ARDUINO_ADAFRUIT_SENSOR
    select PKG_USING_ARDUINO_ADAFRUIT_BUSIO
    default n

if PKG_USING_ARDUINO_ADAFRUIT_AM2320

    config PKG_ARDUINO_ADAFRUIT_AM2320_PATH
        string
        default "/packages/arduino/sensors/Adafruit-AM2320"

    choice
        prompt "Version"
        default PKG_USING_ARDUINO_ADAFRUIT_AM2320_LATEST_VERSION
        help
            Select the package version

        config PKG_USING_ARDUINO_ADAFRUIT_AM2320_LATEST_VERSION
            bool "latest"
    endchoice

    config PKG_ARDUINO_ADAFRUIT_AM2320_VER
       string
       default "latest"    if PKG_USING_ARDUINO_ADAFRUIT_AM2320_LATEST_VERSION

endif
```

## arduino/sensors/Adafruit-AMG88xx/Kconfig
```kconfig
# Kconfig file for package Adafruit-AMG88xx
menuconfig PKG_USING_ARDUINO_ADAFRUIT_AMG88XX
    bool "Adafruit AMG88xx: AMG88xx 8x8 Thermocouple Sensors"
    select PKG_USING_RTDUINO
    select RTDUINO_USING_WIRE
    select PKG_USING_ARDUINO_ADAFRUIT_BUSIO
    default n

if PKG_USING_ARDUINO_ADAFRUIT_AMG88XX

    config PKG_ARDUINO_ADAFRUIT_AMG88XX_PATH
        string
        default "/packages/arduino/sensors/Adafruit-AMG88xx"

    choice
        prompt "Version"
        default PKG_USING_ARDUINO_ADAFRUIT_AMG88XX_LATEST_VERSION
        help
            Select the package version

        config PKG_USING_ARDUINO_ADAFRUIT_AMG88XX_LATEST_VERSION
            bool "latest"
    endchoice

    config PKG_ARDUINO_ADAFRUIT_AMG88XX_VER
       string
       default "latest"    if PKG_USING_ARDUINO_ADAFRUIT_AMG88XX_LATEST_VERSION

endif
```

## arduino/sensors/Adafruit-AS726x/Kconfig
```kconfig
# Kconfig file for package Adafruit-AS726x
menuconfig PKG_USING_ARDUINO_ADAFRUIT_AS726X
    bool "Adafruit AS726x: spectral sensor"
    select PKG_USING_RTDUINO
    select RTDUINO_USING_WIRE
    select PKG_USING_ARDUINO_ADAFRUIT_BUSIO
    default n

if PKG_USING_ARDUINO_ADAFRUIT_AS726X

    config PKG_ARDUINO_ADAFRUIT_AS726X_PATH
        string
        default "/packages/arduino/sensors/Adafruit-AS726x"

    choice
        prompt "Version"
        default PKG_USING_ARDUINO_ADAFRUIT_AS726X_LATEST_VERSION
        help
            Select the package version

        config PKG_USING_ARDUINO_ADAFRUIT_AS726X_LATEST_VERSION
            bool "latest"
    endchoice

    config PKG_ARDUINO_ADAFRUIT_AS726X_VER
       string
       default "latest"    if PKG_USING_ARDUINO_ADAFRUIT_AS726X_LATEST_VERSION

endif
```

## arduino/sensors/Adafruit-AS7341/Kconfig
```kconfig
# Kconfig file for package Adafruit-AS7341
menuconfig PKG_USING_ARDUINO_ADAFRUIT_AS7341
    bool "Adafruit AS7341: 11-Channel Spectral Sensor."
    select PKG_USING_RTDUINO
    select RTDUINO_USING_WIRE
    select PKG_USING_ARDUINO_ADAFRUIT_BUSIO
    default n

if PKG_USING_ARDUINO_ADAFRUIT_AS7341

    config PKG_ARDUINO_ADAFRUIT_AS7341_PATH
        string
        default "/packages/arduino/sensors/Adafruit-AS7341"

    choice
        prompt "Version"
        default PKG_USING_ARDUINO_ADAFRUIT_AS7341_LATEST_VERSION
        help
            Select the package version

        config PKG_USING_ARDUINO_ADAFRUIT_AS7341_LATEST_VERSION
            bool "latest"
    endchoice

    config PKG_ARDUINO_ADAFRUIT_AS7341_VER
       string
       default "latest"    if PKG_USING_ARDUINO_ADAFRUIT_AS7341_LATEST_VERSION

endif
```

## arduino/sensors/Adafruit-BME280/Kconfig
```kconfig
# Kconfig file for package  Adafruit-BME280
menuconfig PKG_USING_ARDUINO_ADAFRUIT_BME280
    bool "Adafruit BME280: Humidity, Barometric Pressure and Temperature sensor"
    select PKG_USING_RTDUINO
    select RTDUINO_USING_WIRE
    select RTDUINO_USING_SPI
    select PKG_USING_ARDUINO_ADAFRUIT_SENSOR
    select PKG_USING_ARDUINO_ADAFRUIT_BUSIO
    default n

if PKG_USING_ARDUINO_ADAFRUIT_BME280

    config PKG_ARDUINO_ADAFRUIT_BME280_PATH
        string
        default "/packages/arduino/sensors/Adafruit-BME280"

    choice
        prompt "Version"
        default PKG_USING_ARDUINO_ADAFRUIT_BME280_LATEST_VERSION
        help
            Select the package version

        config PKG_USING_ARDUINO_ADAFRUIT_BME280_LATEST_VERSION
            bool "latest"
    endchoice

    config PKG_ARDUINO_ADAFRUIT_BME280_VER
       string
       default "latest"    if PKG_USING_ARDUINO_ADAFRUIT_BME280_LATEST_VERSION

endif
```

## arduino/sensors/Adafruit-BME680/Kconfig
```kconfig
# Kconfig file for package Adafruit-BME680
menuconfig PKG_USING_ARDUINO_ADAFRUIT_BME680
    bool "Adafruit BME680: humidity & pressure sensor"
    select PKG_USING_RTDUINO
    select RTDUINO_USING_WIRE
    select RTDUINO_USING_SPI
    select PKG_USING_ARDUINO_ADAFRUIT_SENSOR
    select PKG_USING_ARDUINO_ADAFRUIT_BUSIO
    default n

if PKG_USING_ARDUINO_ADAFRUIT_BME680

    config PKG_ARDUINO_ADAFRUIT_BME680_PATH
        string
        default "/packages/arduino/sensors/Adafruit-BME680"

    choice
        prompt "Version"
        default PKG_USING_ARDUINO_ADAFRUIT_BME680_LATEST_VERSION
        help
            Select the package version

        config PKG_USING_ARDUINO_ADAFRUIT_BME680_LATEST_VERSION
            bool "latest"
    endchoice

    config PKG_ARDUINO_ADAFRUIT_BME680_VER
       string
       default "latest"    if PKG_USING_ARDUINO_ADAFRUIT_BME680_LATEST_VERSION

endif
```

## arduino/sensors/Adafruit-BMP085-Unified/Kconfig
```kconfig
# Kconfig file for package Adafruit-BMP085-Unified
menuconfig PKG_USING_ARDUINO_ADAFRUIT_BMP085_UNIFIED
    bool "Adafruit BMP085: Barometric Pressure Temperature sensor"
    select PKG_USING_RTDUINO
    select RTDUINO_USING_WIRE
    select PKG_USING_ARDUINO_ADAFRUIT_SENSOR
    default n

if PKG_USING_ARDUINO_ADAFRUIT_BMP085_UNIFIED

    config PKG_ARDUINO_ADAFRUIT_BMP085_UNIFIED_PATH
        string
        default "/packages/arduino/sensors/Adafruit-BMP085-Unified"

    choice
        prompt "Version"
        default PKG_USING_ARDUINO_ADAFRUIT_BMP085_UNIFIED_LATEST_VERSION
        help
            Select the package version

        config PKG_USING_ARDUINO_ADAFRUIT_BMP085_UNIFIED_LATEST_VERSION
            bool "latest"
    endchoice

    config PKG_ARDUINO_ADAFRUIT_BMP085_UNIFIED_VER
       string
       default "latest"    if PKG_USING_ARDUINO_ADAFRUIT_BMP085_UNIFIED_LATEST_VERSION

endif
```

## arduino/sensors/Adafruit-BMP085/Kconfig
```kconfig
# Kconfig file for package Adafruit-BMP085
menuconfig PKG_USING_ARDUINO_ADAFRUIT_BMP085
    bool "Adafruit BMP085/BMP180: Barometric Pressure + Temp sensor library"
    select PKG_USING_RTDUINO
    select RTDUINO_USING_WIRE
    select PKG_USING_ARDUINO_ADAFRUIT_SENSOR
    select PKG_USING_ARDUINO_ADAFRUIT_BUSIO
    default n

if PKG_USING_ARDUINO_ADAFRUIT_BMP085

    config PKG_ARDUINO_ADAFRUIT_BMP085_PATH
        string
        default "/packages/arduino/sensors/Adafruit-BMP085"

    choice
        prompt "Version"
        default PKG_USING_ARDUINO_ADAFRUIT_BMP085_LATEST_VERSION
        help
            Select the package version

        config PKG_USING_ARDUINO_ADAFRUIT_BMP085_LATEST_VERSION
            bool "latest"
    endchoice

    config PKG_ARDUINO_ADAFRUIT_BMP085_VER
       string
       default "latest"    if PKG_USING_ARDUINO_ADAFRUIT_BMP085_LATEST_VERSION

endif
```

## arduino/sensors/Adafruit-BMP183-Unified/Kconfig
```kconfig
# Kconfig file for package Adafruit-BMP183-Unified
menuconfig PKG_USING_ARDUINO_ADAFRUIT_BMP183_UNIFIED
    bool "Adafruit BMP183 (Unified): Barometric Pressure & Altitude Sensor."
    select PKG_USING_RTDUINO
    select RTDUINO_USING_SPI
    select PKG_USING_ARDUINO_ADAFRUIT_SENSOR
    default n

if PKG_USING_ARDUINO_ADAFRUIT_BMP183_UNIFIED

    config PKG_ARDUINO_ADAFRUIT_BMP183_UNIFIED_PATH
        string
        default "/packages/arduino/sensors/Adafruit-BMP183-Unified"

    choice
        prompt "Version"
        default PKG_USING_ARDUINO_ADAFRUIT_BMP183_UNIFIED_LATEST_VERSION
        help
            Select the package version

        config PKG_USING_ARDUINO_ADAFRUIT_BMP183_UNIFIED_LATEST_VERSION
            bool "latest"
    endchoice

    config PKG_ARDUINO_ADAFRUIT_BMP183_UNIFIED_VER
       string
       default "latest"    if PKG_USING_ARDUINO_ADAFRUIT_BMP183_UNIFIED_LATEST_VERSION

endif
```

## arduino/sensors/Adafruit-BMP183/Kconfig
```kconfig
# Kconfig file for package Adafruit-BMP183
menuconfig PKG_USING_ARDUINO_ADAFRUIT_BMP183
    bool "Adafruit BMP183: Barometric Pressure & Temperature sensor"
    select PKG_USING_RTDUINO
    select RTDUINO_USING_SPI
    select PKG_USING_ARDUINO_ADAFRUIT_SENSOR
    default n

if PKG_USING_ARDUINO_ADAFRUIT_BMP183

    config PKG_ARDUINO_ADAFRUIT_BMP183_PATH
        string
        default "/packages/arduino/sensors/Adafruit-BMP183"

    choice
        prompt "Version"
        default PKG_USING_ARDUINO_ADAFRUIT_BMP183_LATEST_VERSION
        help
            Select the package version

        config PKG_USING_ARDUINO_ADAFRUIT_BMP183_LATEST_VERSION
            bool "latest"
    endchoice

    config PKG_ARDUINO_ADAFRUIT_BMP183_VER
       string
       default "latest"    if PKG_USING_ARDUINO_ADAFRUIT_BMP183_LATEST_VERSION

endif
```

## arduino/sensors/Adafruit-BMP280-Library/Kconfig
```kconfig
# Kconfig file for package Adafruit_BMP280_Library
menuconfig PKG_USING_ARDUINO_ADAFRUIT_BMP280_LIBRARY
    bool "This driver is for the Adafruit BMP280 Breakout"
    default n

if PKG_USING_ARDUINO_ADAFRUIT_BMP280_LIBRARY

    config PKG_ARDUINO_ADAFRUIT_BMP280_LIBRARY_PATH
        string
        default "/packages/arduino/sensors/Adafruit_BMP280_Library"

    choice
        prompt "Version"
        default PKG_USING_ARDUINO_ADAFRUIT_BMP280_LIBRARY_LATEST_VERSION
        help
            Select the package version

        config PKG_USING_ARDUINO_ADAFRUIT_BMP280_LIBRARY_LATEST_VERSION
            bool "latest"
    endchoice

    config PKG_ARDUINO_ADAFRUIT_BMP280_LIBRARY_VER
       string
       default "latest"    if PKG_USING_ARDUINO_ADAFRUIT_BMP280_LIBRARY_LATEST_VERSION

endif
```

## arduino/sensors/Adafruit-BMP280/Kconfig
```kconfig
# Kconfig file for package Adafruit-BMP280
menuconfig PKG_USING_ARDUINO_ADAFRUIT_BMP280
    bool "Adafruit BMP280: barometric pressure, altitude and temperature sensor"
    select PKG_USING_RTDUINO
    select RTDUINO_USING_WIRE
    select RTDUINO_USING_SPI
    select PKG_USING_ARDUINO_ADAFRUIT_SENSOR
    select PKG_USING_ARDUINO_ADAFRUIT_BUSIO
    default n

if PKG_USING_ARDUINO_ADAFRUIT_BMP280

    config PKG_ARDUINO_ADAFRUIT_BMP280_PATH
        string
        default "/packages/arduino/sensors/Adafruit-BMP280"

    choice
        prompt "Version"
        default PKG_USING_ARDUINO_ADAFRUIT_BMP280_LATEST_VERSION
        help
            Select the package version

        config PKG_USING_ARDUINO_ADAFRUIT_BMP280_LATEST_VERSION
            bool "latest"
    endchoice

    config PKG_ARDUINO_ADAFRUIT_BMP280_VER
       string
       default "latest"    if PKG_USING_ARDUINO_ADAFRUIT_BMP280_LATEST_VERSION

endif
```
