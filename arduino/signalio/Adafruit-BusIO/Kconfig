## arduino/signalio/Adafruit-BusIO/Kconfig
```kconfig
# Kconfig file for package Adafruit_BusIO
menuconfig PKG_USING_ARDUINO_ADAFRUIT_BUSIO
    bool "Adafruit BusIO: abstract away I2C & SPI transactions and registers"
    select PKG_USING_RTDUINO
    default n

if PKG_USING_ARDUINO_ADAFRUIT_BUSIO

    config PKG_ARDUINO_ADAFRUIT_BUSIO_PATH
        string
        default "/packages/arduino/signalio/Adafruit-BusIO"

    choice
        prompt "Version"
        default PKG_USING_ARDUINO_ADAFRUIT_BUSIO_LATEST_VERSION
        help
            Select the package version

        config PKG_USING_ARDUINO_ADAFRUIT_BUSIO_LATEST_VERSION
            bool "latest"
    endchoice

    config PKG_ARDUINO_ADAFRUIT_BUSIO_VER
       string
       default "latest"    if PKG_USING_ARDUINO_ADAFRUIT_BUSIO_LATEST_VERSION

endif
```

## arduino/signalio/Adafruit-MCP23017/Kconfig
```kconfig
# Kconfig file for package Adafruit-MCP23017
menuconfig PKG_USING_ARDUINO_ADAFRUIT_MCP23017
    bool "Adafruit MCP23008/17: I2C and SPI Port Expanders."
    select PKG_USING_RTDUINO
    select RTDUINO_USING_WIRE
    select RTDUINO_USING_SPI
    select PKG_USING_ARDUINO_ADAFRUIT_BUSIO
    default n

if PKG_USING_ARDUINO_ADAFRUIT_MCP23017

    config PKG_ARDUINO_ADAFRUIT_MCP23017_PATH
        string
        default "/packages/arduino/signalio/Adafruit-MCP23017"

    choice
        prompt "Version"
        default PKG_USING_ARDUINO_ADAFRUIT_MCP23017_LATEST_VERSION
        help
            Select the package version

        config PKG_USING_ARDUINO_ADAFRUIT_MCP23017_LATEST_VERSION
            bool "latest"
    endchoice

    config PKG_ARDUINO_ADAFRUIT_MCP23017_VER
       string
       default "latest"    if PKG_USING_ARDUINO_ADAFRUIT_MCP23017_LATEST_VERSION

endif
```

## arduino/signalio/Adafruit-MCP3008/Kconfig
```kconfig
# Kconfig file for package Adafruit-MCP3008
menuconfig PKG_USING_ARDUINO_ADAFRUIT_MCP3008
    bool "Adafruit MCP3008: 8-Channel 10-Bit ADC With SPI Interface"
    select PKG_USING_RTDUINO
    select RTDUINO_USING_SPI
    select PKG_USING_ARDUINO_ADAFRUIT_BUSIO
    default n

if PKG_USING_ARDUINO_ADAFRUIT_MCP3008

    config PKG_ARDUINO_ADAFRUIT_MCP3008_PATH
        string
        default "/packages/arduino/signalio/Adafruit-MCP3008"

    choice
        prompt "Version"
        default PKG_USING_ARDUINO_ADAFRUIT_MCP3008_LATEST_VERSION
        help
            Select the package version

        config PKG_USING_ARDUINO_ADAFRUIT_MCP3008_LATEST_VERSION
            bool "latest"
    endchoice

    config PKG_ARDUINO_ADAFRUIT_MCP3008_VER
       string
       default "latest"    if PKG_USING_ARDUINO_ADAFRUIT_MCP3008_LATEST_VERSION

endif
```

## arduino/signalio/Adafruit-MCP4725/Kconfig
```kconfig
# Kconfig file for package Adafruit-MCP4725
menuconfig PKG_USING_ARDUINO_ADAFRUIT_MCP4725
    bool "Adafruit MCP4725: 12-bit I2C DAC driver"
    select PKG_USING_RTDUINO
    select RTDUINO_USING_WIRE
    select PKG_USING_ARDUINO_ADAFRUIT_BUSIO
    default n

if PKG_USING_ARDUINO_ADAFRUIT_MCP4725

    config PKG_ARDUINO_ADAFRUIT_MCP4725_PATH
        string
        default "/packages/arduino/signalio/Adafruit-MCP4725"

    choice
        prompt "Version"
        default PKG_USING_ARDUINO_ADAFRUIT_MCP4725_LATEST_VERSION
        help
            Select the package version

        config PKG_USING_ARDUINO_ADAFRUIT_MCP4725_LATEST_VERSION
            bool "latest"
    endchoice

    config PKG_ARDUINO_ADAFRUIT_MCP4725_VER
       string
       default "latest"    if PKG_USING_ARDUINO_ADAFRUIT_MCP4725_LATEST_VERSION

endif
```

## arduino/signalio/Adafruit-TCA8418/Kconfig
```kconfig
# Kconfig file for package Adafruit-TCA8418
menuconfig PKG_USING_ARDUINO_ADAFRUIT_TCA8418
    bool "Adafruit TCA8418: GPIO expander and key matrix driver"
    select PKG_USING_RTDUINO
    select RTDUINO_USING_WIRE
    select PKG_USING_ARDUINO_ADAFRUIT_BUSIO
    default n

if PKG_USING_ARDUINO_ADAFRUIT_TCA8418

    config PKG_ARDUINO_ADAFRUIT_TCA8418_PATH
        string
        default "/packages/arduino/signalio/Adafruit-TCA8418"

    choice
        prompt "Version"
        default PKG_USING_ARDUINO_ADAFRUIT_TCA8418_LATEST_VERSION
        help
            Select the package version

        config PKG_USING_ARDUINO_ADAFRUIT_TCA8418_LATEST_VERSION
            bool "latest"
    endchoice

    config PKG_ARDUINO_ADAFRUIT_TCA8418_VER
       string
       default "latest"    if PKG_USING_ARDUINO_ADAFRUIT_TCA8418_LATEST_VERSION

endif
```

## arduino/signalio/Kconfig
```kconfig
menu "Signal IO"

rsource "Adafruit-BusIO/Kconfig"
rsource "Adafruit-TCA8418/Kconfig"
rsource "Adafruit-MCP23017/Kconfig"
rsource "Adafruit-ADS1X15/Kconfig"
rsource "Adafruit-AW9523/Kconfig"
rsource "Adafruit-MCP3008/Kconfig"
rsource "Adafruit-MCP4725/Kconfig"
rsource "Adafruit-BD3491FS/Kconfig"


endmenu
```

## arduino/timing/Kconfig
```kconfig
menu "Timing"

rsource "RTClib/Kconfig"
rsource "MsTimer2/Kconfig"
rsource "Ticker/Kconfig"
rsource "TaskScheduler/Kconfig"

endmenu
```

## arduino/timing/MsTimer2/Kconfig
```kconfig
# Kconfig file for package MsTimer2
menuconfig PKG_USING_ARDUINO_MSTIMER2
    bool "MsTimer2: Run a function every millisecond"
    select PKG_USING_RTDUINO
    select RT_USING_TIMER_SOFT
    default n

if PKG_USING_ARDUINO_MSTIMER2

    config PKG_ARDUINO_MSTIMER2_PATH
        string
        default "/packages/arduino/timing/MsTimer2"

    choice
        prompt "Version"
        default PKG_USING_ARDUINO_MSTIMER2_LATEST_VERSION
        help
            Select the package version

        config PKG_USING_ARDUINO_MSTIMER2_LATEST_VERSION
            bool "latest"
    endchoice

    config PKG_ARDUINO_MSTIMER2_VER
       string
       default "latest"    if PKG_USING_ARDUINO_MSTIMER2_LATEST_VERSION

endif
```

## arduino/timing/RTClib/Kconfig
```kconfig
# Kconfig file for package RTClib
menuconfig PKG_USING_ARDUINO_RTCLIB
    bool "RTClib real time clock library for Arduino"
    select PKG_USING_RTDUINO
    select RTDUINO_USING_WIRE
    select PKG_USING_ARDUINO_ADAFRUIT_BUSIO
    default n

if PKG_USING_ARDUINO_RTCLIB

    config PKG_ARDUINO_RTCLIB_PATH
        string
        default "/packages/arduino/timing/RTClib"

    choice
        prompt "Version"
        default PKG_USING_ARDUINO_RTCLIB_LATEST_VERSION
        help
            Select the package version

        config PKG_USING_ARDUINO_RTCLIB_LATEST_VERSION
            bool "latest"
    endchoice

    config PKG_ARDUINO_RTCLIB_VER
       string
       default "latest"    if PKG_USING_ARDUINO_RTCLIB_LATEST_VERSION

endif
```

## arduino/timing/TaskScheduler/Kconfig
```kconfig
# Kconfig file for package TaskScheduler
menuconfig PKG_USING_ARDUINO_TASKSCHEDULER
    bool "TaskScheduler: Cooperative multitasking for Arduino"
    select PKG_USING_RTDUINO
    default n

if PKG_USING_ARDUINO_TASKSCHEDULER

    config PKG_ARDUINO_TASKSCHEDULER_PATH
        string
        default "/packages/arduino/timing/TaskScheduler"

    choice
        prompt "Version"
        help
            Select the package version

        config PKG_USING_ARDUINO_TASKSCHEDULER_LATEST_VERSION
            bool "latest"
    endchoice

    config PKG_ARDUINO_TASKSCHEDULER_VER
       string
       default "latest"    if PKG_USING_ARDUINO_TASKSCHEDULER_LATEST_VERSION

endif
```

## arduino/timing/Ticker/Kconfig
```kconfig
# Kconfig file for package Ticker
menuconfig PKG_USING_ARDUINO_TICKER
    bool "Ticker: Creating Tickers which can call repeating functions. Replaces delay() with non-blocking functions."
    select PKG_USING_RTDUINO
    default n

if PKG_USING_ARDUINO_TICKER

    config PKG_ARDUINO_TICKER_PATH
        string
        default "/packages/arduino/timing/Ticker"

    choice
        prompt "Version"
        help
            Select the package version

        config PKG_USING_ARDUINO_TICKER_LATEST_VERSION
            bool "latest"
    endchoice

    config PKG_ARDUINO_TICKER_VER
       string
       default "latest"    if PKG_USING_ARDUINO_TICKER_LATEST_VERSION

endif
```

## iot/EmbeddedProto/Kconfig
```kconfig
# Kconfig file for package EmbeddedProto
menuconfig PKG_USING_EMBEDDEDPROTO
    bool "EmbeddedProto: a C++ Protocol Buffers implementation specifically suitable for ARM Cortex-M MCUs."
    default n

if PKG_USING_EMBEDDEDPROTO

    config PKG_EMBEDDEDPROTO_PATH
        string
        default "/packages/iot/EmbeddedProto"

    config EMBEDDEDPROTO_USING_ENCODE_DECODE_EXAMPLE
        bool "EmbeddedProto: encode and decode example."
        help
            EmbeddedProto: encode and decode example.
        default n

    choice
        prompt "Version"
        default PKG_USING_EMBEDDEDPROTO_LATEST_VERSION
        help
            Select the package version

        config PKG_USING_EMBEDDEDPROTO_LATEST_VERSION
            bool "latest"
    endchoice

    config PKG_EMBEDDEDPROTO_VER
       string
       default "latest"    if PKG_USING_EMBEDDEDPROTO_LATEST_VERSION

endif
```

## iot/FreeMQTT/Kconfig
```kconfig
# Kconfig file for package FreeMQTT
menuconfig PKG_USING_FREEMQTT
    bool "FreeMQTT：From coreMQTT Client Library"
    default n
    select RT_USING_LWIP
    select RT_USING_POSIX_FS
    select RT_USING_POSIX_SOCKET

if PKG_USING_FREEMQTT

    config PKG_FREEMQTT_PATH
        string
        default "/packages/iot/FreeMQTT"

    choice
        prompt "Version"
        help
            Select the package version

        config PKG_USING_FREEMQTT_V100
            bool "v1.0.0"

        config PKG_USING_FREEMQTT_LATEST_VERSION
            bool "latest"
    endchoice

    config MQTT_CLIENT_ID
        string "mqtt client ID"
        default "freemqtt"

    config MQTT_USERNAME
        string "mqtt name"
        default "free"

    config MQTT_PASSWORD
        string "mqtt password"
        default "free"

    config MQTT_BROKER_ADDRESS
        string "mqtt broker address"
        default "broker.emqx.io"

    config MQTT_BROKER_PORT
        int "mqtt broker port"
        default 1883

    config MQTT_TOPIC_SUB
        string "mqtt topic subscribe"
        default "free/topic/sub"

    config MQTT_TOPIC_PUB
        string "mqtt topic publish"
        default "free/topic/pub"

    config MQTT_KEEP_ALIVE
        int "mqtt keep alive"
        default 60

    config MQTT_BUF_SIZE
        int "mqtt buffer size"
        default 4096

    config PKG_FREEMQTT_VER
       string
       default "v1.0.0"    if PKG_USING_FREEMQTT_V100
       default "latest"    if PKG_USING_FREEMQTT_LATEST_VERSION

endif
```

## iot/GAgent/Kconfig
```kconfig
config PKG_USING_GAGENT_CLOUD
    bool "GAgent: GAgent of Gizwits in RT-Thread"
    select RT_USING_LWIP
    select PKG_USING_WEBCLIENT
    select PKG_USING_PAHOMQTT
    select PKG_USING_TINYCRYPT
    select TINY_CRYPT_AES
    default n

if PKG_USING_GAGENT_CLOUD
	
    config PKG_USING_GAGENT_CLOUD_EXAMPLE
    bool "Enable GAgent example"
    default n
	
    config PKG_GAGENT_CLOUD_DEBUG
    bool "Enable GAgent debug"
    default n

    config PKG_GAGENT_PATH
        string
        default "/packages/iot/GAgent"

    choice
        prompt "GAgent Version"
        help 
            Select the GAgent version

        config PKG_USING_GAGENT_V100
            bool "v1.0.0"

        config PKG_USING_GAGENT_LATEST_VERSION
            bool "latest" 

    endchoice

    config PKG_CJSON_VER
    string
    default "v1.0.0" if PKG_USING_GAGENT_V100
    default "latest" if PKG_USING_GAGENT_LATEST_VERSION

endif
```

## iot/Kconfig
```kconfig
menu "IoT - internet of things"


source "$PKGS_DIR/packages/iot/lwip/Kconfig"
source "$PKGS_DIR/packages/iot/lorawan_driver/Kconfig"
source "$PKGS_DIR/packages/iot/pahomqtt/Kconfig"
source "$PKGS_DIR/packages/iot/umqtt/Kconfig"
source "$PKGS_DIR/packages/iot/webclient/Kconfig"
source "$PKGS_DIR/packages/iot/webnet/Kconfig"
source "$PKGS_DIR/packages/iot/mongoose/Kconfig"
source "$PKGS_DIR/packages/iot/mymqtt/Kconfig"
source "$PKGS_DIR/packages/iot/kawaii-mqtt/Kconfig"
source "$PKGS_DIR/packages/iot/bc28_mqtt/Kconfig"
source "$PKGS_DIR/packages/iot/WebTerminal/Kconfig"
source "$PKGS_DIR/packages/iot/freemodbus/Kconfig"
source "$PKGS_DIR/packages/iot/nanopb/Kconfig"
source "$PKGS_DIR/packages/iot/wifi-host-driver/Kconfig"
source "$PKGS_DIR/packages/iot/WiFi/Kconfig"
source "$PKGS_DIR/packages/iot/coap/Kconfig"
source "$PKGS_DIR/packages/iot/nopoll/Kconfig"
source "$PKGS_DIR/packages/iot/netutils/Kconfig"
source "$PKGS_DIR/packages/iot/cmux/Kconfig"
source "$PKGS_DIR/packages/iot/ppp_device/Kconfig"
source "$PKGS_DIR/packages/iot/at_device/Kconfig"
source "$PKGS_DIR/packages/iot/atsrv_socket/Kconfig"
source "$PKGS_DIR/packages/iot/wiznet/Kconfig"
source "$PKGS_DIR/packages/iot/zb_coordinator/Kconfig"
source "$PKGS_DIR/packages/iot/iot_cloud/Kconfig"
source "$PKGS_DIR/packages/iot/NimBLE/Kconfig"
source "$PKGS_DIR/packages/iot/llsync_sdk_adapter/Kconfig"
source "$PKGS_DIR/packages/iot/ota_downloader/Kconfig"
source "$PKGS_DIR/packages/iot/ipmsg/Kconfig"
source "$PKGS_DIR/packages/iot/lssdp/Kconfig"
source "$PKGS_DIR/packages/iot/airkissOpen/Kconfig"
source "$PKGS_DIR/packages/iot/librws/Kconfig"
source "$PKGS_DIR/packages/iot/tcpserver/Kconfig"
source "$PKGS_DIR/packages/iot/protobuf-c/Kconfig"
source "$PKGS_DIR/packages/iot/dlt645/Kconfig"
source "$PKGS_DIR/packages/iot/qxwz/Kconfig"
source "$PKGS_DIR/packages/iot/smtp_client/Kconfig"
source "$PKGS_DIR/packages/iot/abup_fota/Kconfig"
source "$PKGS_DIR/packages/iot/libcurl2rtt/Kconfig"
source "$PKGS_DIR/packages/iot/capnp/Kconfig"
source "$PKGS_DIR/packages/iot/agile_telnet/Kconfig"
source "$PKGS_DIR/packages/iot/nmealib/Kconfig"
source "$PKGS_DIR/packages/iot/pdulib/Kconfig"
source "$PKGS_DIR/packages/iot/btstack/Kconfig"
source "$PKGS_DIR/packages/iot/bt_cyw43012/Kconfig"
source "$PKGS_DIR/packages/iot/cyw43xx/Kconfig"
source "$PKGS_DIR/packages/iot/lorawan_ed_stack/Kconfig"
source "$PKGS_DIR/packages/iot/wayz_iotkit/Kconfig"
source "$PKGS_DIR/packages/iot/mavlink/Kconfig"
source "$PKGS_DIR/packages/iot/bsal/Kconfig"
source "$PKGS_DIR/packages/iot/agile_modbus/Kconfig"
source "$PKGS_DIR/packages/iot/agile_ftp/Kconfig"
source "$PKGS_DIR/packages/iot/EmbeddedProto/Kconfig"
source "$PKGS_DIR/packages/iot/rt-link_hw/Kconfig"
source "$PKGS_DIR/packages/iot/RyanMqtt/Kconfig"
source "$PKGS_DIR/packages/iot/RyanW5500/Kconfig"
source "$PKGS_DIR/packages/iot/lora_pkt_fwd/Kconfig"
source "$PKGS_DIR/packages/iot/lora_pkt_sniffer/Kconfig"
source "$PKGS_DIR/packages/iot/hm/Kconfig"
source "$PKGS_DIR/packages/iot/small_modbus/Kconfig"
source "$PKGS_DIR/packages/iot/net_server/Kconfig"
source "$PKGS_DIR/packages/iot/zFTP/Kconfig"
source "$PKGS_DIR/packages/iot/wol/Kconfig"
source "$PKGS_DIR/packages/iot/zephyr_polling/Kconfig"
source "$PKGS_DIR/packages/iot/matter-adaptation-layer/Kconfig"
source "$PKGS_DIR/packages/iot/lhc_modbus/Kconfig"
source "$PKGS_DIR/packages/iot/qmodbus/Kconfig"
source "$PKGS_DIR/packages/iot/p-net-rtt/Kconfig"
source "$PKGS_DIR/packages/iot/OpENer/Kconfig"
endmenu
```
