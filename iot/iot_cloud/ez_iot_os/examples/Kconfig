## iot/iot_cloud/ez_iot_os/examples/Kconfig
```kconfig
config EZIOT_EXAMPLES_ENABLE
    bool "Enable examples"
    default n

config EZIOT_EXAMPLES_CLOUD_HOST
    string "Ezviz cloud server address"
    default "devcn.eziot.com"
    depends on EZIOT_EXAMPLES_ENABLE

config EZIOT_EXAMPLES_CLOUD_PORT
    int "Ezviz cloud server port"
    default 8666
    depends on EZIOT_EXAMPLES_ENABLE

config EZIOT_EXAMPLES_SDK_LOGLVL
    int "The log level for debugging"
    range -1 5
    default 4
    depends on EZIOT_EXAMPLES_ENABLE

choice EZIOT_EXAMPLES_DEV_AUTH_MODE
    prompt "Device access authentication mode"
    default EZIOT_EXAMPLES_DEV_AUTH_MODE_LICENCE
    depends on EZIOT_EXAMPLES_ENABLE

config EZIOT_EXAMPLES_DEV_AUTH_MODE_SAP
    bool "SAP(Ezviz Production line)"
config EZIOT_EXAMPLES_DEV_AUTH_MODE_LICENCE
    bool "Licence"
endchoice

config EZIOT_EXAMPLES_DEV_TYPE
    string "Device model"
    default "4LYV8SK7UKLBOUOVS6HXVX"
    depends on EZIOT_EXAMPLES_ENABLE && EZIOT_EXAMPLES_DEV_AUTH_MODE_SAP

config EZIOT_EXAMPLES_DEV_SERIAL_NUMBER
    string "Device serial number"
    default "Z88889999"
    depends on EZIOT_EXAMPLES_ENABLE && EZIOT_EXAMPLES_DEV_AUTH_MODE_SAP

config EZIOT_EXAMPLES_DEV_VERIFICATION_CODE
    string "Device verification code"
    default "QWERTY"
    depends on EZIOT_EXAMPLES_ENABLE && EZIOT_EXAMPLES_DEV_AUTH_MODE_SAP

config EZIOT_EXAMPLES_DEV_PRODUCT_KEY
    string "Product key"
    default "4LYV8SK7UKLBOUOVS6HXVX"
    depends on EZIOT_EXAMPLES_ENABLE && EZIOT_EXAMPLES_DEV_AUTH_MODE_LICENCE

config EZIOT_EXAMPLES_DEV_NAME
    string "Device name"
    default "A532NO6K0Q2O"
    depends on EZIOT_EXAMPLES_ENABLE && EZIOT_EXAMPLES_DEV_AUTH_MODE_LICENCE

config EZIOT_EXAMPLES_DEV_LICENSE
    string "Licence"
    default "J7Fv5gCsTczVe38aNLe4ev"
    depends on EZIOT_EXAMPLES_ENABLE && EZIOT_EXAMPLES_DEV_AUTH_MODE_LICENCE

config EZIOT_EXAMPLES_DEV_DISPLAY_NAME
    string ""
    default "IOT_UTEST_DEV"
    depends on EZIOT_EXAMPLES_ENABLE

config EZIOT_EXAMPLES_DEV_FIRMWARE_VERSION
    string ""
    default "V1.2.0 build 201212"
    depends on EZIOT_EXAMPLES_ENABLE

#choice
#    prompt "Implementation method of kv interface"
#    default EZIOT_EXAMPLES_KV_USING_KVDB
#
#    config EZIOT_EXAMPLES_KV_USING_MEMORY
#        bool "11111"
#    config EZIOT_EXAMPLES_KV_USING_FILE
#        bool "33333"
#    config EZIOT_EXAMPLES_KV_USING_KVDB
#        bool "22222"
#endchoice
```

## iot/iot_cloud/ez_iot_os/eziot/ez_iot_bm/ota/Kconfig
```kconfig
menuconfig EZIOT_OTA_ENABLE
    bool "Enable ez-iot ota"
    default y

config EZIOT_OTA_TASK_STACK_SIZE
    int "Stack size of ota task"
    default 16384
    depends on EZIOT_OTA_ENABLE
    help
            Stack size for ota task, the task is used for download ota file

config EZIOT_OTA_TASK_PRIORITY
    int "priority of ota task"
    range 0 255
    default 10
    depends on EZIOT_OTA_ENABLE
```

## iot/iot_cloud/ez_iot_os/eziot/ez_iot_bm/shadow/Kconfig
```kconfig
menuconfig EZIOT_SHADOW_ENABLE
    bool "Enable ez-iot shadow"
    default n

config EZIOT_SHADOW_TASK_PRIORITY
    int "priority of shadow core task"
    range 0 255
    default 2
    depends on EZIOT_SHADOW_ENABLE

config EZIOT_SHADOW_STACK_SIZE
    int "Stack size of shadow core"
    default 16384
    depends on EZIOT_SHADOW_ENABLE

config EZIOT_SHADOW_FULL_SYNC_RETRY_MAX
    int "Maximum Tries of full synchronization"
    default 3
    depends on EZIOT_SHADOW_ENABLE

config EZIOT_SHADOW_FULL_SYNC_RETRY_INTERVAL
    int "Full synchronization interval (seconds)"
    range 10 60
    default 30
    depends on EZIOT_SHADOW_ENABLE

config EZIOT_SHADOW_FORCE_FULL_SYNC_INTERVAL
    int "Force full synchronization interval time (seconds)"
    range 3600 86400
    default 86400
    depends on EZIOT_SHADOW_ENABLE

    help
        If the device state does not change for a long time, shadoww will perform a
        full synchronization to maintain state consistency.
```

## iot/iot_cloud/ez_iot_os/eziot/ez_iot_bm/tsl/Kconfig
```kconfig
menuconfig EZIOT_TSL_ENABLE
    bool "Enable ez-iot tsl(Thing Specification Language)"
    default y

config EZIOT_TSL_SHADOW_SUPPORT
    bool "Use shadow to synchronize property"
    default y
    depends on EZIOT_TSL_ENABLE
    select EZIOT_SHADOW_ENABLE

choice EZIOT_TSL_LEGALITY_CHECK_LEVEL
    prompt "Functional legality check level"
    default EZIOT_TSL_LEGALITY_CHECK_WEAK
    depends on EZIOT_TSL_ENABLE

config EZIOT_TSL_LEGALITY_CHECK_NONE
    bool "NONE"
config EZIOT_TSL_LEGALITY_CHECK_WEAK
    bool "WEAK"
config EZIOT_TSL_LEGALITY_CHECK_STRONG
    bool "STRONG"
endchoice

config EZIOT_TSL_DOWNLOAD_TASK_PRIORITY
    int "Priority of profile download task"
    range 0 255
    default 5
    depends on EZIOT_TSL_ENABLE

config EZIOT_TSL_DOWNLOAD_STACK_SIZE
    int "Stack size of profile download task"
    default 16384
    depends on EZIOT_TSL_ENABLE

config EZIOT_TSL_PROFILE_MAP_SIZE
    int "Profile map size limit"
    default 4096
    depends on EZIOT_TSL_LEGALITY_CHECK_WEAK || EZIOT_TSL_LEGALITY_CHECK_STRONG && EZIOT_TSL_ENABLE

config EZIOT_TSL_PROFILE_SIZE
    int "Profile size limit"
    default 8192
    depends on EZIOT_TSL_LEGALITY_CHECK_WEAK || EZIOT_TSL_LEGALITY_CHECK_STRONG && EZIOT_TSL_ENABLE
```

## iot/iot_cloud/ez_iot_os/eziot/ez_iot_core/Kconfig
```kconfig
menuconfig EZIOT_CORE_ENABLE
    bool "Enable ez-iot core"
    default y

config EZIOT_CORE_MULTI_TASK
    bool "Work in multi task"
    default y
    depends on EZIOT_CORE_ENABLE

config EZIOT_CORE_ACEESS_TASK_STACK_SIZE
    int "Stack size of access task"
    default 16384
    depends on EZIOT_CORE_ENABLE
    help
            Stack size for access task, the task is used for device authentication and device access

config EZIOT_CORE_ACEESS_TASK_PRIORITY
    int "priority of access task"
    range 0 255
    default 5
    depends on EZIOT_CORE_ENABLE

config EZIOT_CORE_USER_TASK_STACK_SIZE
    int "Stack size of user task"
    default 16384
    depends on EZIOT_CORE_MULTI_TASK && EZIOT_CORE_ENABLE
    help
            Stack size for user task, the task is used for cloud message distribution to application.

config EZIOT_CORE_USER_TASK_PRIORITY
    int "priority of user task"
    range 0 255
    default 5
    depends on EZIOT_CORE_MULTI_TASK && EZIOT_CORE_ENABLE

config EZIOT_CORE_MESSAGE_SIZE_MAX
    int "Maximum size of business message"
    range 256 16384
    default 16384
    depends on EZIOT_CORE_ENABLE

config EZIOT_CORE_MESSAGE_NUMBER_MAX
    int "Maximum number of business message"
    range 0 256
    default 64
    depends on EZIOT_CORE_ENABLE

config EZIOT_CORE_EXTEND_COUNT
    int "Maximum number of ezviz protocol v2.0 business modules"
    range 0 32
    default 8
    depends on EZIOT_CORE_ENABLE

config EZIOT_CORE_RISK_CONTROL_CMD_MAX
    int "Maximum number of risk control commands"
    range 0 64
    default 16
    depends on EZIOT_CORE_ENABLE

config EZIOT_CORE_DEFAULT_PUBLISH_RETRY
    int "Default number of retries for message publish"
    default 2
    depends on EZIOT_CORE_ENABLE
```

## iot/iot_cloud/ez_iot_os/platform/bsp/rt-thread/Kconfig
```kconfig
config EZIOT_OS_KV_ENABLE
    bool "Enable ez-os interface kv"
    default y

config EZIOT_OS_LIBC_ENABLE
    bool "Enable ez-os interface libc"
    default y

config EZIOT_OS_MEM_ENABLE
    bool "Enable ez-os interface memory"
    default y

config EZIOT_OS_SOCKET_ENABLE
    bool "Enable ez-os interface socket"
    default y

config EZIOT_OS_SYSTEM_ENABLE
    bool "Enable ez-os interface system"
    default y

config EZIOT_OS_THREAD_ENABLE
    bool "Enable ez-os interface thread"
    default y

config EZIOT_OS_TIME_ENABLE
    bool "Enable ez-os interface time"
    default y
```

## iot/iot_cloud/ez_iot_os/unit_test/Kconfig
```kconfig
config EZIOT_UNIT_TEST_ENABLE
    bool "Enable Unit Test"
    default n
    select EZIOT_COMPONENT_UTEST_ENABLE

config EZIOT_UNIT_TEST_REPORT_LOGLVL
    int "The log level of the unit test report"
    range 1 2
    default 2
    depends on EZIOT_UNIT_TEST_ENABLE

config EZIOT_UNIT_TEST_SDK_LOGLVL
    int "The log level for debugging"
    range -1 5
    default -1
    depends on EZIOT_UNIT_TEST_ENABLE

config EZIOT_UNIT_TEST_CASE_TIEMOUT_SECONDS
    int "The default timeout of the interface test"
    default 10
    depends on EZIOT_UNIT_TEST_ENABLE

config EZIOT_UNIT_TEST_CLOUD_HOST
    string "Ezviz cloud server address"
    default "devcn.eziot.com"
    depends on EZIOT_UNIT_TEST_ENABLE

config EZIOT_UNIT_TEST_CLOUD_PORT
    int "Ezviz cloud server port"
    default 8666
    depends on EZIOT_UNIT_TEST_ENABLE

choice EZIOT_UNIT_TEST_DEV_AUTH_MODE
    prompt "Device access authentication mode"
    default EZIOT_UNIT_TEST_DEV_AUTH_MODE_LICENCE
    depends on EZIOT_UNIT_TEST_ENABLE

config EZIOT_UNIT_TEST_DEV_AUTH_MODE_SAP
    bool "SAP(Production line)"
config EZIOT_UNIT_TEST_DEV_AUTH_MODE_LICENCE
    bool "Licence"
endchoice

config EZIOT_UNIT_TEST_DEV_TYPE
    string "Device model"
    default "4LYV8SK7UKLBOUOVS6HXVX"
    depends on EZIOT_UNIT_TEST_ENABLE && EZIOT_UNIT_TEST_DEV_AUTH_MODE_SAP

config EZIOT_UNIT_TEST_DEV_SERIAL_NUMBER
    string "Device serial number"
    default "Z88889999"
    depends on EZIOT_UNIT_TEST_ENABLE && EZIOT_UNIT_TEST_DEV_AUTH_MODE_SAP

config EZIOT_UNIT_TEST_DEV_VERIFICATION_CODE
    string "Device verification code"
    default "QWERTY"
    depends on EZIOT_UNIT_TEST_ENABLE && EZIOT_UNIT_TEST_DEV_AUTH_MODE_SAP

config EZIOT_UNIT_TEST_DEV_PRODUCT_KEY
    string "Product key"
    default "4LYV8SK7UKLBOUOVS6HXVX"
    depends on EZIOT_UNIT_TEST_ENABLE && EZIOT_UNIT_TEST_DEV_AUTH_MODE_LICENCE

config EZIOT_UNIT_TEST_DEV_NAME
    string "Device name"
    default "A532NO6K0Q2O"
    depends on EZIOT_UNIT_TEST_ENABLE && EZIOT_UNIT_TEST_DEV_AUTH_MODE_LICENCE

config EZIOT_UNIT_TEST_DEV_LICENSE
    string "Licence"
    default "J7Fv5gCsTczVe38aNLe4ev"
    depends on EZIOT_UNIT_TEST_ENABLE && EZIOT_UNIT_TEST_DEV_AUTH_MODE_LICENCE

config EZIOT_UNIT_TEST_DEV_DISPLAY_NAME
    string ""
    default "IOT_UTEST_DEV"
    depends on EZIOT_UNIT_TEST_ENABLE

config EZIOT_UNIT_TEST_DEV_FIRMWARE_VERSION
    string ""
    default "V1.2.0 build 201212"
    depends on EZIOT_UNIT_TEST_ENABLE

config EZIOT_UNIT_TEST_WIFI_SSID
    string "config Wifi ssid (for wifi module)"
    default "Lee"
    depends on EZIOT_UNIT_TEST_ENABLE

config EZIOT_UNIT_TEST_WIFI_PASSWORD
    string "config Wifi password (for wifi module)"
    default "12345678"
    depends on EZIOT_UNIT_TEST_ENABLE
```

## iot/iot_cloud/iotsharp-c-sdk/Kconfig
```kconfig
# Kconfig file for package iotshap-c-sdk
menuconfig PKG_USING_IOTSHARP_SDK
    bool "IoTSharp-C-SDK: IoTSharp Client SDK for RT_Thread"
    select PKG_USING_PAHOMQTT
    default n
if PKG_USING_IOTSHARP_SDK
    config PKG_IOTSHARP_SDK_PATH
        string
        default "/packages/iot/iot_cloud/iotsharp-c-sdk"
    config PKG_USING_IOTSHARP_EXAMPLES
        bool "Using IoTSharp Examples"
        default y
    config PKG_USING_IOTSHARP_SERVER
        string "IoTSharp's server"
        default "tcp://cloud.iotsharp.net:1883"
    config PKG_USING_IOTSHARP_DEVICE_NAME
        string "The name of the device or gateway"
        default ""
    config PKG_USING_IOTSHARP_DEVICE_TOKEN
        string "The token of the device or gateway"
        default ""
    config SDK_PLATFORM
        string
        default "rt-thread-package"
    choice
        prompt "Version"
        default PKG_USING_IOTSHARP_SDK_LATEST_VERSION
        help
            Select the package version

        config PKG_USING_IOTSHARP_SDK_V100
            bool "v1.0.0"

        config PKG_USING_IOTSHARP_SDK_LATEST_VERSION
            bool "latest"
    endchoice
    config PKG_IOTSHARP_SDK_VER
       string
       default "latest"    if PKG_USING_IOTSHARP_SDK_LATEST_VERSION
       default "v1.0.0"    if PKG_USING_IOTSHARP_SDK_V100
endif
```

## iot/iot_cloud/jiot-c-sdk/Kconfig
```kconfig
# Kconfig file for package jiot-c-sdk
menuconfig PKG_USING_JIOT-C-SDK
    bool "jiot-c-sdk: JIGUANG IoT Cloud Client SDK for RT_Thread"
	select RT_USING_SAL
	select SAL_USING_POSIX
    default n

if PKG_USING_JIOT-C-SDK

    config PKG_JIOT-C-SDK_PATH
        string
        default "/packages/iot/iot_cloud/jiot-c-sdk"


	config JIOT_SSL
		bool "Enable TLS/DTLS"
		default n
        select PKG_USING_MBEDTLS
		
	config PKG_USING_JIOT_EXAMPLES
		bool "Using JIoT Examples"
		default y
	
	config PKG_USING_JIOT_PRODUCT_KEY
		string "Config Product Key"
		default ""
		
	config PKG_USING_JIOT_DEVICE_NAME
		string "Config Device Name"
		default ""
		
	config PKG_USING_JIOT_DEVICE_SECRET
		string "Config Device Secret"
		default ""
		
	config SDK_PLATFORM
		string
		default "rt-thread-package"

    choice
        prompt "Version"
        default PKG_USING_JIOT-C-SDK_LATEST_VERSION
        help
            Select the package version

        config PKG_USING_JIOT-C-SDK_V100
            bool "v1.0.0"

        config PKG_USING_JIOT-C-SDK_LATEST_VERSION
            bool "latest"
    endchoice
    
	
    config PKG_JIOT-C-SDK_VER
       string
       default "v1.0.0"    if PKG_USING_JIOT-C-SDK_V100
       default "latest"    if PKG_USING_JIOT-C-SDK_LATEST_VERSION

endif
```
