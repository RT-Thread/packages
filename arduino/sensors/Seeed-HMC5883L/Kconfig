## arduino/sensors/Seeed-HMC5883L/Kconfig
```kconfig
# Kconfig file for package Seeed-HMC5883L
menuconfig PKG_USING_ARDUINO_SEEED_HMC5883L
    bool "Seeed-HMC5883L: 3-Axis Digital Compass Sensor"
    select PKG_USING_RTDUINO
    select RTDUINO_USING_WIRE
    default n

if PKG_USING_ARDUINO_SEEED_HMC5883L

    config PKG_ARDUINO_SEEED_HMC5883L_PATH
        string
        default "/packages/arduino/sensors/Seeed-HMC5883L"

    choice
        prompt "Version"
        default PKG_USING_ARDUINO_SEEED_HMC5883L_LATEST_VERSION
        help
            Select the package version

        config PKG_USING_ARDUINO_SEEED_HMC5883L_LATEST_VERSION
            bool "latest"
    endchoice

    config PKG_ARDUINO_SEEED_HMC5883L_VER
       string
       default "latest"    if PKG_USING_ARDUINO_SEEED_HMC5883L_LATEST_VERSION

endif
```

## arduino/sensors/Seeed-HP20x/Kconfig
```kconfig
# Kconfig file for package Seeed-HP20x
menuconfig PKG_USING_ARDUINO_SEEED_HP20X
    bool "Seeed HP20x: Barometric Pressure, Altimeter, and Temperature Sensor"
    select PKG_USING_RTDUINO
    select RTDUINO_USING_WIRE
    default n

if PKG_USING_ARDUINO_SEEED_HP20X

    config PKG_ARDUINO_SEEED_HP20X_PATH
        string
        default "/packages/arduino/sensors/Seeed-HP20x"

    choice
        prompt "Version"
        default PKG_USING_ARDUINO_SEEED_HP20X_LATEST_VERSION
        help
            Select the package version

        config PKG_USING_ARDUINO_SEEED_HP20X_LATEST_VERSION
            bool "latest"
    endchoice

    config PKG_ARDUINO_SEEED_HP20X_VER
       string
       default "latest"    if PKG_USING_ARDUINO_SEEED_HP20X_LATEST_VERSION

endif
```

## arduino/sensors/Seeed-HighTemp/Kconfig
```kconfig
# Kconfig file for package Seeed-HighTemp
menuconfig PKG_USING_ARDUINO_SEEED_HIGHTEMP
    bool "Seeed HighTemp: K type thermocouple Temperature Sensor"
    select PKG_USING_RTDUINO
    default n

if PKG_USING_ARDUINO_SEEED_HIGHTEMP

    config PKG_ARDUINO_SEEED_HIGHTEMP_PATH
        string
        default "/packages/arduino/sensors/Seeed-HighTemp"

    choice
        prompt "Version"
        default PKG_USING_ARDUINO_SEEED_HIGHTEMP_LATEST_VERSION
        help
            Select the package version

        config PKG_USING_ARDUINO_SEEED_HIGHTEMP_LATEST_VERSION
            bool "latest"
    endchoice

    config PKG_ARDUINO_SEEED_HIGHTEMP_VER
       string
       default "latest"    if PKG_USING_ARDUINO_SEEED_HIGHTEMP_LATEST_VERSION

endif
```

## arduino/sensors/Seeed-ITG3200/Kconfig
```kconfig
# Kconfig file for package Seeed-ITG3200
menuconfig PKG_USING_ARDUINO_SEEED_ITG3200
    bool "Seeed ITG3200 Sensor Driver"
    default n

if PKG_USING_ARDUINO_SEEED_ITG3200

    config PKG_SEEED_ITG3200_PATH
        string
        default "/packages/arduino/sensors/Seeed-ITG3200"

    choice
        prompt "Version"
        default PKG_USING_ARDUINO_SEEED_ITG3200_LATEST_VERSION
        help
            Select the package version

        config PKG_USING_ARDUINO_SEEED_ITG3200_LATEST_VERSION
            bool "latest"
    endchoice

    config PKG_SEEED_ITG3200_VER
       string
       default "latest"    if PKG_USING_ARDUINO_SEEED_ITG3200_LATEST_VERSION

endif
```

## arduino/sensors/Seeed-LDC1612/Kconfig
```kconfig
# Kconfig file for package Seeed-LDC1612
menuconfig PKG_USING_ARDUINO_SEEED_LDC1612
    bool "Seeed LDC1612: 2 channel, 28-bit inductance to digital converters (LDCs) for inductive sensor"
    select PKG_USING_RTDUINO
    select RTDUINO_USING_WIRE
    default n

if PKG_USING_ARDUINO_SEEED_LDC1612

    config PKG_ARDUINO_SEEED_LDC1612_PATH
        string
        default "/packages/arduino/sensors/Seeed-LDC1612"

    choice
        prompt "Version"
        default PKG_USING_ARDUINO_SEEED_LDC1612_LATEST_VERSION
        help
            Select the package version

        config PKG_USING_ARDUINO_SEEED_LDC1612_LATEST_VERSION
            bool "latest"
    endchoice

    config PKG_ARDUINO_SEEED_LDC1612_VER
       string
       default "latest"    if PKG_USING_ARDUINO_SEEED_LDC1612_LATEST_VERSION

endif
```

## arduino/sensors/Seeed-LIS3DHTR/Kconfig
```kconfig
# Kconfig file for package Seeed_LIS3DHTR
menuconfig PKG_USING_ARDUINO_SEEED_LIS3DHTR
    bool "Seeed LIS3DHTR: 3-Axis Digital Accelerometer"
    select PKG_USING_RTDUINO
    select RTDUINO_USING_WIRE
    select RTDUINO_USING_SPI
    default n

if PKG_USING_ARDUINO_SEEED_LIS3DHTR

    config PKG_ARDUINO_SEEED_LIS3DHTR_PATH
        string
        default "/packages/arduino/sensors/Seeed-LIS3DHTR"

    choice
        prompt "Version"
        default PKG_USING_ARDUINO_SEEED_LIS3DHTR_LATEST_VERSION
        help
            Select the package version

        config PKG_USING_ARDUINO_SEEED_LIS3DHTR_LATEST_VERSION
            bool "latest"
    endchoice

    config PKG_ARDUINO_SEEED_LIS3DHTR_VER
       string
       default "latest"    if PKG_USING_ARDUINO_SEEED_LIS3DHTR_LATEST_VERSION

endif
```

## arduino/sensors/Seeed-LSM303DLH/Kconfig
```kconfig
# Kconfig file for package Seeed-LSM303DLH
menuconfig PKG_USING_ARDUINO_SEEED_LSM303DLH
    bool "Seeed LSM303DLH: 3-axis accelerometer and magnetic sensor"
    select PKG_USING_RTDUINO
    select RTDUINO_USING_WIRE
    select RTDUINO_USING_SPI
    default n

if PKG_USING_ARDUINO_SEEED_LSM303DLH

    config PKG_ARDUINO_SEEED_LSM303DLH_PATH
        string
        default "/packages/arduino/sensors/Seeed-LSM303DLH"

    choice
        prompt "Version"
        default PKG_USING_ARDUINO_SEEED_LSM303DLH_LATEST_VERSION
        help
            Select the package version

        config PKG_USING_ARDUINO_SEEED_LSM303DLH_LATEST_VERSION
            bool "latest"
    endchoice

    config PKG_ARDUINO_SEEED_LSM303DLH_VER
       string
       default "latest"    if PKG_USING_ARDUINO_SEEED_LSM303DLH_LATEST_VERSION

endif
```

## arduino/sensors/Seeed-LSM6DS3/Kconfig
```kconfig
# Kconfig file for package Seeed-LSM6DS3
menuconfig PKG_USING_ARDUINO_SEEED_LSM6DS3
    bool "Seeed LSM6DS3: 6-Axis Accelerometer&Gyroscope"
    select PKG_USING_RTDUINO
    select RTDUINO_USING_WIRE
    select RTDUINO_USING_SPI
    default n

if PKG_USING_ARDUINO_SEEED_LSM6DS3

    config PKG_ARDUINO_SEEED_LSM6DS3_PATH
        string
        default "/packages/arduino/sensors/Seeed-LSM6DS3"

    choice
        prompt "Version"
        default PKG_USING_ARDUINO_SEEED_LSM6DS3_LATEST_VERSION
        help
            Select the package version

        config PKG_USING_ARDUINO_SEEED_LSM6DS3_LATEST_VERSION
            bool "latest"
    endchoice

    config PKG_ARDUINO_SEEED_LSM6DS3_VER
       string
       default "latest"    if PKG_USING_ARDUINO_SEEED_LSM6DS3_LATEST_VERSION

endif
```

## arduino/sensors/Seeed-LTC2941/Kconfig
```kconfig
# Kconfig file for package Seeed-LTC2941
menuconfig PKG_USING_ARDUINO_SEEED_LTC2941
    bool "Seeed LTC2941: coulomb counter sensor"
    select PKG_USING_RTDUINO
    select RTDUINO_USING_WIRE
    default n

if PKG_USING_ARDUINO_SEEED_LTC2941

    config PKG_ARDUINO_SEEED_LTC2941_PATH
        string
        default "/packages/arduino/sensors/Seeed-LTC2941"

    choice
        prompt "Version"
        default PKG_USING_ARDUINO_SEEED_LTC2941_LATEST_VERSION
        help
            Select the package version

        config PKG_USING_ARDUINO_SEEED_LTC2941_LATEST_VERSION
            bool "latest"
    endchoice

    config PKG_ARDUINO_SEEED_LTC2941_VER
       string
       default "latest"    if PKG_USING_ARDUINO_SEEED_LTC2941_LATEST_VERSION

endif
```

## arduino/sensors/Seeed-MCP9600/Kconfig
```kconfig
# Kconfig file for package Seeed-MCP9600
menuconfig PKG_USING_ARDUINO_SEEED_MCP9600
    bool "Seeed MCP9600: digital temperature sensor"
    select PKG_USING_RTDUINO
    select RTDUINO_USING_WIRE
    default n

if PKG_USING_ARDUINO_SEEED_MCP9600

    config PKG_ARDUINO_SEEED_MCP9600_PATH
        string
        default "/packages/arduino/sensors/Seeed-MCP9600"

    choice
        prompt "Version"
        default PKG_USING_ARDUINO_SEEED_MCP9600_LATEST_VERSION
        help
            Select the package Version

        config PKG_USING_ARDUINO_SEEED_MCP9600_LATEST_VERSION
            bool "latest"
    endchoice

    config PKG_ARDUINO_SEEED_MCP9600_VER
       string
       default "latest"    if PKG_USING_ARDUINO_SEEED_MCP9600_LATEST_VERSION

endif
```

## arduino/sensors/Seeed-MMA7660/Kconfig
```kconfig
# Kconfig file for package Seeed-MMA7660
menuconfig PKG_USING_ARDUINO_SEEED_MMA7660
    bool "Seeed MMA7660: 3-Axis Digital Accelerometer"
    select PKG_USING_RTDUINO
    select RTDUINO_USING_WIRE
    default n

if PKG_USING_ARDUINO_SEEED_MMA7660

    config PKG_ARDUINO_SEEED_MMA7660_PATH
        string
        default "/packages/arduino/sensors/Seeed-MMA7660"

    choice
        prompt "Version"
        default PKG_USING_ARDUINO_SEEED_MMA7660_LATEST_VERSION
        help
            Select the package version

        config PKG_USING_ARDUINO_SEEED_MMA7660_LATEST_VERSION
            bool "latest"
    endchoice

    config PKG_ARDUINO_SEEED_MMA7660_VER
       string
       default "latest"    if PKG_USING_ARDUINO_SEEED_MMA7660_LATEST_VERSION

endif
```

## arduino/sensors/Seeed-MP503/Kconfig
```kconfig
# Kconfig file for package Seeed-MP503
menuconfig PKG_USING_ARDUINO_SEEED_MP503
    bool "Seeed MP503: Air Quality Sensor"
    default n

if PKG_USING_ARDUINO_SEEED_MP503

    config PKG_SEEED_MP503_PATH
        string
        default "/packages/arduino/sensors/Seeed-MP503"

    choice
        prompt "Version"
        default PKG_USING_ARDUINO_SEEED_MP503_LATEST_VERSION
        help
            Select the package version

        config PKG_USING_ARDUINO_SEEED_MP503_LATEST_VERSION
            bool "latest"
    endchoice

    config PKG_SEEED_MP503_VER
       string
       default "latest"    if PKG_USING_ARDUINO_SEEED_MP503_LATEST_VERSION

endif
```

## arduino/sensors/Seeed-PAJ7620/Kconfig
```kconfig
# Kconfig file for package Seeed-PAJ7620
menuconfig PKG_USING_ARDUINO_SEEED_PAJ7620
    bool "Seeed PAJ7620: gesture recognition function sensor"
    select PKG_USING_RTDUINO
    select RTDUINO_USING_WIRE
    default n

if PKG_USING_ARDUINO_SEEED_PAJ7620

    config PKG_ARDUINO_SEEED_PAJ7620_PATH
        string
        default "/packages/arduino/sensors/Seeed-PAJ7620"

    choice
        prompt "Version"
        default PKG_USING_ARDUINO_SEEED_PAJ7620_LATEST_VERSION
        help
            Select the package version

        config PKG_USING_ARDUINO_SEEED_PAJ7620_LATEST_VERSION
            bool "latest"
    endchoice

    config PKG_ARDUINO_SEEED_PAJ7620_VER
       string
       default "latest"    if PKG_USING_ARDUINO_SEEED_PAJ7620_LATEST_VERSION

endif
```

## arduino/sensors/Seeed-SHT31/Kconfig
```kconfig
# Kconfig file for package Seeed-SHT31
menuconfig PKG_USING_ARDUINO_SEEED_SHT31
    bool "Seeed SHT31: Temperature Humidity Sensor"
    select PKG_USING_RTDUINO
    select RTDUINO_USING_WIRE
    default n

if PKG_USING_ARDUINO_SEEED_SHT31

    config PKG_ARDUINO_SEEED_SHT31_PATH
        string
        default "/packages/arduino/sensors/Seeed-SHT31"

    choice
        prompt "Version"
        default PKG_USING_ARDUINO_SEEED_SHT31_LATEST_VERSION
        help
            Select the package version

        config PKG_USING_ARDUINO_SEEED_SHT31_LATEST_VERSION
            bool "latest"
    endchoice

    config PKG_ARDUINO_SEEED_SHT31_VER
       string
       default "latest"    if PKG_USING_ARDUINO_SEEED_SHT31_LATEST_VERSION

endif
```

## arduino/sensors/Seeed-SHT35/Kconfig
```kconfig
# Kconfig file for package Seeed-SHT35
menuconfig PKG_USING_ARDUINO_SEEED_SHT35
    bool "Seeed SHT35: temperature and humidity sensors"
    select PKG_USING_RTDUINO
    select RTDUINO_USING_WIRE
    default n

if PKG_USING_ARDUINO_SEEED_SHT35

    config PKG_ARDUINO_SEEED_SHT35_PATH
        string
        default "/packages/arduino/sensors/Seeed-SHT35"

    choice
        prompt "Version"
        default PKG_USING_ARDUINO_SEEED_SHT35_LATEST_VERSION
        help
            Select the package version

        config PKG_USING_ARDUINO_SEEED_SHT35_LATEST_VERSION
            bool "latest"
    endchoice

    config PKG_ARDUINO_SEEED_SHT35_VER
       string
       default "latest"    if PKG_USING_ARDUINO_SEEED_SHT35_LATEST_VERSION

endif
```

## arduino/sensors/Seeed-Si1145/Kconfig
```kconfig
# Kconfig file for package Seeed-Si1145
menuconfig PKG_USING_ARDUINO_SEEED_SI1145
    bool "Seeed Si1145: Sunlight Sensor"
    select PKG_USING_RTDUINO
    select RTDUINO_USING_WIRE
    default n

if PKG_USING_ARDUINO_SEEED_SI1145

    config PKG_ARDUINO_SEEED_SI1145_PATH
        string
        default "/packages/arduino/sensors/Seeed-Si1145"

    choice
        prompt "Version"
        default PKG_USING_ARDUINO_SEEED_SI1145_LATEST_VERSION
        help
            Select the package version

        config PKG_USING_ARDUINO_SEEED_SI1145_LATEST_VERSION
            bool "latest"
    endchoice

    config PKG_ARDUINO_SEEED_SI1145_VER
       string
       default "latest"    if PKG_USING_ARDUINO_SEEED_SI1145_LATEST_VERSION

endif
```

## arduino/sensors/Seeed-TCS3414CS/Kconfig
```kconfig
# Kconfig file for package Seeed-TCS3414CS
menuconfig PKG_USING_ARDUINO_SEEED_TCS3414CS
    bool "Seeed TCS3414CS: I2C Color Sensor"
    select PKG_USING_RTDUINO
    select RTDUINO_USING_WIRE
    default n

if PKG_USING_ARDUINO_SEEED_TCS3414CS

    config PKG_ARDUINO_SEEED_TCS3414CS_PATH
        string
        default "/packages/arduino/sensors/Seeed-TCS3414CS"

    choice
        prompt "Version"
        default PKG_USING_ARDUINO_SEEED_TCS3414CS_LATEST_VERSION
        help
            Select the package version

        config PKG_USING_ARDUINO_SEEED_TCS3414CS_LATEST_VERSION
            bool "latest"
    endchoice

    config PKG_ARDUINO_SEEED_TCS3414CS_VER
       string
       default "latest"    if PKG_USING_ARDUINO_SEEED_TCS3414CS_LATEST_VERSION

endif
```

## arduino/sensors/Seeed-TSL2561/Kconfig
```kconfig
# Kconfig file for package Seeed-TSL2561
menuconfig PKG_USING_ARDUINO_SEEED_TSL2561
    bool "Seeed TSL2561/ISL29035: Digital Light Sensor"
    select PKG_USING_RTDUINO
    select RTDUINO_USING_WIRE
    default n

if PKG_USING_ARDUINO_SEEED_TSL2561

    config PKG_ARDUINO_SEEED_TSL2561_PATH
        string
        default "/packages/arduino/sensors/Seeed-TSL2561"

    choice
        prompt "Version"
        default PKG_USING_ARDUINO_SEEED_TSL2561_LATEST_VERSION
        help
            Select the package version

        config PKG_USING_ARDUINO_SEEED_TSL2561_LATEST_VERSION
            bool "latest"
    endchoice

    config PKG_ARDUINO_SEEED_TSL2561_VER
       string
       default "latest"    if PKG_USING_ARDUINO_SEEED_TSL2561_LATEST_VERSION

endif
```

## arduino/sensors/Seeed-VEML6070/Kconfig
```kconfig
# Kconfig file for package Seeed-VEML6070
menuconfig PKG_USING_ARDUINO_SEEED_VEML6070
    bool "Seeed VEML6070: advanced ultraviolet (UV) light sensor"
    select PKG_USING_RTDUINO
    select RTDUINO_USING_WIRE
    default n

if PKG_USING_ARDUINO_SEEED_VEML6070

    config PKG_ARDUINO_SEEED_VEML6070_PATH
        string
        default "/packages/arduino/sensors/Seeed-VEML6070"

    choice
        prompt "Version"
        default PKG_USING_ARDUINO_SEEED_VEML6070_LATEST_VERSION
        help
            Select the package version

        config PKG_USING_ARDUINO_SEEED_VEML6070_LATEST_VERSION
            bool "latest"
    endchoice

    config PKG_ARDUINO_SEEED_VEML6070_VER
       string
       default "latest"    if PKG_USING_ARDUINO_SEEED_VEML6070_LATEST_VERSION

endif
```
