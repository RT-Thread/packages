## misc/entertainment/cal/Kconfig
```kconfig
# Kconfig file for package cal
menuconfig PKG_USING_CAL
    bool "cal: a terminal calendar"
    default n

if PKG_USING_CAL

    config PKG_CAL_PATH
        string
        default "/packages/misc/entertainment/cal"

    config PKG_CAL_VER
       string
       default "latest"

endif
```

## misc/entertainment/cmatrix/Kconfig
```kconfig
# Kconfig file for package cmatrix
menuconfig PKG_USING_CMATRIX
    bool "cmatrix: text flying in and out in a terminal like as seen in 'The Matrix' movie"
    select PKG_USING_VT100
    default n

if PKG_USING_CMATRIX

    config PKG_CMATRIX_PATH
        string
        default "/packages/misc/entertainment/cmatrix"

    config PKG_CMATRIX_VER
       string
       default "latest"

endif
```

## misc/entertainment/cowsay/Kconfig
```kconfig
# Kconfig file for package cowsay
menuconfig PKG_USING_COWSAY
    bool "cowsay: greeting from console"
    default n

if PKG_USING_COWSAY

    config PKG_COWSAY_PATH
        string
        default "/packages/misc/entertainment/cowsay"

    config PKG_COWSAY_VER
       string
       default "latest"

endif
```

## misc/entertainment/donut/Kconfig
```kconfig
# Kconfig file for package donut
menuconfig PKG_USING_DONUT
    bool "donut: a 3D spinning donut"
    default n

if PKG_USING_DONUT

    config PKG_DONUT_PATH
        string
        default "/packages/misc/entertainment/donut"

    config PKG_DONUT_VER
       string
       default "latest"

endif
```

## misc/entertainment/morse/Kconfig
```kconfig
menuconfig PKG_USING_MORSE
    bool "Morse code (摩尔斯电码)"
    default n

if PKG_USING_MORSE

    config PKG_MORSE_PATH
        string
        default "/packages/misc/entertainment/morse"

    config PKG_USING_MORSE_DI_DA_SEPARATE
        int
        prompt "Di da separate time ms"
        default 150
    config PKG_USING_MORSE_INTERCHAR
        int
        prompt "Interchar time ms"
        default 300

    config PKG_USING_MORSE_SHELL
        bool "Enable MORSE SHELL"
        default n

    config PKG_USING_MORSE_SAMPLE
        bool "Enable MORSE SAMPLE"
        default n

    if PKG_USING_MORSE_SAMPLE
        choice
            prompt "Samples"
            help
                Select the this package samples
            config PKG_USING_MORSE_KEY_SAMPLE
                bool "KEY_SAMPLE"
            config PKG_USING_MORSE_TPAD_SAMPLE
                bool "TPAD_SAMPLE(ALIENTEK)"
            config PKG_USING_MORSE_SLIDER_SAMPLE
                select BSP_USING_SLIDER
                bool "SLIDER_SAMPLE(Infineon)"
        endchoice
    endif

    choice
        prompt "Version"
        help
            Select the package version

        config PKG_USING_MORSE_V000001
            bool "v0.0.1"

        config PKG_USING_MORSE_LATEST_VERSION
            bool "latest"

    endchoice

    config PKG_MORSE_VER
       string
       default "v0.0.1"    if PKG_USING_MORSE_V000001
       default "latest"    if PKG_USING_MORSE_LATEST_VERSION

endif
```

## misc/entertainment/parkour/Kconfig
```kconfig
# Kconfig file for package parkour
menuconfig PKG_USING_PARKOUR
    bool "parkour:a game of a little person running over your terminal"
	select PKG_USING_VT100
    default n

if PKG_USING_PARKOUR

    config PKG_PARKOUR_PATH
        string
        default "/packages/misc/entertainment/parkour"

    choice
        prompt "Version"
        default PKG_USING_PARKOUR_LATEST_VERSION
        help
            Select the package version     

        config PKG_USING_PARKOUR_LATEST_VERSION
            bool "latest"
    endchoice
          
    config PKG_PARKOUR_VER
       string
       default "latest"    if PKG_USING_PARKOUR_LATEST_VERSION

endif
```

## misc/entertainment/sl/Kconfig
```kconfig
# Kconfig file for package sl
menuconfig PKG_USING_SL
    bool "sl: steam locomotive runs across your terminal when you type 'sl' as you meant to type 'ls'"
    select PKG_USING_VT100
    default n

if PKG_USING_SL

    config PKG_SL_PATH
        string
        default "/packages/misc/entertainment/sl"

    config PKG_SL_VER
       string
       default "latest"

endif
```

## misc/entertainment/snake/Kconfig
```kconfig
# Kconfig file for package snake
menuconfig PKG_USING_SNAKE
    bool "snake: a remake of the old nokia game"
    select RT_USING_POSIX_FS if RT_VER_NUM >= 0x40100
    select RT_USING_POSIX_TERMIOS
    default n

if PKG_USING_SNAKE

    config PKG_SNAKE_PATH
        string
        default "/packages/misc/entertainment/snake"

    config PKG_SNAKE_VER
       string
       default "latest"

endif
```

## misc/entertainment/tetris/Kconfig
```kconfig
# Kconfig file for package tetris
menuconfig PKG_USING_TETRIS
    bool "Tetris: An indie puzzle video game run on RT-Thread console"
    select PKG_USING_VT100
    default n

if PKG_USING_TETRIS

    config PKG_TETRIS_PATH
        string
        default "/packages/misc/entertainment/tetris"

    config PKG_TETRIS_VER
       string
       default "latest"

endif
```

## misc/entertainment/threes/Kconfig
```kconfig
# Kconfig file for package threes
menuconfig PKG_USING_THREES
    bool "threes: An indie puzzle video game run on RT-Thread console"
    select RT_USING_DFS         if RT_VER_NUM < 0x40100
    select RT_USING_POSIX       if RT_VER_NUM < 0x40100
    select RT_USING_LIBC        if RT_VER_NUM < 0x40100
    select RT_USING_POSIX_FS    if RT_VER_NUM >= 0x40100
    select RT_USING_POSIX_TERMIOS
    default n


if PKG_USING_THREES

    config PKG_THREES_PATH
        string
        default "/packages/misc/entertainment/threes"

    config PKG_THREES_VER
       string
       default "latest"

endif
```

## misc/fastlz/Kconfig
```kconfig
menuconfig PKG_USING_FASTLZ
    bool "Fastlz: A portable real-time compression library"
    default n
    help
        FastLZ is very fast and thus suitable for real-time compression
        and decompression.
        Perfect to gain more space with almost zero effort.

if PKG_USING_FASTLZ

    config PKG_FASTLZ_PATH
        string
        default "/packages/misc/fastlz"

    config FASTLZ_USING_SAMPLE
        bool "Enable using fastlz sample"
        default n
        select RT_USING_DFS

    if FASTLZ_USING_SAMPLE

        config FASTLZ_SAMPLE_COMPRESSION_LEVEL
            help
                Set to 1 or 2. Level 1 is the fastest compression and generally useful for short data.
                Level 2 is slightly slower but it gives better compression ratio.
            int "The level of compression"
            default 1
            range 1 2
    endif

    choice
        prompt "version"
        default PKG_USING_FASTLZ_V101
        help
            Select the fastlz version

        config PKG_USING_FASTLZ_LATEST_VERSION
            bool "latest"

        config PKG_USING_FASTLZ_V101
            bool "v1.0.1"

        config PKG_USING_FASTLZ_V100
            bool "v1.0.0"

    endchoice

    config PKG_FASTLZ_VER
       string
       default "v1.0.1"    if PKG_USING_FASTLZ_V101
       default "v1.0.0"    if PKG_USING_FASTLZ_V100
       default "latest"    if PKG_USING_FASTLZ_LATEST_VERSION

endif
```
