## tools/EasyLogger/Kconfig
```kconfig
menuconfig PKG_USING_EASYLOGGER
    bool "EasyLogger: A ultra-lightweight, high-performance C/C++ log library"
    default n

if PKG_USING_EASYLOGGER

menu "EasyLogger Options"

    config PKG_EASYLOGGER_ENABLE_OUTPUT
        bool
        prompt "Enable log output"
        default y

    choice
        prompt "Static output log level"
        default PKG_EASYLOGGER_OUTPUT_LVL_VERBOSE
        help
          Select the output log level. The logs which below the select log level will not be output.
        config PKG_EASYLOGGER_OUTPUT_LVL_ASSERT
            bool "ASSERT"
        config PKG_EASYLOGGER_OUTPUT_LVL_ERROR
            bool "ERROR"
        config PKG_EASYLOGGER_OUTPUT_LVL_WARN
            bool "WARN"
        config PKG_EASYLOGGER_OUTPUT_LVL_INFO
            bool "INFO"
        config PKG_EASYLOGGER_OUTPUT_LVL_VERBOSE
            bool "VERBOSE"
    endchoice

    config PKG_EASYLOGGER_ENABLE_ASSERT
        bool
        prompt "Enable assert check"
        default y

    config PKG_EASYLOGGER_LINE_BUF_SIZE
        int
        prompt "Buffer size for every line's log"
        default 256

    config PKG_EASYLOGGER_FILTER_TAG_MAX_LEN
        int
        prompt "Output filter's tag max length"
        default 30

    config PKG_EASYLOGGER_FILTER_KW_MAX_LEN
        int
        prompt "Output filter's keyword max length"
        default 16

    choice
        prompt "Output newline sign"
        default PKG_EASYLOGGER_NEWLINE_SIGN_CRLF
        config PKG_EASYLOGGER_NEWLINE_SIGN_CRLF
            bool "\\r\\n"
        config PKG_EASYLOGGER_NEWLINE_SIGN_LF
            bool "\\n"
        config PKG_EASYLOGGER_NEWLINE_SIGN_CR
            bool "\\r"
    endchoice

    config PKG_EASYLOGGER_ENABLE_COLOR
        bool
        prompt "Enable color log"
        default y

    config PKG_EASYLOGGER_ENABLE_ASYNC_OUTPUT
        bool
        prompt "Enable asynchronous output mode"
        default n

    config PKG_EASYLOGGER_ASYNC_OUTPUT_BUF_SIZE
        int
        prompt "Buffer size for asynchronous output mode"
        default 512
        depends on PKG_EASYLOGGER_ENABLE_ASYNC_OUTPUT

    config PKG_EASYLOGGER_ASYNC_LINE_OUTPUT
        bool
        prompt "Output's log which must end with newline sign"
        default y
        depends on PKG_EASYLOGGER_ENABLE_ASYNC_OUTPUT

    config PKG_EASYLOGGER_ASYNC_OUTPUT_USING_PTHREAD
        bool
        prompt "Using POSIX pthread implementation"
        default n
        depends on PKG_EASYLOGGER_ENABLE_ASYNC_OUTPUT
        select RT_USING_PTHREADS

    config PKG_EASYLOGGER_ENABLE_PLUGIN_FLASH
        bool
        prompt "Enable flash plugin"
        default n
        select PKG_USING_EASYFLASH
        select PKG_EASYFLASH_LOG

    config PKG_EASYLOGGER_FLASH_BUF_SIZE
        int
        prompt "Flash log plugin's RAM buffer size"
        default 1024
        depends on PKG_EASYLOGGER_ENABLE_PLUGIN_FLASH
endmenu

    config PKG_EASYLOGGER_PATH
        string
        default "/packages/tools/EasyLogger"

    choice
        prompt "Version"
        help
            Select the this package version

        config PKG_USING_EASYLOGGER_V200
            bool "v2.0.0"

        config PKG_USING_EASYLOGGER_LATEST_VERSION
            bool "latest"
    endchoice

    config PKG_EASYLOGGER_VER
        string
        default "v2.0.0" if PKG_USING_EASYLOGGER_V200
        default "latest" if PKG_USING_EASYLOGGER_LATEST_VERSION

endif
```

## tools/Kconfig
```kconfig
menu "tools packages"

source "$PKGS_DIR/packages/tools/CmBacktrace/Kconfig"
source "$PKGS_DIR/packages/tools/EasyFlash/Kconfig"
source "$PKGS_DIR/packages/tools/EasyLogger/Kconfig"
source "$PKGS_DIR/packages/tools/SystemView/Kconfig"
source "$PKGS_DIR/packages/tools/SEGGER_RTT/Kconfig"
source "$PKGS_DIR/packages/tools/rtt_auto_exe_cmd/Kconfig"
source "$PKGS_DIR/packages/tools/rdb/Kconfig"
source "$PKGS_DIR/packages/tools/ulog_easyflash/Kconfig"
source "$PKGS_DIR/packages/tools/ulog_file/Kconfig"
source "$PKGS_DIR/packages/tools/logmgr/Kconfig"
source "$PKGS_DIR/packages/tools/adbd/Kconfig"
source "$PKGS_DIR/packages/tools/CoreMark/Kconfig"
source "$PKGS_DIR/packages/tools/Dhrystone/Kconfig"
source "$PKGS_DIR/packages/tools/MemoryPerf/Kconfig"
source "$PKGS_DIR/packages/tools/nr_micro_shell/Kconfig"
source "$PKGS_DIR/packages/tools/ChineseFontLibrary/Kconfig"
source "$PKGS_DIR/packages/tools/lunar_calendar/Kconfig"
source "$PKGS_DIR/packages/tools/bs8116a/Kconfig"
source "$PKGS_DIR/packages/tools/gps_rmc/Kconfig"
source "$PKGS_DIR/packages/tools/UrlEncode/Kconfig"
source "$PKGS_DIR/packages/tools/uMCN/Kconfig"
source "$PKGS_DIR/packages/tools/lwrb2rtt/Kconfig"
source "$PKGS_DIR/packages/tools/cpu_usage/Kconfig"
source "$PKGS_DIR/packages/tools/gbk2utf8/Kconfig"
source "$PKGS_DIR/packages/tools/vconsole/Kconfig"
source "$PKGS_DIR/packages/tools/mbedtls_bench/Kconfig"
source "$PKGS_DIR/packages/tools/kdb/Kconfig"
source "$PKGS_DIR/packages/tools/wamr/Kconfig"
source "$PKGS_DIR/packages/tools/Micro-XRCE-DDS-Client/Kconfig"
source "$PKGS_DIR/packages/tools/lwlog/Kconfig"
source "$PKGS_DIR/packages/tools/anv_trace/Kconfig"
source "$PKGS_DIR/packages/tools/anv_memleak/Kconfig"
source "$PKGS_DIR/packages/tools/anv_testsuit/Kconfig"
source "$PKGS_DIR/packages/tools/anv_bench/Kconfig"
source "$PKGS_DIR/packages/tools/devmem/Kconfig"
source "$PKGS_DIR/packages/tools/regex/Kconfig"
source "$PKGS_DIR/packages/tools/mem_sandbox/Kconfig"
source "$PKGS_DIR/packages/tools/solar_terms/Kconfig"
source "$PKGS_DIR/packages/tools/gan_zhi/Kconfig"
source "$PKGS_DIR/packages/tools/fdt/Kconfig"
source "$PKGS_DIR/packages/tools/cBox/Kconfig"
source "$PKGS_DIR/packages/tools/snowflake/Kconfig"
source "$PKGS_DIR/packages/tools/hash-match/Kconfig"
source "$PKGS_DIR/packages/tools/armv7m_DWT/Kconfig"
source "$PKGS_DIR/packages/tools/vofa_plus/Kconfig"
source "$PKGS_DIR/packages/tools/RT_Trace/Kconfig"
source "$PKGS_DIR/packages/tools/zdebug/Kconfig"
source "$PKGS_DIR/packages/tools/RVBacktrace/Kconfig"
source "$PKGS_DIR/packages/tools/hpatchlite-wrapper/Kconfig"
endmenu
```

## tools/MCoreDump/Kconfig
```kconfig
menuconfig PKG_USING_MCOREDUMP
    bool "MCoreDump: Advanced fault backtrace library for ARM Cortex-M series MCU."
    default n

if PKG_USING_MCOREDUMP

    if PKG_USING_MCOREDUMP

		choice
			prompt "Select the arch"
			default PKG_USING_MCOREDUMP_ARCH_ARMV7M
			help
				Select the arch

			config PKG_USING_MCOREDUMP_ARCH_ARMV7M
				bool "armv7m"

			config PKG_USING_MCOREDUMP_ARCH_ARMV8M
				bool "armv8m"
		endchoice

		config PKG_USING_MCOREDUMP_EXAMPLE
			bool "Using coredump example"
			default y
			help
				Enable MCoreDump example code

		config PKG_MCOREDUMP_MEMORY_SIZE
			int "Coredump memory buffer size (bytes)"
			default 8192
			range 1024 65536
			help
				Size of the static memory buffer for coredump storage.
				This buffer is placed in .noinit section and persists across resets.
				Minimum: 1KB, Default: 8KB

		config PKG_USING_MCOREDUMP_FILESYSTEM
			bool "Using filesystem for coredump storage"
			default n
			depends on RT_USING_DFS
			help
				Enable filesystem support for saving coredumps to files.
				Requires DFS (Device File System) to be enabled.
				If not enabled, filesystem-related functions will be disabled.

		if PKG_USING_MCOREDUMP_FILESYSTEM

			config PKG_MCOREDUMP_FILESYSTEM_DIR
				string "Coredump directory path"
				default "/sdcard"
				help
					Directory path where coredump files will be saved.

			config PKG_MCOREDUMP_FILESYSTEM_PREFIX
				string "Coredump file prefix"
				default "core_"
				help
					Prefix for coredump filenames.
		endif
    endif

    config PKG_MCOREDUMP_PATH
        string
        default "/packages/tools/MCoreDump"

    choice
        prompt "Version"
        default PKG_USING_MCOREDUMP_LATEST_VERSION
        help
            Select the this package version

        config PKG_USING_MCOREDUMP_LATEST_VERSION
            bool "latest"
    endchoice

    config PKG_MCOREDUMP_VER
        string
        default "latest" if PKG_USING_MCOREDUMP_LATEST_VERSION

    config PKG_MCOREDUMP_VER_NUM
        hex
        default 0x99999    if PKG_USING_MCOREDUMP_LATEST_VERSION

endif
```

## tools/MemoryPerf/Kconfig
```kconfig
# Kconfig file for package MemoryPerf
menuconfig PKG_USING_MEMORYPERF
    bool "MemoryPerf: Memory Performance Testing"
    default n

if PKG_USING_MEMORYPERF

    config PKG_MEMORYPERF_PATH
        string
        default "/packages/tools/MemoryPerf"

    choice
        prompt "Version"
        default PKG_USING_MEMORYPERF_LATEST_VERSION
        help
            Select the package version

        config PKG_USING_MEMORYPERF_V100
            bool "v1.0.0"

        config PKG_USING_MEMORYPERF_LATEST_VERSION
            bool "latest"
    endchoice

    if !PKG_USING_MEMORYPERF_V100
        choice
            prompt "CPU ARCH"
            default PKG_MEMORYPERF_ARCH_ARM
            help
                Select the package cpu arch

            config PKG_MEMORYPERF_ARCH_ARM
                bool "ARM"

            config PKG_MEMORYPERF_ARCH_RISCV
                bool "RISC-V"
        endchoice
    endif

    config PKG_MEMORYPERF_ENABLE_64BIT
        bool "Enable 64bit"
        default n

    config PKG_MEMORYPERF_USING_HEAP
        bool "mem alloc using heap"
        default n
        if PKG_MEMORYPERF_USING_HEAP
        config PKG_MEMORYPERF_ALLOC_SIZE
            hex "mem alloc size"
            default 0x100000
        endif

    config PKG_MEMORYPERF_VER
       string
       default "v1.0.0"    if PKG_USING_MEMORYPERF_V100
       default "latest"    if PKG_USING_MEMORYPERF_LATEST_VERSION

endif
```

## tools/Micro-XRCE-DDS-Client/Kconfig
```kconfig
# Kconfig file for package Micro-XRCE-DDS-Client
menuconfig PKG_USING_MICRO_XRCE_DDS_CLIENT
    select RT_USING_POSIX_SOCKET
    select RT_USING_POSIX_FS
    select RT_USING_POSIX_SELECT
    bool "Micro-XRCE-DDS-Client: The middleware component of micro-ros, which provides ros2 topic pub/sub ability"
    default n

if PKG_USING_MICRO_XRCE_DDS_CLIENT

    menu "Micro-XRCE-DDS-Client Options"

    config MICRO_XRCE_DDS_CLIENT_USING_EXAMPLE
        bool
        prompt "Enable uros examples"
        default y

    endmenu

    config PKG_MICRO_XRCE_DDS_CLIENT_PATH
        string
        default "/packages/tools/Micro-XRCE-DDS-Client"

    choice
        prompt "Version"
        default PKG_USING_MICRO_XRCE_DDS_CLIENT_LATEST_VERSION
        help
            Select the package version

        config PKG_USING_MICRO_XRCE_DDS_CLIENT_LATEST_VERSION
            bool "latest"
    endchoice

    config PKG_MICRO_XRCE_DDS_CLIENT_VER
       string
       default "latest"    if PKG_USING_MICRO_XRCE_DDS_CLIENT_LATEST_VERSION

endif
```

## tools/RT-Tunnel/Kconfig
```kconfig
# Kconfig file for package RT-Tunnel
menuconfig PKG_USING_RT_TUNNEL
    bool "RT-Tunnel: Auxiliary communication with RT-Trace tool and the target."
    default n

if PKG_USING_RT_TUNNEL

    config PKG_RT_TUNNEL_PATH
        string
        default "/packages/tools/RT-Tunnel"

    config TUNNEL_NUM
        int "Tunnel number"
        default 3

    config TUNNEL_BUFFER_SIZE
        int "Tunnel buffer size (bytes)"
        default 8192
        help
            Configure the buffer size for each tunnel.

    choice
        prompt "Version"
        help
            Select the package version

        config PKG_USING_RT_TUNNEL_V100
            bool "v1.0.0"

        config PKG_USING_RT_TUNNEL_LATEST_VERSION
            bool "latest"
    endchoice

    config PKG_RT_TUNNEL_VER
       string
       default "v1.0.0"    if PKG_USING_RT_TUNNEL_V100
       default "latest"    if PKG_USING_RT_TUNNEL_LATEST_VERSION

endif
```

## tools/RT_Trace/Kconfig
```kconfig
# Kconfig file for package RT_Trace
menuconfig PKG_USING_RT_TRACE
    depends on ARCH_ARM_CORTEX_M0 || ARCH_ARM_CORTEX_M3 || ARCH_ARM_CORTEX_M4 || ARCH_ARM_CORTEX_M7
    bool "RT_Trace:by using J-Link realizes event monitoring"
    default n

if PKG_USING_RT_TRACE

    config PKG_RT_TRACE_PATH
        string
        default "/packages/tools/RT_Trace"

    config CTF_USE_TIMESTAMP
        bool "Trace use timestamp"
        default n

    if CTF_USE_TIMESTAMP
        config FREQUENCY_OF_TIMESTAMP
            int "Frequency of timestamp"
            default 480000000
    endif

    config TRACE_PACKET_SIZE
        int "TRACE_PACKET_SIZE"
        default 2048
        help
            trace has two buffer, total size is TRACE_PACKET_SIZE * 2

    menu "Select listening events"

        config TRACE_LISTEN_SCHEDULE
            bool "listen thread schedule"
            default y
        config TRACE_LISTEN_TIMER
            bool "listen timmer"
            default y
        menuconfig TRACE_LISTEN_IPC
            bool "listen ipc"
            default n

            if TRACE_LISTEN_IPC
                config TRACE_LISTEN_SEM
                    bool "listen semaphore"
                    default y
                config TRACE_LISTEN_MUTEX
                    bool "listen mutex"
                    default n
                config TRACE_LISTEN_EVENT
                    bool "listen event(ipc)"
                    default n
                config TRACE_LISTEN_MB
                    bool "listen mailbox"
                    default n
                config TRACE_LISTEN_MQ
                    bool "listen message queue"
                    default n
            endif

    endmenu

    choice
        prompt "Version"
        default PKG_USING_RT_TRACE_LATEST_VERSION
        help
            Select the package version

        config PKG_USING_RT_TRACE_V001
            bool "v0.0.1"

        config PKG_USING_RT_TRACE_LATEST_VERSION
            bool "latest"
    endchoice

    config PKG_RT_TRACE_VER
       string
       default "v0.0.1"    if PKG_USING_RT_TRACE_V001
       default "latest"    if PKG_USING_RT_TRACE_LATEST_VERSION

endif
```

## tools/RVBacktrace/Kconfig
```kconfig
# Kconfig file for package RVBacktrace
menuconfig PKG_USING_RVBACKTRACE
    bool "RISC-V Minimalist Stack Traceback Components."
    default n

if PKG_USING_RVBACKTRACE
    config PKG_RVBACKTRACE_PATH
        string
        default "/packages/tools/RVBacktrace"

    if PKG_RVBACKTRACE_VER_NUM > 0x10001
        config BACKTRACE_USE_FP
            bool
            prompt "Use BACKTRACE_USE_FP -fno-omit-frame-pointer"
            default n
            help
                To enable this option, add the [-fno-omit-frame-pointer] option to ASM,C/C++.
        config BACKTRACE_FSTACK_PROTECT
            bool
            prompt "Use BACKTRACE_FSTACK_PROTECT -fstack-protector-strong"
            default n
            help
                To enable this option, add the [-fstack-protector-strong] option to ASM,C/C++, add [-Wl,--wrap,_exit] flag to link option.
        config BACKTRACE_ALL
            bool
            prompt "Outputs the stack of all threads"
            default n
            depends on BACKTRACE_USE_FP
            help
                Before enabling this option, enable the BACKTRACE_USE_FP / Outputs the stack of all threads
    endif

    choice
        prompt "Version"
        default PKG_USING_RVBACKTRACE_LATEST_VERSION
        help
            Select the package version

        config PKG_USING_RVBACKTRACE_V010001
            bool "v1.0.1"

        config PKG_USING_RVBACKTRACE_LATEST_VERSION
            bool "latest"
    endchoice

    config PKG_RVBACKTRACE_VER
       string
       default "v1.0.1"    if PKG_USING_RVBACKTRACE_V010001
       default "latest"    if PKG_USING_RVBACKTRACE_LATEST_VERSION

    config PKG_RVBACKTRACE_VER_NUM
        hex
        default 0x10001    if PKG_USING_RVBACKTRACE_V010001
        default 0x99999    if PKG_USING_RVBACKTRACE_LATEST_VERSION
endif
```
