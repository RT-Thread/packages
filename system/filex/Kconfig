## system/micro_ros_local/Kconfig
```kconfig
menuconfig PKG_USING_MICRO_ROS_RTTHREAD_PACKAGE
    bool "micro-ROS package for RTThread"
    select RT_USING_POSIX_FS
    select RT_USING_POSIX_SOCKET
    select RT_USING_POSIX_SELECT
    select RT_USING_SAL
    select BSP_USING_ONCHIP_RTC
    default n

if PKG_USING_MICRO_ROS_RTTHREAD_PACKAGE

    config PKG_MICRO_ROS_RTTHREAD_PACKAGE_PATH
        string
        default "/packages/system/micro_ros_local"

    config RTT_UCLIENT_PLATFORM_RTTHREAD
        bool "Using Micro XRCE-DDS Client Library in RT-Thread"
        default n

    config RTT_URCLC_PLATFORM_RTTHREAD
        bool "Using Micro rclc Library in RT-Thread"
        default y

    menu "Include examples"
        config PKG_RCLC_EXAMPLE
            bool "Enable micro-ROS rclc platform example"
            depends on RTT_URCLC_PLATFORM_RTTHREAD
            default y

        config PKG_UCLIENT_PLATFORM_EXAMPLE
            bool "Enable micro-ROS uxr platform example"
            depends on RTT_UCLIENT_PLATFORM_RTTHREAD
            default n
    endmenu

    choice
        prompt "Distribution"
        default PKG_MICRO_ROS_RTTHREAD_PACKAGE_FOXY_DISTRO
        help
            Select the micro-ROS distro

        config PKG_MICRO_ROS_RTTHREAD_PACKAGE_HUMBLE_DISTRO
            bool "Humble"

        config PKG_MICRO_ROS_RTTHREAD_PACKAGE_FOXY_DISTRO
            bool "Foxy"
    endchoice

    menu "Memory configuration"
        config PKG_MICRO_ROS_RTTHREAD_PACKAGE_MAX_NODES
            int "# Nodes"
            default 1

        config PKG_MICRO_ROS_RTTHREAD_PACKAGE_MAX_PUBLISHERS
            int "# Publishers"
            default 1

        config PKG_MICRO_ROS_RTTHREAD_PACKAGE_MAX_SUBSCRIBERS
            int "# Subscribers"
            default 1

        config PKG_MICRO_ROS_RTTHREAD_PACKAGE_MAX_SERVICES
            int "# Services"
            default 0

        config PKG_MICRO_ROS_RTTHREAD_PACKAGE_MAX_CLIENTS
            int "# Clients"
            default 0

    endmenu
        
    menu "ROS node communication mode"

        config PKG_MICRO_ROS_USE_SERIAL
            bool "serial"
            default n
            if PKG_MICRO_ROS_USE_SERIAL
                menu "serial configuration"
                    config MICRO_ROS_SERIAL_NAME
                        string "select the micro serial dev name"
                        default "vcom"
                endmenu
            endif

        config PKG_MICRO_ROS_USE_UDP
            bool "udp"
            default n
            if PKG_MICRO_ROS_USE_UDP
                menu "udp configuration"
                    config MICRO_ROS_UDP_IP
                        string "select the micro udp ip"
                        default "127.0.0.1"

                    config MICRO_ROS_UDP_PORT
                        string "select the micro udp port"
                        default "8080"
                endmenu
            endif
            
        config PKG_MICRO_ROS_USE_TCP
            bool "tcp"
            default n
            if PKG_MICRO_ROS_USE_TCP
                menu "tcp configuration"
                    config MICRO_ROS_TCP_IP
                        string "select the micro tcp ip"
                        default "127.0.0.1"

                    config MICRO_ROS_TCP_PORT
                        string "select the micro tcp port"
                        default "8080"
                endmenu
            endif

    endmenu
            
endif
```

## system/minIni/Kconfig
```kconfig
menuconfig PKG_USING_MININI
    bool "minIni: a portable and configurable library for reading and writing '.INI' files."
    default n

if PKG_USING_MININI

    config PKG_MININI_PATH
        string
        default "/packages/system/minIni"

    choice
        prompt "version"
        help
            Select the minIni version

        config PKG_USING_MININI_V120
            bool "v1.2.0"

        config PKG_USING_MININI_LATEST_VERSION
            bool "latest"
    endchoice

    default "v1.2.0" if PKG_USING_MININI_V120
    default "latest" if PKG_USING_MININI_LATEST_VERSION

endif
```

## system/mlibc/Kconfig
```kconfig
# Kconfig file for package mlibc
menuconfig PKG_USING_MLIBC
    bool "mlibc: Embedded libc, especially for RISC-V"
    select RT_USING_EXTERNAL_LIBC
    default n

if PKG_USING_MLIBC

    config PKG_MLIBC_PATH
        string
        default "/packages/system/mlibc"

    choice
        prompt "Version"
        help
            Select the package version

        config PKG_USING_MLIBC_LATEST_VERSION
            bool "latest"
    endchoice

    config PKG_MLIBC_VER
       string
       default "latest"    if PKG_USING_MLIBC_LATEST_VERSION

endif
```

## system/openamp/Kconfig
```kconfig
# Kconfig file for package openamp
menuconfig PKG_USING_OPENAMP
    bool "OpenAMP: openamp for RT-Thread"
    default n

if PKG_USING_OPENAMP
    config PKG_OPENAMP_PATH
        string
        default "/packages/system/openamp"

    config RT_USING_OPENAMP
    bool "ENABLE OpenAMP"
    default y

    config RT_USING_OPENAMP_TEST
        bool "ENABLE OpenAMP test"
    default y

    choice
        prompt "Version"
        help
            Select this package version

        config PKG_USING_OPENAMP_V10000
            bool "v1.0.0"

        config PKG_USING_OPENAMP_LATEST_VERSION
            bool "latest"
    endchoice

    config PKG_OPENAMP_VER
        string
        default "v1.0.0" if PKG_USING_OPENAMP_V10000
        default "latest" if PKG_USING_OPENAMP_LATEST_VERSION

endif
```

## system/partition/Kconfig
```kconfig
menuconfig PKG_USING_PARTITION
    bool "partition: A simple partition for block device in rt-thread."
    default n

if PKG_USING_PARTITION

    config PKG_PARTITION_PATH
        string
        default "/packages/system/partition"

    config PKG_PARTITION_VER
        string
        default "v1.0.1"

endif
```

## system/perf_counter/Kconfig
```kconfig
# Kconfig file for package perf_counter
menuconfig PKG_USING_PERF_COUNTER
    bool "perf_counter: A dedicated performance counter for Cortex-M systick"
    select RT_USING_HOOK
    select RT_HOOK_USING_FUNC_PTR
    default n

if PKG_USING_PERF_COUNTER

    config PKG_PERF_COUNTER_PATH
        string
        default "/packages/system/perf_counter"

    config PKG_PERF_COUNTER_USING_THREAD_STATISTIC
        bool "Enable thread statistic"
        default n

    choice
        prompt "Version"
        help
            Select the package version

        config PKG_USING_PERF_COUNTER_V2241
            bool "v2.2.4.1"

        config PKG_USING_PERF_COUNTER_LATEST_VERSION
            bool "latest"
    endchoice

    config PKG_PERF_COUNTER_VER
       string
       default "v2.2.4.1"  if PKG_USING_PERF_COUNTER_V2241
       default "latest"    if PKG_USING_PERF_COUNTER_LATEST_VERSION

endif
```

## system/persimmon/Kconfig
```kconfig
if BOARD_X1000_REALBOARD
    config PKG_USING_PERSIMMON
        bool "Persimmon GUI component"
        select RT_USING_GUIENGINE
        default n
        help
            A GUI component running on RT-Thread real time operating system
			
    config RT_USING_PERSIMMON_EXAMPLE
        bool "Persimmon Examples"
		depends on PKG_USING_PERSIMMON
        default n
        help
            Basic examples for persimmon
endif

if PKG_USING_PERSIMMON

    config PKG_PERSIMMON_PATH
        string
        default "/packages/system/persimmon"

    config PKG_PERSIMMON_VER
        string
        default "v1.0.0"

endif
```

## system/pixman/Kconfig
```kconfig
menuconfig PKG_USING_PIXMAN
    bool "pixman is a library that provides low-level pixel manipulation"
    default n

if PKG_USING_PIXMAN

    config PKG_PIXMAN_PATH
        string
        default "/packages/system/pixman"

    choice
        prompt "version"
        help
            Select the persimmon version

        config PKG_USING_PIXMAN_LATEST_VERSION
            bool "latest"

        config PKG_USING_PIXMAN_V0244
            bool "v0.24.4"
        config PKG_USING_PIXMAN_V0340
            bool "v0.34.0"
    endchoice

    config PKG_PIXMAN_VER
        string
        default "v0.24.4" if PKG_USING_PIXMAN_V0244
        default "v0.34.0" if PKG_USING_PIXMAN_V0340
        default "latest" if PKG_USING_PIXMAN_LATEST_VERSION
endif
```

## system/plccore/Kconfig
```kconfig
# Kconfig file for package plccore
menuconfig PKG_USING_PLCCORE
    bool "plccore: A PLC(programmable logic controller) runtime kernel."
    default n

if PKG_USING_PLCCORE

    config PKG_PLCCORE_PATH
        string
        default "/packages/system/plccore"

    choice
        prompt "Version"
        default PKG_USING_PLCCORE_LATEST_VERSION
        help
            Select the package version

        config PKG_USING_PLCCORE_LATEST_VERSION
            bool "latest"
    endchoice
          
    config PKG_PLCCORE_VER
       string
       default "latest"    if PKG_USING_PLCCORE_LATEST_VERSION

endif
```

## system/qboot/Kconfig
```kconfig
# Kconfig file for package qboot

menuconfig PKG_USING_QBOOT
    bool "qboot : A component used to make bootloader quickly"
    select PKG_USING_FAL if RT_VER_NUM < 0x40100
    select RT_USING_FAL if RT_VER_NUM >= 0x40100
    select PKG_USING_CRCLIB
    default n

if PKG_USING_QBOOT

    config PKG_QBOOT_PATH
        string
        default "/packages/system/qboot"

    config QBOOT_USING_PRODUCT_CODE
        bool "using product code"
        default n

    if QBOOT_USING_PRODUCT_CODE
        config QBOOT_PRODUCT_CODE
            string "product code, maximum 20 characters"
            default "00010203040506070809"
    endif

    config QBOOT_APP_PART_NAME
        string "application partition name"
        default "app"

    config QBOOT_DOWNLOAD_PART_NAME
        string "download partition name"
        default "download"

    config QBOOT_FACTORY_PART_NAME
        string "factory partition name"
        default "factory"

    config QBOOT_USING_AES
        bool "using AES decrypt"
        select PKG_USING_TINYCRYPT
        select TINY_CRYPT_AES
        default n

    if QBOOT_USING_AES
        config QBOOT_AES_IV
            string "AES initialization vector, 16 characters"
            default "0123456789ABCDEF"

        config QBOOT_AES_KEY
            string "AES round keys, 32 characters"
            default "0123456789ABCDEF0123456789ABCDEF"
    endif

    config QBOOT_USING_GZIP
        bool "using gzip decompress"
        select PKG_USING_ZLIB
        default n

    config QBOOT_USING_QUICKLZ
        bool "using quicklz decompress"
        select PKG_USING_QUICKLZ
        default y

    config QBOOT_USING_FASTLZ
        bool "using fastlz decompress"
        select PKG_USING_FASTLZ
        default n

    config QBOOT_USING_SHELL
        bool "using shell command of qboot"
        default y

    if QBOOT_USING_SHELL
        config QBOOT_SHELL_KEY_CHK_TMO
            int "check timeout the [enter] key pressed, unit : s"
            default 5
    endif

    config QBOOT_USING_SYSWATCH
        bool "using syswatch component"
        select PKG_USING_SYSWATCH
        default y

    config QBOOT_USING_OTA_DOWNLOADER
        bool "using OTA_download component"
        select PKG_USING_OTA_DOWNLOADER
        select PKG_USING_YMODEM_OTA
        default y

    config QBOOT_USING_PRODUCT_INFO
        bool "using product infomation print"
        default y

    if QBOOT_USING_PRODUCT_INFO
        config QBOOT_PRODUCT_NAME
            string "product name"
            default "Qboot test device"

        config QBOOT_PRODUCT_VER
            string "product version"
            default "v1.00 2020.07.27"

        config QBOOT_PRODUCT_MCU
            string "product MCU chip model"
            default "stm32l4r5zi"
    endif

    config QBOOT_USING_STATUS_LED
        bool "using running status led"
        select PKG_USING_QLED
        default y

    if QBOOT_USING_STATUS_LED
        config QBOOT_STATUS_LED_PIN
            int "running status led pin"
            range 0 176
            default 0

        config QBOOT_STATUS_LED_LEVEL
            int "led on level"
            range 0 1
            default 1
    endif

    config QBOOT_USING_FACTORY_KEY
        bool "using resume factory key"
        default n

    if QBOOT_USING_FACTORY_KEY
        config QBOOT_FACTORY_KEY_PIN
            int "resume factory key pin"
            range 0 176
            default 1

        config QBOOT_FACTORY_KEY_LEVEL
            int "the level after key is pressed"
            range 0 1
            default 0

        config QBOOT_FACTORY_KEY_CHK_TMO
            int "timeout when the key is pressed continuously, unit : s"
            default 10
    endif

    config QBOOT_APP_RUN_IN_QSPI_FLASH
        bool "appl run in external flash"
        default n

    config QBOOT_THREAD_STACK_SIZE
        int "The stack size of thread"
        default 4096

    config QBOOT_THREAD_PRIO
        int "The priority of thread"
        default 5

    choice
        prompt "Version"
        default PKG_USING_QBOOT_LATEST_VERSION
        help
            Select the package version

        config PKG_USING_QBOOT_LATEST_VERSION
            bool "latest"

        config PKG_USING_QBOOT_V106
            bool "v1.06"

        config PKG_USING_QBOOT_V105
            bool "v1.05"

        config PKG_USING_QBOOT_V104
            bool "v1.04"

        config PKG_USING_QBOOT_V103
            bool "v1.03"

        config PKG_USING_QBOOT_V102
            bool "v1.02"

        config PKG_USING_QBOOT_V101
            bool "v1.01"

        config PKG_USING_QBOOT_V100
            bool "v1.00"
    endchoice

    config PKG_QBOOT_VER
       string
       default "latest" if PKG_USING_QBOOT_LATEST_VERSION
       default "v1.06" if PKG_USING_QBOOT_V106
       default "v1.05" if PKG_USING_QBOOT_V105
       default "v1.04" if PKG_USING_QBOOT_V104
       default "v1.03" if PKG_USING_QBOOT_V103
       default "v1.02" if PKG_USING_QBOOT_V102
       default "v1.01" if PKG_USING_QBOOT_V101
       default "v1.00" if PKG_USING_QBOOT_V100

endif
```

## system/qpc/Kconfig
```kconfig
# Kconfig file for package qpc
menuconfig PKG_USING_QPC
    bool "QP/C"
    default n

if PKG_USING_QPC

    config PKG_QPC_PATH
        string
        default "/packages/system/qpc"

    config QPC_USING_BLINKY_EXAMPLE
        bool "Enable Blinky Example"
        default n

    choice
        prompt "Version"
        default PKG_USING_QPC_LATEST_VERSION
        help
            Select the package version

        config PKG_USING_QPC_V700
            bool "v7.0.0"

        config PKG_USING_QPC_V722
            bool "v7.2.2"

        config PKG_USING_QPC_LATEST_VERSION
            bool "latest"
    endchoice

    config PKG_QPC_VER
       string
       default "v7.2.2"    if PKG_USING_QPC_V722
       default "v7.0.0"    if PKG_USING_QPC_V700
       default "latest"    if PKG_USING_QPC_LATEST_VERSION

endif
```
