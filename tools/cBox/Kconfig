## tools/cBox/Kconfig
```kconfig
# Kconfig file for package cBox
menuconfig PKG_USING_CBOX
    bool "CBOX: C language box."
    default n

if PKG_USING_CBOX

    config PKG_USING_CBOX_TEST
        bool "Using cBOX testcase"
        default n

    config PKG_CBOX_PATH
        string
        default "/packages/tools/cBox"

    choice
        prompt "Version"
        default PKG_USING_CBOX_LATEST_VERSION
        help
            Select the package version

        config PKG_USING_CBOX_LATEST_VERSION
            bool "latest"
    endchoice

    config PKG_CBOX_VER
       string
       default "latest"    if PKG_USING_CBOX_LATEST_VERSION

endif
```

## tools/cpu_usage/Kconfig
```kconfig
# Kconfig file for package cpu_usage
menuconfig PKG_USING_CPU_USAGE
    bool "CPUU: CPU usage statistics tool."
    default n

if PKG_USING_CPU_USAGE

    config PKG_CPU_USAGE_PATH
        string
        default "/packages/tools/cpu_usage"

    choice
        prompt "Version"
        default PKG_USING_CPU_USAGE_LATEST_VERSION
        help
            Select the package version

        config PKG_USING_CPU_USAGE_V100
            bool "v1.0.0"

        config PKG_USING_CPU_USAGE_LATEST_VERSION
            bool "latest"
    endchoice

    config PKG_CPU_USAGE_VER
       string
       default "v1.0.0"    if PKG_USING_CPU_USAGE_V100
       default "latest"    if PKG_USING_CPU_USAGE_LATEST_VERSION

endif
```

## tools/devmem/Kconfig
```kconfig
# Kconfig file for package devmem
menuconfig PKG_USING_DEVMEM
    bool "DEVMEM: read/write memory/register tools"
    default n

if PKG_USING_DEVMEM

    config PKG_DEVMEM_PATH
        string
        default "/packages/tools/devmem"

    choice
        prompt "Version"
        default PKG_USING_DEVMEM_LATEST_VERSION
        help
            Select the package version

        config PKG_USING_DEVMEM_V100
            bool "v1.0.0"

        config PKG_USING_DEVMEM_LATEST_VERSION
            bool "latest"
    endchoice

    config PKG_DEVMEM_VER
       string
       default "v1.0.0"    if PKG_USING_DEVMEM_V100
       default "latest"    if PKG_USING_DEVMEM_LATEST_VERSION

endif
```

## tools/dhrystone/Kconfig
```kconfig
menuconfig PKG_USING_DHRYSTONE
    bool "DHRYSTONE: a benchmark that measures the performance of MCUs and CPUs."
    default n

if PKG_USING_DHRYSTONE

    config DHRY_ITERS
        int "Run the benchmark for a specified number of iterations."
        default "320000"
    comment "You may ajust this number to make sure the benchmark runs long enough"

    config PKG_DHRYSTONE_PATH
        string
        default "/packages/tools/dhrystone"

    choice
        prompt "Version"
        default PKG_USING_DHRYSTONE_LATEST_VERSION
        help
            Select the this package version
            
        config PKG_USING_DHRYSTONE_LATEST_VERSION
            bool "latest"
    endchoice

    config PKG_DHRYSTONE_VER
        string
        default "latest" if PKG_USING_DHRYSTONE_LATEST_VERSION

endif
```

## tools/dict/Kconfig
```kconfig
# Kconfig for package dict
menuconfig PKG_USING_DICT
    bool "dict: a general-purpose dictionary module"
    default n

if PKG_USING_DICT
    config PKG_DICT_PATH
        string
        default "/packages/tools/dict"

    config DICT_DEFAULT_CAPACITY
    int "Default initial capacity"
    default 32
    range 8 65536
    help
        Set the default bucket array capacity when creating a dictionary
        without specifying a configuration. Recommended values: 16/32/64.
        Higher values reduce resize operations but consume more memory.


    config DICT_LOAD_FACTOR_X100
    int "Load factor (x100)"
    default 75
    range 50 95
    help
        Set the resize threshold as a percentage of capacity.
        When element count >= capacity * (load_factor/100), the dictionary
        automatically expands to prevent excessive hash collisions.

        Common values:
        - 50: Lower memory usage, more resize operations
        - 75: Balanced (default)
        - 90: Higher memory usage, fewer resize operations

    choice
        prompt "Version"
        default PKG_USING_DICT_LATEST_VERSION
        help
            Select the package version

        config PKG_USING_DICT_LATEST_VERSION
            bool "latest"

    endchoice

    config PKG_DICT_VER
       string
       default "latest"    if PKG_USING_DICT_LATEST_VERSION

endif
```

## tools/easylogger/Kconfig
```kconfig
config PKG_USING_ELOG
    bool "A ultra-lightweight, high-performance C/C++ log library"
    default n

if PKG_USING_ELOG

    config PKG_ELOG_PATH
        string
        default "/packages/tools/easylogger"
    
    config PKG_ELOG_VER
        string
        default "2.0.0"

menu "EasyLogger Options"

    config PKG_ELOG_ENABLE_OUTPUT
        bool
        prompt "Enable log output"
        default y

    choice
        prompt "Static output log level"
        default PKG_ELOG_OUTPUT_LVL_VERBOSE
        help
          Select the output log level. The logs which below the select log level will not be output.
        config PKG_ELOG_OUTPUT_LVL_ASSERT
            bool "ASSERT"
        config PKG_ELOG_OUTPUT_LVL_ERROR
            bool "ERROR"
        config PKG_ELOG_OUTPUT_LVL_WARN
            bool "WARN"
        config PKG_ELOG_OUTPUT_LVL_INFO
            bool "INFO"
        config PKG_ELOG_OUTPUT_LVL_VERBOSE
            bool "VERBOSE"
    endchoice

    config PKG_ELOG_ENABLE_ASSERT
        bool
        prompt "Enable assert check"
        default y

    config PKG_ELOG_LINE_BUF_SIZE
        int
        prompt "Buffer size for every line's log"
        default 256

    config PKG_ELOG_FILTER_TAG_MAX_LEN
        int
        prompt "Output filter's tag max length"
        default 30

    config PKG_ELOG_FILTER_KW_MAX_LEN
        int
        prompt "Output filter's keyword max length"
        default 16

    choice
        prompt "Output newline sign"
        default PKG_ELOG_NEWLINE_SIGN_CRLF
        config PKG_ELOG_NEWLINE_SIGN_CRLF
            bool "\\r\\n"
        config PKG_ELOG_NEWLINE_SIGN_LF
            bool "\\n"
        config PKG_ELOG_NEWLINE_SIGN_CR
            bool "\\r"
    endchoice

    config PKG_ELOG_ENABLE_COLOR
        bool
        prompt "Enable color log"
        default y

    config PKG_ELOG_ENABLE_ASYNC_OUTPUT
        bool
        prompt "Enable asynchronous output mode"
        default n

    config PKG_ELOG_ASYNC_OUTPUT_BUF_SIZE
        int
        prompt "Buffer size for asynchronous output mode"
        default 512
        depends on PKG_ELOG_ENABLE_ASYNC_OUTPUT

    config PKG_ELOG_ASYNC_LINE_OUTPUT
        bool
        prompt "Output's log which must end with newline sign"
        default y
        depends on PKG_ELOG_ENABLE_ASYNC_OUTPUT

    config PKG_ELOG_ASYNC_OUTPUT_USING_PTHREAD
        bool
        prompt "Using POSIX pthread implementation"
        default n
        depends on PKG_ELOG_ENABLE_ASYNC_OUTPUT
        select RT_USING_PTHREADS

    config PKG_ELOG_ENABLE_PLUGIN_FLASH
        bool
        prompt "Enable flash plugin"
        default n
        select PKG_USING_EASYFLASH
        select PKG_EASYFLASH_ENABLE_LOG

    config PKG_ELOG_FLASH_BUF_SIZE
        int
        prompt "Flash log plugin's RAM buffer size"
        default 1024
        depends on PKG_ELOG_ENABLE_PLUGIN_FLASH
endmenu

endif
```

## tools/fdt/Kconfig
```kconfig
menuconfig PKG_USING_FDT
    bool "Device Tree package in RT-Thread"
    default n

if PKG_USING_FDT

    config PKG_FDT_PATH
        string
        default "/packages/tools/fdt"

    config FDT_USING_EXAMPLE
        bool "Enable fdt example"
        default y

    config FDT_USING_LIBFDT
        bool "Enable libfdt"
        default y

    choice
        prompt "Version"
        help
            Select this package version

        config PKG_USING_FDT_V10000
            bool "v1.0.0"

        config PKG_USING_FDT_LATEST_VERSION
            bool "latest"
    endchoice

    config PKG_FDT_VER
        string
        default "v1.0.0" if PKG_USING_FDT_V10000
        default "latest" if PKG_USING_FDT_LATEST_VERSION

endif
```

## tools/fee/Kconfig
```kconfig
# Kconfig file for package fee
menuconfig PKG_USING_FEE
    bool "fee: fixed-block Flash EEPROM emulation package"
    default n

if PKG_USING_FEE

    config PKG_FEE_PATH
        string
        default "/packages/tools/fee"

    config FEE_MOCK_FLASH_SIZE
        hex "RAM mock flash size"
        default 0xA0000
        help
            Size of the built-in RAM-backed mock flash used by the default
            weak flash driver implementation in port/fee_port.c.

    config FEE_USING_SAMPLE
        bool "Enable samples"
        default n
        depends on RT_USING_FINSH
        help
            Build the MSH-based smoke and diagnostic sample.

    choice
        prompt "Version"
        default PKG_USING_FEE_V0_1_0
        help
            Select the package version

        config PKG_USING_FEE_V0_1_0
            bool "v0.1.0"

        config PKG_USING_FEE_LATEST_VERSION
            bool "latest"
    endchoice

    config PKG_FEE_VER
       string
       default "v0.1.0" if PKG_USING_FEE_V0_1_0
       default "latest" if PKG_USING_FEE_LATEST_VERSION

endif
```

## tools/gan_zhi/Kconfig
```kconfig
# Kconfig file for package gan_zhi
menuconfig PKG_USING_GAN_ZHI
    bool "gan_zhi: get tiangan and dizhi informations according to the date and time."
    default n
    select PKG_USING_SOLAR_TERMS

if PKG_USING_GAN_ZHI

    config PKG_GAN_ZHI_PATH
        string
        default "/packages/tools/gan_zhi"

    config GAN_ZHI_USING_EXAMPLE
        bool "Enable show gan zhi samples"
        default n

    choice
        prompt "Version"
        default PKG_USING_GAN_ZHI_LATEST_VERSION
        help
            Select the package version

        config PKG_USING_GAN_ZHI_V100
            bool "v1.0.0"

        config PKG_USING_GAN_ZHI_LATEST_VERSION
            bool "latest"
    endchoice

    config PKG_GAN_ZHI_VER
       string
       default "v1.0.0"    if PKG_USING_GAN_ZHI_V100
       default "latest"    if PKG_USING_GAN_ZHI_LATEST_VERSION

endif
```

## tools/gbk2utf8/Kconfig
```kconfig
# Kconfig file for package gbk2utf8
menuconfig PKG_USING_GBK2UTF8
    bool "GBK2UTF8: conversion between GBK and UTF8."
    default n

if PKG_USING_GBK2UTF8

    config PKG_GBK2UTF8_PATH
        string
        default "/packages/tools/gbk2utf8"

    choice
        prompt "Version"
        default PKG_USING_GBK2UTF8_LATEST_VERSION
        help
            Select the package version

        config PKG_USING_GBK2UTF8_V100
            bool "v1.0.0"

        config PKG_USING_GBK2UTF8_LATEST_VERSION
            bool "latest"
    endchoice

    config PKG_GBK2UTF8_VER
       string
       default "v1.0.0"    if PKG_USING_GBK2UTF8_V100
       default "latest"    if PKG_USING_GBK2UTF8_LATEST_VERSION

endif
```

## tools/gps_rmc/Kconfig
```kconfig
# Kconfig file for package gps_rmc
menuconfig PKG_USING_GPS_RMC
    bool "GPS RMC: Analysis of GPS RMC information"
    default n

if PKG_USING_GPS_RMC

    config PKG_GPS_RMC_PATH
        string
        default "/packages/tools/gps_rmc"

    choice
        prompt "Version"
        default PKG_USING_GPS_RMC_LATEST_VERSION
        help
            Select the package version

        config PKG_USING_GPS_RMC_LATEST_VERSION
            bool "latest"
    endchoice

    config PKG_GPS_RMC_VER
       string
       default "latest"    if PKG_USING_GPS_RMC_LATEST_VERSION

    config GPS_RMC_USING_SAMPLE
        bool "Enable example"
        default n

    if GPS_RMC_USING_SAMPLE

        config GPS_RMC_SAMPLE_UART_NAME
            string "Uart Port Name"
            default "uart6"

    endif

endif
```

## tools/hash-match/Kconfig
```kconfig
# Kconfig file for package hash-match
menuconfig PKG_USING_HASH_MATCH
    bool "hash match for MCU"
    default n

if PKG_USING_HASH_MATCH

    config PKG_HASH_MATCH_PATH
        string
        default "/packages/tools/hash-match"

    config PKG_USING_HASH_MATCH_DEMO
        bool "Enable hash match demo"
        default n

    choice
        prompt "Version"
        default PKG_USING_HASH_MATCH_LATEST_VERSION
        help
            Select the package version

        config PKG_USING_HASH_MATCH_V100
            bool "v1.0.0"

        config PKG_USING_HASH_MATCH_LATEST_VERSION
            bool "latest"
    endchoice

    config PKG_HASH_MATCH_VER
       string
       default "v1.0.0"    if PKG_USING_HASH_MATCH_V100
       default "latest"    if PKG_USING_HASH_MATCH_LATEST_VERSION

endif
```

## tools/heatshrink/Kconfig
```kconfig
# Kconfig file for package heatshrink
menuconfig PKG_USING_HEATSHRINK
    bool "heatshrink: A data compression/decompression library for embedded/real-time systems"
    default n

if PKG_USING_HEATSHRINK

    config PKG_HEATSHRINK_PATH
        string
        default "/packages/tools/heatshrink"

    config HEATSHRINK_USING_LOGS
        bool "Enable logs"
        default n

    choice
        prompt "Version"
        default PKG_USING_HEATSHRINK_V100
        help
            Select the package version

        config PKG_USING_HEATSHRINK_V100
            bool "v1.0.0"

        config PKG_USING_ADBD_HEATSHRINK_VERSION
            bool "latest"

    endchoice

    config PKG_HEATSHRINK_VER
       string
       default "v1.0.0"    if PKG_USING_HEATSHRINK_V100
       default "latest"    if PKG_USING_HEATSHRINK_LATEST_VERSION

endif
```

## tools/hpatchlite-wrapper/Kconfig
```kconfig
menuconfig PKG_USING_HPATCHLITE
    bool "hpatchlite-wrapper: A lightweight and user-friendly wrapper for the HPatchLite."
    default n
    select RT_USING_HEAP

if PKG_USING_HPATCHLITE

    config PKG_HPATCHLITE_PATH
        string
        default "/packages/tools/hpatchlite-wrapper"

    menu "Decompressor Options"

        config PKG_HPATCHLITE_DECOMPRESSER_TUZ
            bool "Enable tinyuz (tuz) decompressor support"
            default n # By default, enable the smallest decompressor
            help
                Select this to include support for the tinyuz (.tuz) compressed patch format.
                This is a lightweight decompressor, ideal for resource-constrained devices.

        # You can add other decompressors here in the future
        # config PKG_HPATCHLITE_DECOMPRESSER_ZLIB
        #     bool "Enable zlib decompressor support"
        #     default n

    endmenu

    choice
        prompt "Version"
        default PKG_USING_HPATCHLITE_LATEST_VERSION
        help
            Select the package version

        config PKG_USING_HPATCHLITE_LATEST_VERSION
            bool "latest"
    endchoice

    config PKG_HPATCHLITE_VER
       string
       default "latest" if PKG_USING_HPATCHLITE_LATEST_VERSION

endif
```

## tools/iperf/Kconfig
```kconfig
config PKG_USING_IPERF
    bool "IPerf: iperf-liked network performance tool"
    default n

if PKG_USING_IPERF

    config PKG_IPERF_PATH
        string
        default "/packages/tools/iperf"

    config PKG_IPERF_VER
        string
        default "v1.0.0"

endif
```
