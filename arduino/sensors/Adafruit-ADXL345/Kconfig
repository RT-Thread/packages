## arduino/sensors/Adafruit-BMP3XX/Kconfig
```kconfig
# Kconfig file for package Adafruit-BMP3XX
menuconfig PKG_USING_ARDUINO_ADAFRUIT_BMP3XX
    bool "Adafruit BMP3XX: Precision Barometric Pressure and Altimeter Sensors"
    select PKG_USING_RTDUINO
    select RTDUINO_USING_WIRE
    select RTDUINO_USING_SPI
    select PKG_USING_ARDUINO_ADAFRUIT_SENSOR
    select PKG_USING_ARDUINO_ADAFRUIT_BUSIO
    default n

if PKG_USING_ARDUINO_ADAFRUIT_BMP3XX

    config PKG_ARDUINO_ADAFRUIT_BMP3XX_PATH
        string
        default "/packages/arduino/sensors/Adafruit-BMP3XX"

    choice
        prompt "Version"
        default PKG_USING_ARDUINO_ADAFRUIT_BMP3XX_LATEST_VERSION
        help
            Select the package version

        config PKG_USING_ARDUINO_ADAFRUIT_BMP3XX_LATEST_VERSION
            bool "latest"
    endchoice

    config PKG_ARDUINO_ADAFRUIT_BMP3XX_VER
       string
       default "latest"    if PKG_USING_ARDUINO_ADAFRUIT_BMP3XX_LATEST_VERSION

endif
```

## arduino/sensors/Adafruit-BNO055/Kconfig
```kconfig
# Kconfig file for package Adafruit-BNO055
menuconfig PKG_USING_ARDUINO_ADAFRUIT_BNO055
    bool "Adafruit BNO055: Absolute Orientation Sensor"
    select PKG_USING_RTDUINO
    select RTDUINO_USING_WIRE
    select PKG_USING_ARDUINO_ADAFRUIT_SENSOR
    select PKG_USING_ARDUINO_ADAFRUIT_BUSIO
    default n

if PKG_USING_ARDUINO_ADAFRUIT_BNO055

    config PKG_ARDUINO_ADAFRUIT_BNO055_PATH
        string
        default "/packages/arduino/sensors/Adafruit-BNO055"

    choice
        prompt "Version"
        default PKG_USING_ARDUINO_ADAFRUIT_BNO055_LATEST_VERSION
        help
            Select the package version

        config PKG_USING_ARDUINO_ADAFRUIT_BNO055_LATEST_VERSION
            bool "latest"
    endchoice

    config PKG_ARDUINO_ADAFRUIT_BNO055_VER
       string
       default "latest"    if PKG_USING_ARDUINO_ADAFRUIT_BNO055_LATEST_VERSION

endif
```

## arduino/sensors/Adafruit-BNO08x-RVC/Kconfig
```kconfig
# Kconfig file for package Adafruit-BNO08x-RVC
menuconfig PKG_USING_ARDUINO_ADAFRUIT_BNO08X_RVC
    bool "Adafruit-BNO08x-RVC: a simple library to use the UART-RVC mode of the BNO08x sensors"
    select PKG_USING_RTDUINO
    select RTDUINO_USING_WIRE
    select PKG_USING_ARDUINO_ADAFRUIT_SENSOR
    select PKG_USING_ARDUINO_ADAFRUIT_BUSIO
    default n

if PKG_USING_ARDUINO_ADAFRUIT_BNO08X_RVC

    config PKG_ARDUINO_ADAFRUIT_BNO08X_RVC_PATH
        string
        default "/packages/arduino/sensors/Adafruit-BNO08x-RVC"

    choice
        prompt "Version"
        default PKG_USING_ARDUINO_ADAFRUIT_BNO08X_RVC_LATEST_VERSION
        help
            Select the package version

        config PKG_USING_ARDUINO_ADAFRUIT_BNO08X_RVC_LATEST_VERSION
            bool "latest"
    endchoice

    config PKG_ARDUINO_ADAFRUIT_BNO08X_RVC_VER
       string
       default "latest"    if PKG_USING_ARDUINO_ADAFRUIT_BNO08X_RVC_LATEST_VERSION

endif
```

## arduino/sensors/Adafruit-BNO08x/Kconfig
```kconfig
# Kconfig file for package Adafruit-BNO08x
menuconfig PKG_USING_ARDUINO_ADAFRUIT_BNO08X
    bool "Adafruit BNO08x: 9-DOF Orientation IMU Fusion"
    select PKG_USING_RTDUINO
    select RTDUINO_USING_WIRE
    select PKG_USING_ARDUINO_ADAFRUIT_SENSOR
    select PKG_USING_ARDUINO_ADAFRUIT_BUSIO
    default n

if PKG_USING_ARDUINO_ADAFRUIT_BNO08X

    config PKG_ARDUINO_ADAFRUIT_BNO08X_PATH
        string
        default "/packages/arduino/sensors/Adafruit-BNO08x"

    choice
        prompt "Version"
        default PKG_USING_ARDUINO_ADAFRUIT_BNO08X_LATEST_VERSION
        help
            Select the package version

        config PKG_USING_ARDUINO_ADAFRUIT_BNO08X_LATEST_VERSION
            bool "latest"
    endchoice

    config PKG_ARDUINO_ADAFRUIT_BNO08X_VER
       string
       default "latest"    if PKG_USING_ARDUINO_ADAFRUIT_BNO08X_LATEST_VERSION

endif
```

## arduino/sensors/Adafruit-CAP1188/Kconfig
```kconfig
# Kconfig file for package Adafruit-CAP1188
menuconfig PKG_USING_ARDUINO_ADAFRUIT_CAP1188
    bool "Adafruit CAP1188: 8-Key Capacitive Touch Sensor"
    select PKG_USING_RTDUINO
    select RTDUINO_USING_WIRE
    select RTDUINO_USING_SPI
    select PKG_USING_ARDUINO_ADAFRUIT_BUSIO
    default n

if PKG_USING_ARDUINO_ADAFRUIT_CAP1188

    config PKG_ARDUINO_ADAFRUIT_CAP1188_PATH
        string
        default "/packages/arduino/sensors/Adafruit-CAP1188"

    choice
        prompt "Version"
        default PKG_USING_ARDUINO_ADAFRUIT_CAP1188_LATEST_VERSION
        help
            Select the package version

        config PKG_USING_ARDUINO_ADAFRUIT_CAP1188_LATEST_VERSION
            bool "latest"
    endchoice

    config PKG_ARDUINO_ADAFRUIT_CAP1188_VER
       string
       default "latest"    if PKG_USING_ARDUINO_ADAFRUIT_CAP1188_LATEST_VERSION

endif
```

## arduino/sensors/Adafruit-CCS811/Kconfig
```kconfig
# Kconfig file for package Adafruit-CCS811
menuconfig PKG_USING_ARDUINO_ADAFRUIT_CCS811
    bool "Adafruit CCS811: Air Quality Sensor"
    select PKG_USING_RTDUINO
    select RTDUINO_USING_WIRE
    select PKG_USING_ARDUINO_ADAFRUIT_BUSIO
    default n

if PKG_USING_ARDUINO_ADAFRUIT_CCS811

    config PKG_ARDUINO_ADAFRUIT_CCS811_PATH
        string
        default "/packages/arduino/sensors/Adafruit-CCS811"

    choice
        prompt "Version"
        default PKG_USING_ARDUINO_ADAFRUIT_CCS811_LATEST_VERSION
        help
            Select the package version

        config PKG_USING_ARDUINO_ADAFRUIT_CCS811_LATEST_VERSION
            bool "latest"
    endchoice

    config PKG_ARDUINO_ADAFRUIT_CCS811_VER
       string
       default "latest"    if PKG_USING_ARDUINO_ADAFRUIT_CCS811_LATEST_VERSION

endif
```

## arduino/sensors/Adafruit-DHT/Kconfig
```kconfig
# Kconfig file for package Adafruit-DHT
menuconfig PKG_USING_ARDUINO_ADAFRUIT_DHT
    bool "Adafruit DHT: Arduino library for DHT11, DHT22 Temperature and Humidity Sensor"
    select PKG_USING_RTDUINO
    select PKG_USING_ARDUINO_ADAFRUIT_SENSOR
    default n

if PKG_USING_ARDUINO_ADAFRUIT_DHT

    config PKG_ARDUINO_ADAFRUIT_DHT_PATH
        string
        default "/packages/arduino/sensors/Adafruit-DHT"

    choice
        prompt "Version"
        default PKG_USING_ARDUINO_ADAFRUIT_DHT_LATEST_VERSION
        help
            Select the package version

        config PKG_USING_ARDUINO_ADAFRUIT_DHT_LATEST_VERSION
            bool "latest"
    endchoice

    config PKG_ARDUINO_ADAFRUIT_DHT_VER
       string
       default "latest"    if PKG_USING_ARDUINO_ADAFRUIT_DHT_LATEST_VERSION

endif
```

## arduino/sensors/Adafruit-DPS310/Kconfig
```kconfig
# Kconfig file for package Adafruit-DPS310
menuconfig PKG_USING_ARDUINO_ADAFRUIT_DPS310
    bool "Adafruit DPS310: Barometric Pressure Sensor"
    default n

if PKG_USING_ARDUINO_ADAFRUIT_DPS310

    config PKG_ARDUINO_ADAFRUIT_DPS310_PATH
        string
        default "/packages/arduino/sensors/Adafruit-DPS310"

    choice
        prompt "Version"
        default PKG_USING_ARDUINO_ADAFRUIT_DPS310_LATEST_VERSION
        help
            Select the package version

        config PKG_USING_ARDUINO_ADAFRUIT_DPS310_LATEST_VERSION
            bool "latest"
    endchoice

    config PKG_ARDUINO_ADAFRUIT_DPS310_VER
       string
       default "latest"    if PKG_USING_ARDUINO_ADAFRUIT_DPS310_LATEST_VERSION

endif
```

## arduino/sensors/Adafruit-EMC2101/Kconfig
```kconfig
# Kconfig file for package Adafruit-EMC2101
menuconfig PKG_USING_ARDUINO_ADAFRUIT_EMC2101
    bool "Adafruit EMC2101: Fan Controller and Temperature sensor"
    select PKG_USING_RTDUINO
    select RTDUINO_USING_WIRE
    select PKG_USING_ARDUINO_ADAFRUIT_SENSOR
    select PKG_USING_ARDUINO_ADAFRUIT_BUSIO
    default n

if PKG_USING_ARDUINO_ADAFRUIT_EMC2101

    config PKG_ARDUINO_ADAFRUIT_EMC2101_PATH
        string
        default "/packages/arduino/sensors/Adafruit-EMC2101"

    choice
        prompt "Version"
        default PKG_USING_ARDUINO_ADAFRUIT_EMC2101_LATEST_VERSION
        help
            Select the package version

        config PKG_USING_ARDUINO_ADAFRUIT_EMC2101_LATEST_VERSION
            bool "latest"
    endchoice

    config PKG_ARDUINO_ADAFRUIT_EMC2101_VER
       string
       default "latest"    if PKG_USING_ARDUINO_ADAFRUIT_EMC2101_LATEST_VERSION

endif
```
