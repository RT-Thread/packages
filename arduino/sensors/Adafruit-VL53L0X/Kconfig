## arduino/sensors/Seeed-ADXL345/Kconfig
```kconfig
# Kconfig file for package Seeed-ADXL345
menuconfig PKG_USING_ARDUINO_SEEED_ADXL345
    bool "Seeed ADXL345: 3-Axis Digital Accelerometer"
    select PKG_USING_RTDUINO
    select RTDUINO_USING_WIRE
    default n

if PKG_USING_ARDUINO_SEEED_ADXL345

    config PKG_ARDUINO_SEEED_ADXL345_PATH
        string
        default "/packages/arduino/sensors/Seeed-ADXL345"

    choice
        prompt "Version"
        default PKG_USING_ARDUINO_SEEED_ADXL345_LATEST_VERSION
        help
            Select the package version

        config PKG_USING_ARDUINO_SEEED_ADXL345_LATEST_VERSION
            bool "latest"
    endchoice

    config PKG_ARDUINO_SEEED_ADXL345_VER
       string
       default "latest"    if PKG_USING_ARDUINO_SEEED_ADXL345_LATEST_VERSION

endif
```

## arduino/sensors/Seeed-AT42QT1070/Kconfig
```kconfig
# Kconfig file for package Seeed-AT42QT1070
menuconfig PKG_USING_ARDUINO_SEEED_AT42QT1070
    bool "Seeed AT42QT1070: a digital burst mode charge-transfer capacitive sensor driver"
    select PKG_USING_RTDUINO
    select RTDUINO_USING_WIRE
    default n

if PKG_USING_ARDUINO_SEEED_AT42QT1070

    config PKG_ARDUINO_SEEED_AT42QT1070_PATH
        string
        default "/packages/arduino/sensors/Seeed-AT42QT1070"

    choice
        prompt "Version"
        default PKG_USING_ARDUINO_SEEED_AT42QT1070_LATEST_VERSION
        help
            Select the package version

        config PKG_USING_ARDUINO_SEEED_AT42QT1070_LATEST_VERSION
            bool "latest"
    endchoice

    config PKG_ARDUINO_SEEED_AT42QT1070_VER
       string
       default "latest"    if PKG_USING_ARDUINO_SEEED_AT42QT1070_LATEST_VERSION

endif
```

## arduino/sensors/Seeed-BBM150/Kconfig
```kconfig
# Kconfig file for package Seeed-BBM150
menuconfig PKG_USING_ARDUINO_SEEED_BBM150
    bool "Seeed BBM150: digital compass sensor"
    select PKG_USING_RTDUINO
    select RTDUINO_USING_WIRE
    default n

if PKG_USING_ARDUINO_SEEED_BBM150

    config PKG_ARDUINO_SEEED_BBM150_PATH
        string
        default "/packages/arduino/sensors/Seeed-BBM150"

    choice
        prompt "Version"
        default PKG_USING_ARDUINO_SEEED_BBM150_LATEST_VERSION
        help
            Select the package version

        config PKG_USING_ARDUINO_SEEED_BBM150_LATEST_VERSION
            bool "latest"
    endchoice

    config PKG_ARDUINO_SEEED_BBM150_VER
       string
       default "latest"    if PKG_USING_ARDUINO_SEEED_BBM150_LATEST_VERSION

endif
```

## arduino/sensors/Seeed-BME280/Kconfig
```kconfig
# Kconfig file for package Seeed-BME280
menuconfig PKG_USING_ARDUINO_SEEED_BME280
    bool "Seeed BME280: Temp & Humi & Barometer Sensor"
    select PKG_USING_RTDUINO
    select RTDUINO_USING_WIRE
    default n

if PKG_USING_ARDUINO_SEEED_BME280

    config PKG_ARDUINO_SEEED_BME280_PATH
        string
        default "/packages/arduino/sensors/Seeed-BME280"

    choice
        prompt "Version"
        default PKG_USING_ARDUINO_SEEED_BME280_LATEST_VERSION
        help
            Select the package version

        config PKG_USING_ARDUINO_SEEED_BME280_LATEST_VERSION
            bool "latest"
    endchoice

    config PKG_ARDUINO_SEEED_BME280_VER
       string
       default "latest"    if PKG_USING_ARDUINO_SEEED_BME280_LATEST_VERSION

endif
```

## arduino/sensors/Seeed-BMP085/Kconfig
```kconfig
# Kconfig file for package Seeed-BMP085
menuconfig PKG_USING_ARDUINO_SEEED_BMP085
    bool "Seeed BMP085/BMP180: Barometer Sensor"
    select PKG_USING_RTDUINO
    select RTDUINO_USING_WIRE
    default n

if PKG_USING_ARDUINO_SEEED_BMP085

    config PKG_ARDUINO_SEEED_BMP085_PATH
        string
        default "/packages/arduino/sensors/Seeed-BMP085"

    choice
        prompt "Version"
        default PKG_USING_ARDUINO_SEEED_BMP085_LATEST_VERSION
        help
            Select the package version

        config PKG_USING_ARDUINO_SEEED_BMP085_LATEST_VERSION
            bool "latest"
    endchoice

    config PKG_ARDUINO_SEEED_BMP085_VER
       string
       default "latest"    if PKG_USING_ARDUINO_SEEED_BMP085_LATEST_VERSION

endif
```

## arduino/sensors/Seeed-BMP280/Kconfig
```kconfig
# Kconfig file for package Seeed_BMP280
menuconfig PKG_USING_ARDUINO_SEEED_BMP280
    bool "Seeed BMP280: an absolute barometric pressure sensor"
    select PKG_USING_RTDUINO
    select RTDUINO_USING_WIRE
    default n

if PKG_USING_ARDUINO_SEEED_BMP280

    config PKG_ARDUINO_SEEED_BMP280_PATH
        string
        default "/packages/arduino/sensors/Seeed-BMP280"

    choice
        prompt "Version"
        default PKG_USING_ARDUINO_SEEED_BMP280_LATEST_VERSION
        help
            Select the package version

        config PKG_USING_ARDUINO_SEEED_BMP280_LATEST_VERSION
            bool "latest"
    endchoice

    config PKG_ARDUINO_SEEED_BMP280_VER
       string
       default "latest"    if PKG_USING_ARDUINO_SEEED_BMP280_LATEST_VERSION

endif
```

## arduino/sensors/Seeed-DHT/Kconfig
```kconfig
# Kconfig file for package Seeed-DHT
menuconfig PKG_USING_ARDUINO_SEEED_DHT
    bool "Seeed-DHT: DHT11, DHT22, DHT21 & AM2301 Temperature And Humidity Sensor"
    select PKG_USING_RTDUINO
    select RTDUINO_USING_WIRE
    default n

if PKG_USING_ARDUINO_SEEED_DHT

    config PKG_ARDUINO_SEEED_DHT_PATH
        string
        default "/packages/arduino/sensors/Seeed-DHT"

    choice
        prompt "Version"
        default PKG_USING_ARDUINO_SEEED_DHT_LATEST_VERSION
        help
            Select the package version

        config PKG_USING_ARDUINO_SEEED_DHT_LATEST_VERSION
            bool "latest"
    endchoice

    config PKG_ARDUINO_SEEED_DHT_VER
       string
       default "latest"    if PKG_USING_ARDUINO_SEEED_DHT_LATEST_VERSION

endif
```

## arduino/sensors/Seeed-DRV2605L/Kconfig
```kconfig
# Kconfig file for package Seeed-DRV2605L
menuconfig PKG_USING_ARDUINO_SEEED_DRV2605L
    bool "Seeed DRV2605L: Haptic Motor Sensor"
    select PKG_USING_RTDUINO
    select RTDUINO_USING_WIRE
    default n

if PKG_USING_ARDUINO_SEEED_DRV2605L

    config PKG_ARDUINO_SEEED_DRV2605L_PATH
        string
        default "/packages/arduino/sensors/Seeed-DRV2605L"

    choice
        prompt "Version"
        default PKG_USING_ARDUINO_SEEED_DRV2605L_LATEST_VERSION
        help
            Select the package version

        config PKG_USING_ARDUINO_SEEED_DRV2605L_LATEST_VERSION
            bool "latest"
    endchoice

    config PKG_ARDUINO_SEEED_DRV2605L_VER
       string
       default "latest"    if PKG_USING_ARDUINO_SEEED_DRV2605L_LATEST_VERSION

endif
```

## arduino/sensors/Seeed-H3LIS331DL/Kconfig
```kconfig
# Kconfig file for package Seeed-H3LIS331DL
menuconfig PKG_USING_ARDUINO_SEEED_H3LIS331DL
    bool "Seeed H3LIS331DL: 3-axis linear accelerometer"
    select PKG_USING_RTDUINO
    select RTDUINO_USING_WIRE
    default n

if PKG_USING_ARDUINO_SEEED_H3LIS331DL

    config PKG_ARDUINO_SEEED_H3LIS331DL_PATH
        string
        default "/packages/arduino/sensors/Seeed-H3LIS331DL"

    choice
        prompt "Version"
        default PKG_USING_ARDUINO_SEEED_H3LIS331DL_LATEST_VERSION
        help
            Select the package version

        config PKG_USING_ARDUINO_SEEED_H3LIS331DL_LATEST_VERSION
            bool "latest"
    endchoice

    config PKG_ARDUINO_SEEED_H3LIS331DL_VER
       string
       default "latest"    if PKG_USING_ARDUINO_SEEED_H3LIS331DL_LATEST_VERSION

endif
```

## arduino/sensors/Seeed-HDC1000/Kconfig
```kconfig
# Kconfig file for package Seeed-HDC1000
menuconfig PKG_USING_ARDUINO_SEEED_HDC1000
    bool "Seeed HDC1000: Temperature and Humidity Sensor"
    select PKG_USING_RTDUINO
    select RTDUINO_USING_WIRE
    default n

if PKG_USING_ARDUINO_SEEED_HDC1000

    config PKG_ARDUINO_SEEED_HDC1000_PATH
        string
        default "/packages/arduino/sensors/Seeed-HDC1000"

    choice
        prompt "Version"
        default PKG_USING_ARDUINO_SEEED_HDC1000_LATEST_VERSION
        help
            Select the package version

        config PKG_USING_ARDUINO_SEEED_HDC1000_LATEST_VERSION
            bool "latest"
    endchoice

    config PKG_ARDUINO_SEEED_HDC1000_VER
       string
       default "latest"    if PKG_USING_ARDUINO_SEEED_HDC1000_LATEST_VERSION

endif
```

## arduino/sensors/Seeed-HM3301/Kconfig
```kconfig
# Kconfig file for package Seeed-HM3301
menuconfig PKG_USING_ARDUINO_SEEED_HM3301
    bool "Seeed HM3301: dust detection sensor"
    select PKG_USING_RTDUINO
    select RTDUINO_USING_WIRE
    default n

if PKG_USING_ARDUINO_SEEED_HM3301

    config PKG_ARDUINO_SEEED_HM3301_PATH
        string
        default "/packages/arduino/sensors/Seeed-HM3301"

    choice
        prompt "Version"
        default PKG_USING_ARDUINO_SEEED_HM3301_LATEST_VERSION
        help
            Select the package version

        config PKG_USING_ARDUINO_SEEED_HM3301_LATEST_VERSION
            bool "latest"
    endchoice

    config PKG_ARDUINO_SEEED_HM3301_VER
       string
       default "latest"    if PKG_USING_ARDUINO_SEEED_HM3301_LATEST_VERSION

endif
```
