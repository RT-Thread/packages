## language/JSON/RyanJson/Kconfig
```kconfig
# Kconfig file for package RyanJson
menuconfig PKG_USING_RYAN_JSON
    bool "RyanJson: 一个针对资源受限的嵌入式设备优化的c语言Json库,内存占用极小的通用Json库,简洁高效!"
    default n

if PKG_USING_RYAN_JSON

    config PKG_RYAN_JSON_PATH
        string
        default "/packages/language/JSON/RyanJson"

    choice
        prompt "版本选择: 推荐latest"
        default PKG_USING_RYAN_JSON_LATEST_VERSION
        help
            Select the package version

        config PKG_USING_RYAN_JSON_LATEST_VERSION
            bool "latest"
    endchoice

    config PKG_RYAN_JSON_VER
       string
       default "latest"    if PKG_USING_RYAN_JSON_LATEST_VERSION

    config PKG_RYAN_JSON_VER_NUM
        hex
        default 0xfff    if PKG_USING_RYAN_JSON_LATEST_VERSION
endif
```

## language/JSON/agile_jsmn/Kconfig
```kconfig
# Kconfig file for package agile_jsmn
menuconfig PKG_USING_AGILE_JSMN
    bool "agile_jsmn: Lightweight JSON parser."
    default n

if PKG_USING_AGILE_JSMN

    config PKG_AGILE_JSMN_PATH
        string
        default "/packages/language/JSON/agile_jsmn"

    choice
        prompt "Version"
        default PKG_USING_AGILE_JSMN_V101
        help
            Select the package version

        config PKG_USING_AGILE_JSMN_V100
            bool "v1.0.0"

        config PKG_USING_AGILE_JSMN_V101
            bool "v1.0.1"

        config PKG_USING_AGILE_JSMN_LATEST_VERSION
            bool "latest"
    endchoice

    config PKG_AGILE_JSMN_VER
       string
       default "v1.0.0"    if PKG_USING_AGILE_JSMN_V100
       default "v1.0.1"    if PKG_USING_AGILE_JSMN_V101
       default "latest"    if PKG_USING_AGILE_JSMN_LATEST_VERSION

    config PKG_AGILE_JSMN_VER_NUM
        hex
        default 0x10000    if PKG_USING_AGILE_JSMN_V100
        default 0x10001    if PKG_USING_AGILE_JSMN_V101
        default 0x99999    if PKG_USING_AGILE_JSMN_LATEST_VERSION
endif
```

## language/JSON/cJSON/Kconfig
```kconfig
menuconfig PKG_USING_CJSON
    bool "cJSON: Ultralightweight JSON parser in ANSI C"
    default n

if PKG_USING_CJSON

    config PKG_CJSON_PATH
        string
        default "/packages/language/JSON/cJSON"

    choice
        prompt "Version"
        help
            Select the cJSON version

        config PKG_USING_CJSON_V1717
            bool "v1.7.17"

        config PKG_USING_CJSON_V1716
            bool "v1.7.16"

        config PKG_USING_CJSON_V1715
            bool "v1.7.15"

        config PKG_USING_CJSON_V1714
            bool "v1.7.14"

        config PKG_USING_CJSON_V159
            bool "v1.5.9"

        config PKG_USING_CJSON_V102
            bool "v1.0.2"

        config PKG_USING_CJSON_LATEST_VERSION
            bool "latest"
    endchoice

    config PKG_CJSON_VER
        string
        default "v1.0.2" if PKG_USING_CJSON_V102
        default "v1.5.9" if PKG_USING_CJSON_V159
        default "v1.7.14" if PKG_USING_CJSON_V1714
        default "v1.7.15" if PKG_USING_CJSON_V1715
        default "v1.7.16" if PKG_USING_CJSON_V1716
        default "v1.7.17" if PKG_USING_CJSON_V1717
        default "latest" if PKG_USING_CJSON_LATEST_VERSION

endif
```

## language/JSON/jsmn/Kconfig
```kconfig
menuconfig PKG_USING_JSMN
    bool "jsmn: is a minimalistic JSON parser in C"
    default n

if PKG_USING_JSMN

    config PKG_JSMN_PATH
        string
        default "/packages/language/JSON/jsmn"

    choice
        prompt "Version"
        help
            Select this package version

        config PKG_USING_JSMN_V010
            bool "v0.1.0"

        config PKG_USING_JSMN_LATEST_VERSION
            bool "latest"
    endchoice

    config PKG_JSMN_VER
       string
       default "v0.1.0"    if PKG_USING_JSMN_V010
       default "latest"    if PKG_USING_JSMN_LATEST_VERSION

menu "jsmn Options"
    config JSMN_USING_EXAMPLE
        bool
        prompt "jsmn example"
        default n

    config JSMN_USING_TEST
        bool
        prompt "jsmn test"
        default n
endmenu

endif
```

## language/JSON/ljson/Kconfig
```kconfig
menuconfig PKG_USING_LJSON
    bool "ljson: JSON parser in ANSI C"
    default n

if PKG_USING_LJSON

    config PKG_LJSON_PATH
        string
        default "/packages/language/JSON/ljson"

    choice
        prompt "version"
        help
            Select the ljson version

        config PKG_USING_LJSON_V002
            bool "v0.0.2"

        config PKG_USING_LJSON_LATEST_VERSION
            bool "latest"
    endchoice

    config PKG_LJSON_VER
        string
        default "v0.0.2" if PKG_USING_LJSON_V002
        default "latest" if PKG_USING_LJSON_LATEST_VERSION

endif
```

## language/JSON/parson/Kconfig
```kconfig
menuconfig PKG_USING_PARSON
    bool "parson: parson is a lightweight json library written in C."
    default n

if PKG_USING_PARSON

    config PKG_PARSON_PATH
        string
        default "/packages/language/JSON/parson"

    choice
        prompt "Version"
        help
            Select the Parson version

        config PKG_USING_PARSON_LATEST_VERSION
            bool "latest"
    endchoice

    config PKG_PARSON_VER
        string
        default "latest" if PKG_USING_PARSON_LATEST_VERSION

endif
```

## language/JSON/rapidjson/Kconfig
```kconfig
# Kconfig file for package rapidjson
menuconfig PKG_USING_RAPIDJSON
    bool "rapidjson: A fast JSON parser/generator for C++ with both SAX/DOM style API."
    select RT_USING_CPLUSPLUS
    select RT_USING_LIBC if RT_VER_NUM < 0x40100
    default n

if PKG_USING_RAPIDJSON

    config PKG_RAPIDJSON_PATH
        string
        default "/packages/language/JSON/rapidjson"

    config RAPIDJSON_USING_SIMPLE_READER
        bool "simple_reader: simple reader example"
        help
            simple_reader: simple reader example
        default n

    config RAPIDJSON_USING_SIMPLE_WRITER
        bool "simple_writer: simple writer example"
        help
            simple_writer: simple writer example
        default n

    config RAPIDJSON_USING_TUTORIAL
        bool "tutorial: tutorial example"
        help
            tutorial: tutorial example
        default n

    config RAPIDJSON_USING_SIMPLE_PULL_READER
        bool "simple_pull_reader: simple pull reader example"
        help
            simple_pull_reader: simple pull reader example
        default n

    config RAPIDJSON_USING_SIMPLE_DOM
        bool "simple_dom: simple dom example"
        help
            simple_dom: simple dom example
        default n

    config RAPIDJSON_USING_SERIALIZE
        bool "serialize: serialize example"
        help
            serialize: serialize example
        default n

    config RAPIDJSON_USING_MESSAGE_READER
        bool "message_reader: message reader example"
        help
            message_reader: message reader example
        default n

    config RAPIDJSON_USING_LOOK_AHEAD_PARSER
        bool "look_ahead_parser: look ahead parser example"
        help
            look_ahead_parser: look ahead parser example
        default n

    config RAPIDJSON_USING_ARCHIVER_TEST
        bool "archiver_test: archiver test example"
        help
            archiver_test: archiver test example
        default n

    choice
        prompt "Version"
        default PKG_USING_RAPIDJSON_LATEST_VERSION
        help
            Select the package version

        config PKG_USING_RAPIDJSON_V100
            bool "v1.0.0"

        config PKG_USING_RAPIDJSON_LATEST_VERSION
            bool "latest"
    endchoice

    config PKG_RAPIDJSON_VER
       string
       default "latest"    if PKG_USING_RAPIDJSON_LATEST_VERSION

endif
```

## language/Kconfig
```kconfig
menu "language packages"

source "$PKGS_DIR/packages/language/JSON/Kconfig"
source "$PKGS_DIR/packages/language/XML/Kconfig"
source "$PKGS_DIR/packages/language/LuatOS/Kconfig"
source "$PKGS_DIR/packages/language/Lua/Kconfig"
source "$PKGS_DIR/packages/language/jerryscript/Kconfig"
source "$PKGS_DIR/packages/language/micropython/Kconfig"
source "$PKGS_DIR/packages/language/pikascript/Kconfig"
source "$PKGS_DIR/packages/language/rtt_rust/Kconfig"

endmenu
```

## language/Lua/Kconfig
```kconfig
# Kconfig file for package lua
menuconfig PKG_USING_LUA
    bool "Lua: A lightweight, embeddable scripting language."
    default n
    select RT_USING_LIBC

if PKG_USING_LUA

    config PKG_LUA_PATH
        string
        default "/packages/language/Lua"

    choice
        prompt "Submitted version"
        help
            Select the Submitted version

        config PKG_USING_LUA_V100
            bool "v1.0.0"

        config PKG_USING_LUA_LATEST_VERSION
            bool "latest"
    endchoice

    config PKG_LUA_VER
        string
        default "v1.0.0" if PKG_USING_LUA_V100
        default "latest" if PKG_USING_LUA_LATEST_VERSION

    #menu "Lua Options"
        choice
            prompt "Porting Lua version"
            help
                Select the Porting Lua version

            config LUA_USING_PORTING_V514
                bool "Lua5.1.4"
            config LUA_USING_PORTING_V534
                bool "Lua5.3.4"
        endchoice
    #endmenu

endif
```

## language/LuatOS/Kconfig
```kconfig
# Kconfig file for package LuatOS_SOC
menuconfig PKG_USING_LUATOS_SOC
    select RT_USING_DFS          if RT_VER_NUM < 0x40100
    select RT_USING_POSIX        if RT_VER_NUM < 0x40100
    select RT_USING_LIBC         if RT_VER_NUM < 0x40100
    select RT_USING_POSIX_FS     if RT_VER_NUM >= 0x40100
    select RT_USING_POSIX_STDIO  if RT_VER_NUM >= 0x40100
    select RT_USING_TIMER_SOFT
    select RT_USING_DFS_ROMFS
    bool "LUATOS : Powerful embedded Lua Engine for IoT devices"
    default n

if PKG_USING_LUATOS_SOC

    config PKG_LUATOS_SOC_PATH
        string
        default "/packages/language/LuatOS"

    choice
        prompt "Version"
        default PKG_USING_LUATOS_SOC_LATEST_VERSION
        help
            Select the package version

        config PKG_USING_LUATOS_SOC_LATEST_VERSION
            bool "latest"
    endchoice

    config PKG_LUATOS_SOC_VER
       string
       default "latest"    if PKG_USING_LUATOS_SOC_LATEST_VERSION

config PKG_USING_LUATOS_SOC_LCD
    bool "LuatOS_SOC using lcd"
    default n

config PKG_USING_LUATOS_SOC_EINK
    bool "LuatOS_SOC using eink"
    default n

config PKG_LUATOS_SOC_LUAT_HEAP_SIZE
    int "LuatOS heap size"
    range 1 999
    default 64

endif
```

## language/XML/Kconfig
```kconfig
menu "XML: Extensible Markup Language"

source "$PKGS_DIR/packages/language/XML/simple_xml/Kconfig"
source "$PKGS_DIR/packages/language/XML/ezXML/Kconfig"

endmenu
```

## language/XML/ezXML/Kconfig
```kconfig
menuconfig PKG_USING_EZXML
    bool "ezXML is a C library for parsing XML documents."
    default n

if PKG_USING_EZXML

    config PKG_EZXML_PATH
        string
        default "/packages/language/XML/ezXML"

    choice
        prompt "version"
        help
            Select the ezXML version
        default PKG_USING_EZXML_LATEST_VERSION

        config PKG_USING_EZXML_LATEST_VERSION
            bool "latest"

        config PKG_USING_EZXML_V0681
            bool "v0.8.6.1"

        config PKG_USING_EZXML_V068
            bool "v0.8.6"
    endchoice

    config PKG_EZXML_VER
        string
        default "v0.8.6.1"  if PKG_USING_EZXML_V0681
        default "v0.8.6"    if PKG_USING_EZXML_V068
        default "latest"    if PKG_USING_EZXML_LATEST_VERSION

endif
```

## language/XML/simple_xml/Kconfig
```kconfig
# Kconfig file for package simple_xml
menuconfig PKG_USING_SIMPLE_XML
    bool "simple_xml : Based on the XML parser of the C language."
    default n

if PKG_USING_SIMPLE_XML

    config PKG_USING_SIMPLE_XML_EXAMPLE
        bool "example for using simple_xml"
        default n

    config PKG_SIMPLE_XML_PATH
        string
        default "/packages/language/XML/simple_xml"

    choice
        prompt "Version"
        default PKG_USING_SIMPLE_XML_LATEST_VERSION
        help
            Select the package version

        config PKG_USING_SIMPLE_XML_V110
            bool "v1.1.0"

        config PKG_USING_SIMPLE_XML_LATEST_VERSION
            bool "latest"
    endchoice

    config PKG_SIMPLE_XML_VER
       string
       default "v1.1.0"    if PKG_USING_SIMPLE_XML_V110
       default "latest"    if PKG_USING_SIMPLE_XML_LATEST_VERSION

endif
```

## language/jerryscript/Kconfig
```kconfig
menuconfig PKG_USING_JERRYSCRIPT
    bool "JerryScript: Ultra-lightweight JavaScript engine for the Internet of Things."
    default n

if PKG_USING_JERRYSCRIPT

    config PKG_JERRYSCRIPT_PATH
        string
        default "/packages/language/jerryscript"

    choice
        prompt "version"
        help
            Select the version of jerryscript

        config PKG_USING_JERRYSCRIPT_LATEST_VERSION
            bool "latest"

        config PKG_USING_JERRYSCRIPT_V100
            bool "v1.0.0"
    endchoice

    config PKG_JERRYSCRIPT_VER
        string
        default "v1.0.0" if PKG_USING_JERRYSCRIPT_V100
        default "latest" if PKG_USING_JERRYSCRIPT_LATEST_VERSION

    config PKG_JMEM_HEAP_SIZE
        int "Jerry memory heap size KB"
        default 512

    config PKG_JERRY_ENABLE_ERROR_MESSAGES
        bool "Jerry enable error message"
        default y

    config PKG_JERRY_ENABLE_LOGGING
        bool "Jerry enable logging"
        default n

    config PKG_JMEM_STATS
        bool "Jerry enable memory usage statistics"
        select PKG_JERRY_ENABLE_LOGGING
        default n

    config CONFIG_DISABLE_ANNEXB_BUILTIN
        bool "CONFIG_DISABLE_ANNEXB_BUILTIN"
        default n

    config CONFIG_DISABLE_ARRAY_BUILTIN
        bool "CONFIG_DISABLE_ARRAY_BUILTIN"
        default n

    config CONFIG_DISABLE_BOOLEAN_BUILTIN
        bool "CONFIG_DISABLE_BOOLEAN_BUILTIN"
        default n

    config CONFIG_DISABLE_DATE_BUILTIN
        bool "CONFIG_DISABLE_DATE_BUILTIN"
        default n

    config CONFIG_DISABLE_ERROR_BUILTINS
        bool "CONFIG_DISABLE_ERROR_BUILTINS"
        default n

    config CONFIG_DISABLE_JSON_BUILTIN
        bool "CONFIG_DISABLE_JSON_BUILTIN"
        default n

    config CONFIG_DISABLE_MATH_BUILTIN
        bool "CONFIG_DISABLE_MATH_BUILTIN"
        default n

    config CONFIG_DISABLE_NUMBER_BUILTIN
        bool "CONFIG_DISABLE_NUMBER_BUILTIN"
        default n

    config CONFIG_DISABLE_REGEXP_BUILTIN
        bool "CONFIG_DISABLE_REGEXP_BUILTIN"
        default n

    config CONFIG_DISABLE_STRING_BUILTIN
        bool "CONFIG_DISABLE_STRING_BUILTIN"
        default n

    config PKG_CONFIG_DISABLE_ES2015
        bool "Group of ES2015-related features disabled together."
        default y

endif
```
