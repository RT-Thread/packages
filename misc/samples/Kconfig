## misc/ulapack/Kconfig
```kconfig
# Kconfig file for package ulapack
menuconfig PKG_USING_ULAPACK
    select RT_USING_LIBC
    bool "ulapack: linear algebra library for embedded devices."
    default n

if PKG_USING_ULAPACK

    config PKG_ULAPACK_PATH
        string
        default "/packages/misc/ulapack"

    config ULAPACK_USING_LU
        bool "LU decomposition example"
        help
            LU decomposition example
        default n

    config ULAPACK_USING_SVD
        bool "SVD decomposition example"
        help
            SVD decomposition example
        default n

    config ULAPACK_USING_PCA
        bool "Principal components analysis example"
        help
            Principal components analysis example
        default n

    config ULAPACK_USING_POLYFIT
        bool "Polynomial regression example"
        help
            Polynomial regression example
        default n

    choice
        prompt "Memory allocation"
        default ULAPACK_USE_DYNAMIC_ALLOC
        help
            Select memory allocation method
        config ULAPACK_USE_DYNAMIC_ALLOC
            bool "Dynamic allocation"
        config ULAPACK_USE_STATIC_ALLOC
            bool "Static allocation"
    endchoice

    choice
        prompt "Version"
        default PKG_USING_ULAPACK_LATEST_VERSION
        help
            Select the package version
        config PKG_USING_ULAPACK_LATEST_VERSION
            bool "latest"
    endchoice

    config PKG_ULAPACK_VER
       string
       default "latest"    if PKG_USING_ULAPACK_LATEST_VERSION

    config PKG_ULAPACK_VER_NUM
        hex
        default 0x99999 if PKG_USING_ULAPACK_LATEST_VERSION

endif
```

## misc/upacker/Kconfig
```kconfig
# Kconfig file for package upacker
menuconfig PKG_USING_UPACKER
    bool "upacker: building and parsing data frames to be sent over a serial interface"
    default n

if PKG_USING_UPACKER

    config PKG_UPACKER_PATH
        string
        default "/packages/misc/upacker"

    choice
        prompt "Version"
        default PKG_USING_UPACKER_LATEST_VERSION
        help
            Select the package version

        config PKG_USING_UPACKER_LATEST_VERSION
            bool "latest"
    endchoice
          
    config PKG_UPACKER_VER
       string
       default "latest"    if PKG_USING_UPACKER_LATEST_VERSION

endif
```

## misc/uparam/Kconfig
```kconfig
# Kconfig file for package uparam
menuconfig PKG_USING_UPARAM
    bool "uparam: Manage system parameters with FLASH"
    select PKG_USING_FAL if RT_VER_NUM < 0x40100
    select RT_USING_FAL if RT_VER_NUM >= 0x40100
    default n

if PKG_USING_UPARAM

    config PKG_UPARAM_PATH
        string
        default "/packages/misc/uparam"

    choice
        prompt "Version"
        default PKG_USING_UPARAM_LATEST_VERSION
        help
            Select the package version

        config PKG_USING_UPARAM_LATEST_VERSION
            bool "latest"
    endchoice

    config PKG_UPARAM_VER
       string
       default "latest"    if PKG_USING_UPARAM_LATEST_VERSION

endif
```

## misc/vi/Kconfig
```kconfig
menuconfig PKG_USING_VI
    bool "vi: A screen-oriented text editor"
    select RT_USING_DFS         if RT_VER_NUM < 0x40100
    select RT_USING_POSIX       if RT_VER_NUM < 0x40100
    select RT_USING_LIBC        if RT_VER_NUM < 0x40100
    select RT_USING_POSIX_FS    if RT_VER_NUM >= 0x40100
    select RT_USING_POSIX_STDIO if RT_VER_NUM >= 0x40100
    select RT_USING_POSIX_POLL  if RT_VER_NUM >= 0x40100
    select PKG_USING_OPTPARSE
    select PKG_USING_MEM_SANDBOX
    default n

if PKG_USING_VI

    config PKG_VI_PATH
        string
        default "/packages/misc/vi"

    config VI_SANDBOX_SIZE_KB
        int "Space size of the vi sandbox (KB)"
        default 20

    config VI_MAX_LEN
        int "Maximum screen width in vi"
        range 256 16384
        default 4096
        help
          Contrary to what you may think, this is not eating much.
          Make it smaller than 4k only if you are very limited on memory.

    config VI_ENABLE_8BIT
        bool "Allow vi to display 8-bit chars (otherwise shows dots)"
        default n
        help
          If your terminal can display characters with high bit set,
          you may want to enable this. Note: vi is not Unicode-capable.
          If your terminal combines several 8-bit bytes into one character
          (as in Unicode mode), this will not work properly.

    config VI_ENABLE_COLON
        bool "Enable \":\" colon commands (no \"ex\" mode)"
        default y
        help
          Enable a limited set of colon commands for vi. This does not
          provide an "ex" mode.

    config VI_ENABLE_COLON_EXPAND
        bool "Expand \"%\" and \"#\" in colon commands"
        default y
        depends on VI_ENABLE_COLON
        help
          Expand the special characters \"%\" (current filename)
          and \"#\" (alternate filename) in colon commands.

    config VI_ENABLE_YANKMARK
        bool "Enable yank/put commands and mark cmds"
        default y
        help
          This will enable you to use yank and put, as well as mark in
          busybox vi.

    config VI_ENABLE_SEARCH
        bool "Enable search and replace cmds"
        default y
        help
          Select this if you wish to be able to do search and replace in
          busybox vi.

    config VI_ENABLE_DOT_CMD
        bool "Remember previous cmd and \".\" cmd"
        default y
        help
          Make busybox vi remember the last command and be able to repeat it.

    config VI_ENABLE_READONLY
        bool "Enable -R option and \"view\" mode"
        default y
        help
          Enable the read-only command line option, which allows the user to
          open a file in read-only mode.

    config VI_ENABLE_SETOPTS
        bool "Enable set-able options, ai ic showmatch"
        default y
        help
          Enable the editor to set some (ai, ic, showmatch) options.

    config VI_ENABLE_SET
        bool "Support for :set"
        default y
        help
          Support for ":set".

    config VI_ENABLE_WIN_RESIZE
        select RT_USING_POSIX_TERMIOS
        bool "Handle window resize"
        default y
        help
          Make busybox vi behave nicely with terminals that get resized.

    config VI_ENABLE_VI_ASK_TERMINAL
        bool "Use 'tell me cursor position' ESC sequence to measure window"
        default y
        help
          If terminal size can't be retrieved and $LINES/$COLUMNS are not set,
          this option makes vi perform a last-ditch effort to find it:
          position cursor to 999,999 and ask terminal to report real
          cursor position using "ESC [ 6 n" escape sequence, then read stdin.
          This is not clean but helps a lot on serial lines and such.

    config VI_ENABLE_UNDO
        bool "Support undo command 'u'"
        default y
        help
          Support the 'u' command to undo insertion, deletion, and replacement
          of text.

    config VI_ENABLE_UNDO_QUEUE
        bool "Enable undo operation queuing"
        default y
        depends on VI_ENABLE_UNDO
        help
          The vi undo functions can use an intermediate queue to greatly lower
          malloc() calls and overhead. When the maximum size of this queue is
          reached, the contents of the queue are committed to the undo stack.
          This increases the size of the undo code and allows some undo
          operations (especially un-typing/backspacing) to be far more useful.

    config VI_UNDO_QUEUE_MAX
        int "Maximum undo character queue size"
        default 256
        range 32 65536
        depends on VI_ENABLE_UNDO_QUEUE
        help
          This option sets the number of bytes used at runtime for the queue.
          Smaller values will create more undo objects and reduce the amount
          of typed or backspaced characters that are grouped into one undo
          operation; larger values increase the potential size of each undo
          and will generally malloc() larger objects and less frequently.
          Unless you want more (or less) frequent "undo points" while typing,
          you should probably leave this unchanged.

    config VI_ENABLE_VERBOSE_STATUS
        bool "Enable verbose status reporting"
        default y
        help
          Enable more verbose reporting of the results of yank, change,
          delete, undo and substitution commands.

    choice
        prompt "Version"
        help
            Select this package version
        default PKG_USING_VI_LATEST_VERSION
        default PKG_USING_VI_V135 if RT_VER_NUM < 0x40100

        config PKG_USING_VI_LATEST_VERSION
            bool "latest"

        config PKG_USING_VI_V135
            depends on RT_VER_NUM < 0x40100
            bool "v1.3.5"

    endchoice

    config PKG_VI_VER
        string
        default "latest" if PKG_USING_VI_LATEST_VERSION
        default "v1.3.5" if PKG_USING_VI_V135
endif
```

## misc/vt100/Kconfig
```kconfig
# Kconfig file for package vt100
menuconfig PKG_USING_VT100
    bool "vt100: iridescent drawing library on MSH"
    select RT_USING_LIBC
    default n

if PKG_USING_VT100

    config PKG_VT100_PATH
        string
        default "/packages/misc/vt100"

    config VT100_USING_MONITOR
        bool "Monitor: RT-Thread monitor example"
        help
            RT-Thread monitor.
        default n

    config VT100_USING_COLOR
        bool "Color: Draw different colors and boxes"
        help
            Color: Draw different colors and boxes
        default n

    config VT100_USING_SL
        bool "Animation: a funny rushing train"
        help
            Animation: a funny rushing train
        default n

    choice
        prompt "Version"
        default PKG_USING_VT100_LATEST_VERSION
        help
            Select the package version
        config PKG_USING_VT100_V100
            bool "v1.0.0"
        config PKG_USING_VT100_LATEST_VERSION
            bool "latest"
    endchoice

    config PKG_VT100_VER
       string
       default "v1.0.0"    if PKG_USING_VT100_V100
       default "latest"    if PKG_USING_VT100_LATEST_VERSION

    config PKG_VT100_VER_NUM
        hex
        default 0x10000 if PKG_USING_VT100_V100
        default 0x99999 if PKG_USING_VT100_LATEST_VERSION

endif
```

## misc/zlib/Kconfig
```kconfig
# Kconfig file for package zlib
menuconfig PKG_USING_ZLIB
    bool "zlib: general purpose data compression library"
    default n

if PKG_USING_ZLIB

    config PKG_ZLIB_PATH
        string
        default "/packages/misc/zlib"

    config ZLIB_USING_SAMPLE
        bool "Enable using zlib sample"
        select RT_USING_DFS      if RT_VER_NUM < 0x40100
        select RT_USING_POSIX_FS if RT_VER_NUM >= 0x40100
        default n

    choice
        prompt "Version"
        default PKG_USING_ZLIB_LATEST_VERSION
        help
            Select the package version

        config PKG_USING_ZLIB_V100
            bool "v1.0.0"

        config PKG_USING_ZLIB_V123
            bool "v1.2.3"

        config PKG_USING_ZLIB_LATEST_VERSION
            bool "latest"
    endchoice

    config PKG_ZLIB_VER
       string
       default "v1.0.0"    if PKG_USING_ZLIB_V100
       default "v1.2.3"    if PKG_USING_ZLIB_V123
       default "latest"    if PKG_USING_ZLIB_LATEST_VERSION

endif
```

## multimedia/3gpp_amrnb/Kconfig
```kconfig
# Kconfig file for package 3gpp amrnb
menuconfig PKG_USING_3GPP_AMRNB
    bool "Enable 3gpp amrnb codec library"
    default n

    if PKG_USING_3GPP_AMRNB
        config PKG_AMRNB_PATH
            string
            default "/packages/multimedia/3gpp_amrnb"

        choice
            prompt "Version"
            help
                Select the 3gpp amrnb package version

            config PKG_AMRNB_USING_LATEST_VERSION
                bool "latest"

            config PKG_AMRNB_USING_V010000
                bool "v1.0.0"
        endchoice

        config PKG_AMRNB_VER_NUM
            hex
            default 0x010000    if PKG_AMRNB_USING_V010000
            default 0x999999    if PKG_AMRNB_USING_LATEST_VERSION

        config PKG_AMRNB_VER
            string
            default "v1.0.0"    if PKG_AMRNB_VER_NUM = 0x010000
            default "latest"    if PKG_AMRNB_VER_NUM = 0x999999

        config AMRNB_USING_CMD
            bool "Enable codec command"
            default y
    endif
```

## multimedia/Arm-2D/Kconfig
```kconfig
# Kconfig file for package Arm-2D
menuconfig PKG_USING_ARM_2D
    bool "Arm-2D: 2D Graphic Library optimized for Cortex-M processors"
    default n

if PKG_USING_ARM_2D

    config PKG_ARM_2D_PATH
        string
        default "/packages/multimedia/Arm-2D"

    choice
        prompt "Version"
        help
            Select the package version

        config PKG_USING_ARM_2D_LATEST_VERSION
            bool "latest"
    endchoice

    config PKG_ARM_2D_VER
       string
       default "latest"    if PKG_USING_ARM_2D_LATEST_VERSION

endif
```

## multimedia/AzureGUIX/Kconfig
```kconfig
# Kconfig file for package AzureGUIX
menuconfig PKG_USING_AZUREGUIX
    bool "AzureGUIX"
    default n

if PKG_USING_AZUREGUIX

    config PKG_AZUREGUIX_PATH
        string
        default "/packages/multimedia/AzureGUIX"

    config GUIX_VIRTUAL_DISPLAY_MONO
        bool "Enable uart device virtual display"
        default n

    if GUIX_VIRTUAL_DISPLAY_MONO
        config GUIX_VIRTUAL_DISPLAY_SERIAL_DEV
            string "virtual display uart device name"
            default "uart2"
    endif

    choice
        prompt "Version"
        default PKG_USING_AZUREGUIX_LATEST_VERSION
        help
            Select the package version

        config PKG_USING_AZUREGUIX_V100
            bool "v1.0.0"

        config PKG_USING_AZUREGUIX_LATEST_VERSION
            bool "latest"
    endchoice

    config PKG_AZUREGUIX_VER
       string
       default "v1.0.0"    if PKG_USING_AZUREGUIX_V100
       default "latest"    if PKG_USING_AZUREGUIX_LATEST_VERSION

endif
```

## multimedia/Kconfig
```kconfig
menu "multimedia packages"

source "$PKGS_DIR/packages/multimedia/LVGL/Kconfig"
source "$PKGS_DIR/packages/multimedia/u8g2/Kconfig"
source "$PKGS_DIR/packages/multimedia/openmv/Kconfig"
source "$PKGS_DIR/packages/multimedia/mupdf/Kconfig"
source "$PKGS_DIR/packages/multimedia/STemWin/Kconfig"
source "$PKGS_DIR/packages/multimedia/wavplayer/Kconfig"
source "$PKGS_DIR/packages/multimedia/TJpgDec/Kconfig"
source "$PKGS_DIR/packages/multimedia/PDFGen/Kconfig"
source "$PKGS_DIR/packages/multimedia/helix/Kconfig"
source "$PKGS_DIR/packages/multimedia/AzureGUIX/Kconfig"
source "$PKGS_DIR/packages/multimedia/touchgfx2rtt/Kconfig"
source "$PKGS_DIR/packages/multimedia/NUemWin/Kconfig"
source "$PKGS_DIR/packages/multimedia/mp3player/Kconfig"
source "$PKGS_DIR/packages/multimedia/TinyJPEG/Kconfig"
source "$PKGS_DIR/packages/multimedia/ugui/Kconfig"
source "$PKGS_DIR/packages/multimedia/mcurses/Kconfig"
source "$PKGS_DIR/packages/multimedia/termbox/Kconfig"
source "$PKGS_DIR/packages/multimedia/vt100/Kconfig"
source "$PKGS_DIR/packages/multimedia/qrcode/Kconfig"
source "$PKGS_DIR/packages/multimedia/gui_engine/Kconfig"
source "$PKGS_DIR/packages/multimedia/persimmon/Kconfig"
source "$PKGS_DIR/packages/multimedia/3gpp_amrnb/Kconfig"

endmenu
```

## multimedia/LVGL/Kconfig
```kconfig
menu "LVGL: powerful and easy-to-use embedded GUI library"

source "$PKGS_DIR/packages/multimedia/LVGL/LVGL/Kconfig"
source "$PKGS_DIR/packages/multimedia/LVGL/LittlevGL2RTT/Kconfig"
source "$PKGS_DIR/packages/multimedia/LVGL/lv_music_demo/Kconfig"
source "$PKGS_DIR/packages/multimedia/LVGL/gui_guider_demo/Kconfig"

endmenu
```
