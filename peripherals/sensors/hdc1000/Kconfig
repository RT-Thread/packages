## peripherals/sensors/hdc1000/Kconfig
```kconfig
# Kconfig file for package hdc1000
menuconfig PKG_USING_HDC1000
    bool "hdc1000 sensor driver,support: temperature and humidity."
    default n

if PKG_USING_HDC1000

    config PKG_HDC1000_PATH
        string
        default "/packages/peripherals/sensors/hdc1000"

    choice
        prompt "Version"
        default PKG_USING_HDC1000_LATEST_VERSION
        help
            Select the package version

        config PKG_USING_HDC1000_V100
            bool "v1.0.0"

        config PKG_USING_HDC1000_LATEST_VERSION
            bool "latest"
    endchoice
          
    config PKG_HDC1000_VER
       string
       default "v1.0.0"    if PKG_USING_HDC1000_V100
       default "latest"    if PKG_USING_HDC1000_LATEST_VERSION

endif
```

## peripherals/sensors/hmc5883/Kconfig
```kconfig
# Kconfig file for package hmc5883
menuconfig PKG_USING_HMC5883
    bool "hmc5883: a hmc5883 package for rt-thread."
    default n

if PKG_USING_HMC5883

    config PKG_HMC5883_PATH
        string
        default "/packages/peripherals/sensors/hmc5883"

    choice
        prompt "Version"
        default PKG_USING_HMC5883_LATEST_VERSION
        help
            Select the package version

        config PKG_USING_HMC5883_V100
            bool "v1.0.0"

        config PKG_USING_HMC5883_LATEST_VERSION
            bool "latest"
    endchoice

    config PKG_HMC5883_VER
       string
       default "latest"    if PKG_USING_HMC5883_LATEST_VERSION

endif
```

## peripherals/sensors/hs300x/Kconfig
```kconfig
# Kconfig file for package hs300x
menuconfig PKG_USING_HS300X
    bool "hs300x: digital humidity and temperature sensor hs300x driver library"
    default n

if PKG_USING_HS300X

    config PKG_HS300X_PATH
        string
        default "/packages/peripherals/sensors/hs300x"

    choice
        prompt "Version"
        default PKG_USING_HS300X_LATEST_VERSION
        help
            Select the package version

        config PKG_USING_HS300X_LATEST_VERSION
            bool "latest"
    endchoice

    config PKG_HS300X_VER
       string
       default "latest"    if PKG_USING_HS300X_LATEST_VERSION

endif
```

## peripherals/sensors/hshcal001/Kconfig
```kconfig
# Kconfig file for package hshcal001
menuconfig PKG_USING_HSHCAL001
    bool "hshcal001 sensor driver package, support: temperature, humidity."
    default n

if PKG_USING_HSHCAL001

    config PKG_HSHCAL001_PATH
        string
        default "/packages/peripherals/sensors/hshcal001"

    config PKG_USING_HSHCAL001_HUMI
        bool "Enable hshcal001 humi"
        default y

    config PKG_USING_HSHCAL001_TEMP
        bool "Enable hshcal001 temp"
        default y

    choice
        prompt "Version"
        default PKG_USING_HSHCAL001_LATEST_VERSION
        help
            Select the package version

        config PKG_USING_HSHCAL001_V001
            bool "v0.0.1"

        config PKG_USING_HSHCAL001_LATEST_VERSION
            bool "latest"
    endchoice

    config PKG_HSHCAL001_VER
       string
       default "v0.0.1"    if PKG_USING_HSHCAL001_V001
       default "latest"    if PKG_USING_HSHCAL001_LATEST_VERSION

endif
```

## peripherals/sensors/hts221/Kconfig
```kconfig
# Kconfig file for package hts221
menuconfig PKG_USING_HTS221
    bool "HTS221 sensor driver package, support: temperature, humidity."
    default n

if PKG_USING_HTS221

    config PKG_HTS221_PATH
        string
        default "/packages/peripherals/sensors/hts221"

    config PKG_USING_HTS221_HUMI
        bool "Enable hts221 humi"
        default y

    config PKG_USING_HTS221_TEMP
        bool "Enable hts221 temp"
        default y

    choice
        prompt "Version"
        default PKG_USING_HTS221_LATEST_VERSION
        help
            Select the package version

        config PKG_USING_HTS221_V001
            bool "v0.0.1"

        config PKG_USING_HTS221_LATEST_VERSION
            bool "latest"
    endchoice

    config PKG_HTS221_VER
       string
       default "v0.0.1"    if PKG_USING_HTS221_V001
       default "latest"    if PKG_USING_HTS221_LATEST_VERSION

endif
```

## peripherals/sensors/icm20608/Kconfig
```kconfig
# Kconfig file for package icm20608
menuconfig PKG_USING_ICM20608
    bool "icm20608: a 3-axis gyroscope and a 3-axis accelerometer driver library"
    default n

if PKG_USING_ICM20608

    config PKG_ICM20608_PATH
        string
        default "/packages/peripherals/sensors/icm20608"

    choice
        prompt "Version"
        default PKG_USING_ICM20608_LATEST_VERSION
        help
            Select the package version

        config PKG_USING_ICM20608_V100
            bool "v1.0.0"

        config PKG_USING_ICM20608_LATEST_VERSION
            bool "latest"
    endchoice

    config PKG_ICM20608_VER
       string
       default "v1.0.0"    if PKG_USING_ICM20608_V100
       default "latest"    if PKG_USING_ICM20608_LATEST_VERSION

endif
```

## peripherals/sensors/icm20948/Kconfig
```kconfig
# Kconfig file for package icm20948
menuconfig PKG_USING_ICM20948
    bool "icm20948 sensor driver package, support: accelerometer, gyroscope."
    select RT_USING_SENSOR
    default n

if PKG_USING_ICM20948

    config PKG_ICM20948_PATH
        string
        default "/packages/peripherals/sensors/icm20948"

    config PKG_ICM20948_USING_SAMPLE
        bool "Enable icm20948 sample"
        default n

    choice
        prompt "I2C device address type"
        default PKG_ICM20948_I2C_ADDR_TYPE_LOW
        help
            Select I2C device address type: if SA0=0 -> I2C_DEVICE_TYPE_LOW if SA0=1 -> I2C_DEVICE_TYPE_HIGH

        config PKG_ICM20948_I2C_ADDR_TYPE_HIGH
            bool "I2C address high. if SA0 pad connect to VCC, select me"

        config PKG_ICM20948_I2C_ADDR_TYPE_LOW
            bool "I2C address low. if SA0 pad connect to GND, select me"
    endchoice

    choice
        prompt "Version"
        default PKG_USING_ICM20948_LATEST_VERSION
        help
            Select the package version

        config PKG_USING_ICM20948_LATEST_VERSION
            bool "latest"
    endchoice

    config PKG_ICM20948_VER
       string
       default "latest"    if PKG_USING_ICM20948_LATEST_VERSION

endif
```

## peripherals/sensors/ina226/Kconfig
```kconfig
# Kconfig file for package ina226
menuconfig PKG_USING_INA226
    bool "ina226: a ina226 package for rt-thread."
    default n
    select RT_USING_I2C
    help
        A current monitoring chip from TI, driven through the SENSOR frame.

if PKG_USING_INA226
	config PKG_INA226_USING_SENSOR_V1
        bool "Enable sensor_v1 divce framework(please enbale an i2c bus)"
        select RT_USING_SENSOR
        default n
		
    config PKG_USING_INA226_EXAMPLE
        bool "Enable ina226 example"
        select PKG_INA226_USING_SENSOR_V1
        default n

    config PKG_INA226_PATH
        string
        default "/packages/peripherals/sensors/ina226"

    choice
        prompt "Version"
        default PKG_USING_INA226_LATEST_VERSION
        help
            Select the package version

        config PKG_USING_INA226_V101
            bool "v1.0.1"

        config PKG_USING_INA226_LATEST_VERSION
            bool "latest"
    endchoice

    config PKG_INA226_VER
       string
       default "latest"    if PKG_USING_INA226_LATEST_VERSION

endif
```

## peripherals/sensors/ina260/Kconfig
```kconfig
# Kconfig file for package ina260
menuconfig PKG_USING_INA260
    bool "ina260: a ina260 package for rt-thread."
    default n
    select RT_USING_I2C
    help
        A current monitoring chip from TI, driven through the SENSOR frame.

if PKG_USING_INA260

    config PKG_INA260_USING_SENSOR_V1
        bool "Enable sensor_v1 divce framework"
        select RT_USING_SENSOR
        default n
		
    config PKG_USING_INA260_EXAMPLE
        bool "Enable ina260 example"
        select PKG_INA260_USING_SENSOR_V1
        default n

    config PKG_INA260_PATH
        string
        default "/packages/peripherals/sensors/ina260"

    choice
        prompt "Version"
        default PKG_USING_INA260_LATEST_VERSION
        help
            Select the package version

        config PKG_USING_INA260_V101
            bool "v1.0.1"

        config PKG_USING_INA260_LATEST_VERSION
            bool "latest"
    endchoice

    config PKG_INA260_VER
       string
       default "latest"    if PKG_USING_INA260_LATEST_VERSION

endif
```

## peripherals/sensors/isl29035/Kconfig
```kconfig
# Kconfig file for package ISL29035
menuconfig PKG_USING_ISL29035
    bool "ISL29035: Integrated Digital Light Sensor ISL29035 driver library"
    default n

if PKG_USING_ISL29035

    config PKG_ISL29035_PATH
        string
        default "/packages/peripherals/sensors/ISL29035"

    config PKG_ISL29035_USING_SENSOR_V1
        bool "Enable sensor_v1 divce framework"
        select RT_USING_SENSOR
        default n

    choice
        prompt "Version"
        default PKG_USING_ISL29035_LATEST_VERSION
        help
            Select the package version

        config PKG_USING_ISL29035_LATEST_VERSION
            bool "latest"
    endchoice

    config PKG_ISL29035_VER
        string
        default "latest"    if PKG_USING_ISL29035_LATEST_VERSION

endif
```

## peripherals/sensors/lis2dh12/Kconfig
```kconfig
# Kconfig file for package lis2dh12
menuconfig PKG_USING_LIS2DH12
    bool "LIS2DH12 sensor driver package, support: 3-axis accelerometer,tempature."
    default n

if PKG_USING_LIS2DH12

    config PKG_LIS2DH12_PATH
        string
        default "/packages/peripherals/sensors/lis2dh12"

    config PKG_LIS2DH12_USING_SENSOR_V1
        bool "Enable sensor_v1 divce framework(please enbale an spi bus)"
        select RT_USING_SENSOR
        default n

    choice
        prompt "Version"
        default PKG_USING_LIS2DH12_LATEST_VERSION
        help
            Select the package version

        config PKG_USING_LIS2DH12_V001
            bool "v0.0.1"

        config PKG_USING_LIS2DH12_LATEST_VERSION
            bool "latest"
    endchoice

    config PKG_LIS2DH12_VER
       string
       default "v0.0.1"    if PKG_USING_LIS2DH12_V001
       default "latest"    if PKG_USING_LIS2DH12_LATEST_VERSION

endif
```

## peripherals/sensors/lps22hb/Kconfig
```kconfig
# Kconfig file for package lps22hb
menuconfig PKG_USING_LPS22HB
    bool "LPS22HB sensor driver package, support: barometric,temperature."
    default n

if PKG_USING_LPS22HB
	
    config PKG_LPS22HB_USING_SENSOR_V1
        bool "Enable sensor_v1 divce framework"
        select RT_USING_SENSOR
        default n
		
    config PKG_LPS22HB_PATH
        string
        default "/packages/peripherals/sensors/lps22hb"
	
    choice
        prompt "Version"
        default PKG_USING_LPS22HB_LATEST_VERSION
        help
            Select the package version

        config PKG_USING_LPS22HB_V001
            bool "v0.0.1"

        config PKG_USING_LPS22HB_LATEST_VERSION
            bool "latest"
    endchoice

    config PKG_LPS22HB_VER
       string
       default "v0.0.1"    if PKG_USING_LPS22HB_V001
       default "latest"    if PKG_USING_LPS22HB_LATEST_VERSION

endif
```

## peripherals/sensors/lsm303agr/Kconfig
```kconfig
# Kconfig file for package lsm303agr
menuconfig PKG_USING_LSM303AGR
    bool "LSM303AGR sensor driver package, support: accelerometer, magnetometer."
    default n

if PKG_USING_LSM303AGR

   config PKG_LSM303AGR_USING_SENSOR_V1
    bool "Enable sensor_v1 divce framework"
    select RT_USING_SENSOR
    default n
    
    if PKG_LSM303AGR_USING_SENSOR_V1
        config PKG_USING_LSM303AGR_ACCE
            bool "Enable lsm303agr acce"
            default y
        config PKG_USING_LSM303AGR_MAG
            bool "Enable lsm303agr mag"
            default y
    endif

    config PKG_LSM303AGR_PATH
        string
        default "/packages/peripherals/sensors/lsm303agr"

    choice
        prompt "Version"
        default PKG_USING_LSM303AGR_LATEST_VERSION
        help
            Select the package version

        config PKG_USING_LSM303AGR_V001
            bool "v0.0.1"

        config PKG_USING_LSM303AGR_LATEST_VERSION
            bool "latest"
    endchoice

    config PKG_LSM303AGR_VER
       string
       default "v0.0.1"    if PKG_USING_LSM303AGR_V001
       default "latest"    if PKG_USING_LSM303AGR_LATEST_VERSION

endif
```

## peripherals/sensors/lsm6dsl/Kconfig
```kconfig
# Kconfig file for package lsm6dsl
menuconfig PKG_USING_LSM6DSL
    bool "LSM6DSL sensor driver package, support: accelerometer, gyroscope, step."
    default n

if PKG_USING_LSM6DSL

	config PKG_LSM6DSL_USING_SENSOR_V1
        bool "Enable sensor_v1 divce framework"
        select RT_USING_SENSOR
        default n

    config PKG_LSM6DSL_PATH
        string
        default "/packages/peripherals/sensors/lsm6dsl"

    config PKG_USING_LSM6DSL_ACCE
        bool "Enable lsm6dsl acce"
        default y

    config PKG_USING_LSM6DSL_GYRO
        bool "Enable lsm6dsl gyro"
        default y

    config PKG_USING_LSM6DSL_STEP
        bool "Enable lsm6dsl step"
        default y

    choice
        prompt "Version"
        default PKG_USING_LSM6DSL_LATEST_VERSION
        help
            Select the package version

        config PKG_USING_LSM6DSL_V001
            bool "v0.0.1"

        config PKG_USING_LSM6DSL_LATEST_VERSION
            bool "latest"
    endchoice

    config PKG_LSM6DSL_VER
       string
       default "v0.0.1"    if PKG_USING_LSM6DSL_V001
       default "latest"    if PKG_USING_LSM6DSL_LATEST_VERSION

endif
```

## peripherals/sensors/lsm6dsm/Kconfig
```kconfig
# Kconfig file for package LSM6DSM
menuconfig PKG_USING_LSM6DSM
    bool "LSM6DSM sensor driver package, support: accelerometer, gyroscope, step, temperature."
    default n

if PKG_USING_LSM6DSM

    config PKG_LSM6DSM_USING_SENSOR_V1
        bool "Enable sensor_v1 divce framework"
        select RT_USING_SENSOR
        default n
		
    config PKG_LSM6DSM_PATH
        string
        default "/packages/peripherals/sensors/lsm6dsm"

    config PKG_LSM6DSM_USING_ACCE
        bool "Enable LSM6DSM Accelerometer"
        default y

    config PKG_LSM6DSM_USING_GYRO
        bool "Enable LSM6DSM gyro"
        default y

    config PKG_LSM6DSM_USING_STEP
        bool "Enable LSM6DSM temperature"
        default y

    config PKG_LSM6DSM_USING_TEMP
        bool "Enable LSM6DSM step count"
        default y

    choice
        prompt "I2C device address type"
        default PKG_LSM6DSM_I2C_ADDR_TYPE_LOW
        help
            Select I2C device address type: if SA0=0 -> I2C_DEVICE_TYPE_LOW if SA0=1 -> I2C_DEVICE_TYPE_HIGH

        config PKG_LSM6DSM_I2C_ADDR_TYPE_HIGH
            bool "I2C address high. if SA0 pad connect to VCC, select me"

        config PKG_LSM6DSM_I2C_ADDR_TYPE_LOW
            bool "I2C address low. if SA0 pad connect to GND, select me"
    endchoice

    choice
        prompt "Version"
        default PKG_USING_LSM6DSM_LATEST_VERSION
        help
            Select the package version

        config PKG_USING_LSM6DSM_V100
            bool "v1.0.0"

        config PKG_USING_LSM6DSM_LATEST_VERSION
            bool "latest"
    endchoice

    config PKG_LSM6DSM_VER
       string
       default "v1.0.0"    if PKG_USING_LSM6DSM_V100
       default "latest"    if PKG_USING_LSM6DSM_LATEST_VERSION

endif
```
