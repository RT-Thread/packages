## iot/WiFi/marvell/Kconfig
```kconfig
menu "Marvell WiFi"

config PKG_USING_MARVELLWIFI
    bool "Marvell WiFi driver for rt-thread"
    default n

if PKG_USING_MARVELLWIFI

    config PKG_MARVELLWIFI_PATH
        string
        default "/packages/iot/WiFi/marvell"

    config PKG_MARVELLWIFI_VER
        string
        default "v1.0.0"

    config MARVELLWIFI_USING_STA
        bool "Using station mode"
        default y

    if MARVELLWIFI_USING_STA
        config MARVELLWIFI_STA_REASSOCIATION
        bool "station mode support reassociation"
        default y
    endif

    config MARVELLWIFI_USING_UAP
        bool "Using access point mode"
        default n
endif

endmenu
```

## iot/WiFi/rw007/Kconfig
```kconfig
menuconfig PKG_USING_RW007
    bool "rw007: SPI WIFI rw007 driver"
    select RT_USING_SPI
    select RT_USING_PIN
    select RT_USING_LWIP
    default n
    help
        if "PKG_USING_RW007" is opened, "RT_USING_LWIP" will be default selected.

if PKG_USING_RW007

    config PKG_RW007_PATH
        string
        default "/packages/iot/WiFi/rw007"

    choice
        prompt "version"
        help
            Select the wiced wifi version
        default PKG_USING_RW007_V111

        config PKG_USING_RW007_V111
            bool "v1.1.1"

        config PKG_USING_RW007_V110
            bool "v1.1.0"

        config PKG_USING_RW007_V100
            bool "v1.0.0"
            
        config PKG_USING_RW007_V200
            bool "v2.0.0"
            
        config PKG_USING_RW007_V201
            bool "v2.0.1"
            
        config PKG_USING_RW007_LATEST_VERSION
            bool "latest"
    endchoice

    config PKG_RW007_VER
        string
        default "v1.1.1" if PKG_USING_RW007_V111
        default "v1.1.0" if PKG_USING_RW007_V110
        default "v1.0.0" if PKG_USING_RW007_V100
        default "v2.0.0" if PKG_USING_RW007_V200
        default "v2.0.1" if PKG_USING_RW007_V201
        default "latest" if PKG_USING_RW007_LATEST_VERSION

    choice
        prompt "example driver port"
        default RW007_USING_STM32_DRIVERS

        config RW007_NOT_USE_EXAMPLE_DRIVERS
            bool "not use example driver, porting by myself"

        config RW007_USING_STM32_DRIVERS
            bool "rw007 for stm32"

        config RW007_USING_RENESAS_DRIVERS
            bool "rw007 for RENESAS"

        # config RW007_USING_IMXRT_DRIVERS
        #    bool "rw007 for imxrt"
    endchoice

    config RW007_SPI_MAX_HZ
        int "SPI Max Hz"
        default 30000000

    if !RW007_NOT_USE_EXAMPLE_DRIVERS
        if RW007_USING_STM32_DRIVERS || RW007_USING_IMXRT_DRIVERS
            config RW007_SPI_BUS_NAME
                string "RW007 BUS NAME"
                default "spi2"

            config RW007_CS_PIN
                int "CS pin index"
                default 102

            config RW007_BOOT0_PIN
                int "BOOT0 pin index (same as spi clk pin)"
                default 175

            config RW007_BOOT1_PIN
                int "BOOT1 pin index (same as spi cs pin)"
                default 102

            config RW007_INT_BUSY_PIN
                int "INT/BUSY pin index"
                default 62

            config RW007_RST_PIN
                int "RESET pin index"
                default 187
        endif

        if RW007_USING_RENESAS_DRIVERS
            config RW007_SPI_BUS_NAME
                string "RW007 BUS NAME"
                default "spi1"

            config RW007_CS_PIN
                hex "(HEX)CS pin index"
                default 0x040D

            config RW007_BOOT0_PIN
                hex "(HEX)BOOT0 pin index (same as spi clk pin)"
                default 0x040C

            config RW007_BOOT1_PIN
                hex "(HEX)BOOT1 pin index (same as spi cs pin)"
                default 0x040D

            config RW007_INT_BUSY_PIN
                hex "(HEX)INT/BUSY pin index"
                default 0x0101

            config RW007_RST_PIN
                hex "(HEX)RESET pin index"
                default 0x0102
        endif

    endif

endif
```
