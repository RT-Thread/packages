## peripherals/sht3x/Kconfig
```kconfig
# Kconfig file for package sht3x
menuconfig PKG_USING_SHT3X
    bool "sht3x: digital humidity and temperature sensor sht3x driver library"
    default n

if PKG_USING_SHT3X

    config PKG_SHT3X_PATH
        string
        default "/packages/peripherals/sht3x"
            
    choice
        prompt "Version"
        default PKG_USING_SHT3X_V100 
        help
            Select the package version

        config PKG_USING_SHT3X_V100
            bool "v1.0.0"

        config PKG_USING_SHT3X_LATEST_VERSION
            bool "latest"
    endchoice

    config PKG_SHT3X_VER
       string
       default "v1.0.0"    if PKG_USING_SHT3X_V100
       default "latest"    if PKG_USING_SHT3X_LATEST_VERSION
endif
```

## peripherals/soft_serial/Kconfig
```kconfig
# Kconfig file for package soft_serial

menuconfig PKG_USING_SOFT_SERIAL
    bool "soft_serial : a software serial driver package by using the hardware timer capture / comparison functionality."
    default n

if PKG_USING_SOFT_SERIAL

    config PKG_SOFT_SERIAL_PATH
        string
        default "/packages/peripherals/soft_serial"

    config SOFT_SERIAL_TIM_CLK_FREQ
        int "clock frequency of the hardware timer"
        default 8000000

    config SOFT_SERIAL_TIM_PCLK1_MUL
        int "APB1 timer clock frequency multiplier"
        default 1

    config SOFT_SERIAL_TIM_PCLK2_MUL
        int "APB2 timer clock frequency multiplier"
        default 1

    config SOFT_SERIAL_CHK_RX_BEGIN_BIT
        bool "using the begin bit check"
        default y

    config SOFT_SERIAL_CHK_RX_PARITY
        bool "using parity bit check"
        default n

    choice
        prompt "Version"
        default PKG_USING_SOFT_SERIAL_V100
        help
            Select the package version

        config PKG_USING_SOFT_SERIAL_LATEST_VERSION
            bool "latest"

        config PKG_USING_SOFT_SERIAL_V100
            bool "v1.00"
    endchoice

    config PKG_SOFT_SERIAL_VER
       string
       default "latest" if PKG_USING_SOFT_SERIAL_LATEST_VERSION
       default "v1.00"  if PKG_USING_SOFT_SERIAL_V100

endif
```

## peripherals/soft_spi/Kconfig
```kconfig
# Kconfig file for package soft_spi
menuconfig PKG_USING_SPI_BITOPS
    bool "a soft spi driver package for rt-thread"
    default n

if PKG_USING_SPI_BITOPS

    config PKG_SOFT_SPI_PATH
        string
        default "/packages/peripherals/soft_spi"

    choice
        prompt "Version"
        default PKG_USING_SPI_BITOPS_LATEST_VERSION
        help
            Select the package version

        config PKG_USING_SPI_BITOPS_LATEST_VERSION
            bool "latest"
    endchoice
          
    config PKG_SOFT_SPI_VER
       string
       default "latest"    if PKG_USING_SPI_BITOPS_LATEST_VERSION

endif
```

## peripherals/spi-tools/Kconfig
```kconfig
# Kconfig file for package SPI_TOOLS
menuconfig PKG_USING_SPI_TOOLS
    bool "spi-tools: a collection of spi tools including init/deinit/config/trans"
    select RT_USING_PIN
    select RT_USING_SPI
    default n

if PKG_USING_SPI_TOOLS

    config PKG_SPI_TOOLS_PATH
        string
        default "/packages/peripherals/spi-tools"

    choice
        prompt "Version"
        default PKG_USING_SPI_TOOLS_LATEST_VERSION
        help
            Select the package version
        config PKG_USING_SPI_TOOLS_V100
            bool "v1.0.0"
        config PKG_USING_SPI_TOOLS_LATEST_VERSION
            bool "latest"
    endchoice

    config PKG_SPI_TOOLS_VER
       string
       default "v1.0.0"    if PKG_USING_SPI_TOOLS_V100
       default "latest"    if PKG_USING_SPI_TOOLS_LATEST_VERSION

endif
```

## peripherals/ssd1306/Kconfig
```kconfig
# Kconfig file for package ssd1306
menuconfig PKG_USING_SSD1306
    bool "ssd1306: OLEDs based on SSD1306, SH1106, SH1107 and SSD1309 driver"
    default n

if PKG_USING_SSD1306

    config PKG_SSD1306_PATH
        string
        default "/packages/peripherals/ssd1306"

    config PKG_USING_SSD1306_DEBUG
        bool "Enable debug log output"
        default n

    config PKG_USING_SSD1306_I2C_ADDRESS
       hex "I2C address"
       default 0x3C

    config PKG_USING_SSD1306_I2C_BUS_NAME
        string "I2C bus name"
        default "i2c1"

    config PKG_USING_SSD1306_SAMPLE
        bool "Enable ssd1306 sample"
        default n

    choice
        prompt "Version"
        default PKG_USING_SSD1306_LATEST_VERSION
        help
            Select the package version

        config PKG_USING_SSD1306_V100
            bool "v1.0.0"

        config PKG_USING_SSD1306_LATEST_VERSION
            bool "latest"
    endchoice

    config PKG_SSD1306_VER
       string
       default "v1.0.0"    if PKG_USING_SSD1306_V100
       default "latest"    if PKG_USING_SSD1306_LATEST_VERSION

endif
```

## peripherals/st7305/Kconfig
```kconfig
# Kconfig file for package st7305

menuconfig PKG_USING_ST7305
    bool "Control the st7305 chip with SPI bus."
    default n

if PKG_USING_ST7305

    config ST7305_SPI_BUS_NAME
        string "Setting current SPI bus name."
        default "spi1"

    config ST7305_SPI_DEVICE_NAME
        string "Setting current SPI device name."
        default "spi10"

    if RT_USING_HEAP
        config FRAME_BUF_USING_HEAP
        bool "Use heap with the frame buffer allocated."
        default n
    endif

    config PKG_ST7305_PATH
        string
        default "/packages/peripherals/st7305"

    choice
        prompt "Version"
        default PKG_USING_ST7305_V100
        help
            Select the this package version

        config PKG_USING_ST7305_V100
            bool "v1.0.0"

        config PKG_USING_ST7305_LATEST_VERSION
            bool "latest"
    endchoice

    config PKG_ST7305_VER
        string
        default "v1.0.0" if PKG_USING_ST7305_V100
        default "latest" if PKG_USING_ST7305_LATEST_VERSION

endif
```

## peripherals/st7789/Kconfig
```kconfig
# Kconfig file for package ST7789
menuconfig PKG_USING_ST7789
    depends on  RT_VER_NUM >= 0x50000
    bool "TFT-LCD ST7789 SPI Graphic driver."
    default n

if PKG_USING_ST7789
    config PKG_ST7789_PATH
        string
        default "/packages/peripherals/st7789"

    config PKG_ST_7789_SPI_BUS_NAME
        string "spi bus name"
        default "spi0"

    config PKG_ST_7789_SPI_DEVICE_NAME
            string "spi device name"
            default "spi00"

    config PKG_ST_7789_WIDTH
        int "Width of the LCD display"
        default 240

    config PKG_ST_7789_HEIGHT
        int "Height of the LCD display"
        default 320

    config PKG_ST_7789_DC_PIN
        int "DC pin connected to the LCD display"
        default -1

    config PKG_ST_7789_RES_PIN
        int "RESET pin connected to the LCD display"
        default -1

    config PKG_ST_7789_CS_PIN
        int "CS pin connected to the LCD display"
        default -1

    config PKG_ST_7789_BLK_PIN
        int "Backlight pin connected to the LCD display"
        default -1

    choice
        prompt "Version"
        default PKG_USING_ST7789_LATEST_VERSION
        help
            Select the this package version

        config PKG_USING_ST7789_V100
            bool "v1.0.0"

        config PKG_USING_ST7789_LATEST_VERSION
            bool "latest"
    endchoice

    config PKG_ST7789_VER
        string
        default "v1.0.0" if PKG_USING_ST7789_V100
        default "latest" if PKG_USING_ST7789_LATEST_VERSION

endif
```

## peripherals/stm32_sdio/Kconfig
```kconfig
# Kconfig file for package stm32_sdio

menuconfig PKG_USING_STM32_SDIO
    bool "stm32_sdio: STM32 SDIO controller drivers library"
    select RT_USING_SDIO
    default n

if PKG_USING_STM32_SDIO

    config SDIO_BUFF_SIZE
        int "SDIO buff size"
        default 4096

    config SDIO_MAX_FREQ
        int "SDIO max freq"
        default 24000000

    config SDIO_ALIGN_LEN
        int "SDIO allgn"
        default 32

    config SDIO_USING_1_BIT
        bool "SDIO use 1 bit"
        default n

    config PKG_STM32_SDIO_PATH
        string
        default "/packages/peripherals/stm32_sdio"

    choice
        prompt "Version"
        help
            Select the stm32_sdio version
            
        if ((RT_VER_NUM >= 0x30103 && RT_VER_NUM < 0x40000) || RT_VER_NUM >= 0x40001)
            config PKG_USING_STM32_SDIO_V102
                bool "v1.0.2"
        endif
        
        if (RT_VER_NUM < 0x30103 ||  RT_VER_NUM = 0x40000)
            config PKG_USING_STM32_SDIO_V101
                bool "v1.0.1"

            config PKG_USING_STM32_SDIO_V100
                bool "v1.0.0"
        endif
        
        config PKG_USING_STM32_SDIO_LATEST_VERSION
            bool "latest"
    endchoice

    config PKG_STM32_SDIO_VER
       string
       default "v1.0.2"    if PKG_USING_STM32_SDIO_V102
       default "v1.0.1"    if PKG_USING_STM32_SDIO_V101
       default "v1.0.0"    if PKG_USING_STM32_SDIO_V100
       default "latest"    if PKG_USING_STM32_SDIO_LATEST_VERSION
endif
```

## peripherals/stm32f40x-drivers/Kconfig
```kconfig
config PKG_USING_STM32F40X_Drivers
    bool "STM32F40X_Drivers: RT-Thread Drivers for STM32F4 Series"
    default n

if PKG_USING_STM32F40X_Drivers

    config PKG_STM32F40X_Drivers_PATH
        string
        default "/packages/peripherals/stm32f40x-drivers"

    choice
        prompt "Version"
        help 
            Select this package version

        config PKG_USING_STM32F40X_Drivers_V10000
            bool "v1.0.0"

        config PKG_USING_STM32F40X_Drivers_LATEST_VERSION
            bool "latest"
    endchoice

    config PKG_STM32F40X_Drivers_VER
        string
        default "v1.0.0" if PKG_USING_STM32F40X_Drivers_V10000
        default "latest" if PKG_USING_STM32F40X_Drivers_LATEST_VERSION

endif
```

## peripherals/stm32f40x-stdlibraries/Kconfig
```kconfig
config PKG_USING_STM32F40X_STD
    bool "STM32F40X_STD: STM32F40x STD library"
    default n

if PKG_USING_STM32F40X_STD

    config PKG_STM32F40X_STD_PATH
        string
        default "/packages/peripherals/stm32f40x-stdlibraries"

    choice
        prompt "Version"
        help 
            Select this package version

        config PKG_USING_STM32F40X_STD_V10000
            bool "v1.0.0"

        config PKG_USING_STM32F40X_STD_LATEST_VERSION
            bool "latest"
    endchoice

    config PKG_STM32F40X_STD_VER
        string
        default "v1.0.0" if PKG_USING_STM32F40X_STD_V10000
        default "latest" if PKG_USING_STM32F40X_STD_LATEST_VERSION

endif
```

## peripherals/sx12xx/Kconfig
```kconfig
# Kconfig file for package sx12xx
menuconfig PKG_USING_SX12XX
    bool "sx12xx:Semtech LoRa RF chip driver library"
    default n
    select RT_USING_PIN
    select RT_USING_SPI
if PKG_USING_SX12XX

    config PKG_SX12XX_PATH
        string
        default "/packages/peripherals/sx12xx"
    choice
        prompt "SX12XX device type"
        default SX12XX_USING_SX1278
        help
            Select the sx12xx type

        config SX12XX_USING_SX1278
            bool "SX1278 LSD4RF-2F717N30"

    endchoice
    config SX12XX_DEVICE_EXTERN_CONFIG
         bool
         default n

    if !SX12XX_DEVICE_EXTERN_CONFIG
        menu "SX12XX device configure"

            config SX12XX_SPI_DEVICE
                string "SPI device name"
                default "spi10"

            config SX12XX_RST_PIN
                int "Reset PIN number"
                default 7

            config SX12XX_DO0_PIN
                int "DO0 PIN number"
                default 103

            config SX12XX_DO1_PIN
                int "DO1 PIN number"
                default 104

            config SX12XX_DO2_PIN
                int "DO2 PIN number"
                default 105

            config SX12XX_DO3_PIN
                int "DO3 PIN number"
                default 106

            config SX12XX_DO4_PIN
                int "DO4 PIN number"
                default 107

            config SX12XX_DO5_PIN
                int "DO5 PIN number"
                default 108

        endmenu
    endif
    config PKG_USING_SX12XX_SAMPLE
        bool "Enable sx12xx sample"
        default n
    choice
        prompt "Version"
        default PKG_USING_SX12XX_LATEST_VERSION
        help
            Select the package version

        config PKG_USING_SX12XX_V100
            bool "v1.0.0"

        config PKG_USING_SX12XX_LATEST_VERSION
            bool "latest"
    endchoice

    config PKG_SX12XX_VER
       string
       default "v1.0.0"    if PKG_USING_SX12XX_V100
       default "latest"    if PKG_USING_SX12XX_LATEST_VERSION

endif
```

## peripherals/tca9534/Kconfig
```kconfig
# Kconfig file for package tca9534
menuconfig PKG_USING_TCA9534
    bool "TCA9534: a 8-bit I/O expander for i2c-bus."
    default n

if PKG_USING_TCA9534

    config PKG_TCA9534_PATH
        string
        default "/packages/peripherals/tca9534"

     config PKG_USING_TCA9534_SAMPLE
        bool "Enable tca9534 sample"
        default n

    choice
        prompt "Version"
        default PKG_USING_TCA9534_LATEST_VERSION
        help
            Select the package version

        config PKG_USING_TCA9534_V100
            bool "v1.0.0"

        config PKG_USING_TCA9534_LATEST_VERSION
            bool "latest"
    endchoice

    config PKG_TCA9534_VER
       string
       default "v1.0.0"    if PKG_USING_TCA9534_V100
       default "latest"    if PKG_USING_TCA9534_LATEST_VERSION

endif
```
