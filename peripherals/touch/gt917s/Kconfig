## peripherals/uat/Kconfig
```kconfig
# Kconfig file for package uAT

menuconfig PKG_USING_UAT
    bool "Micro AT device driver interface component"
    select PKG_USING_RS485
    default n

if PKG_USING_UAT

    config PKG_UAT_PATH
        string
        default "/packages/peripherals/uat"

    config UAT_USING_PRT_RAW
        bool "using print raw data"
        default n

    choice
        prompt "Version"
        default PKG_USING_UAT_LATEST_VERSION
        help
            Select the package version

        config PKG_USING_UAT_LATEST_VERSION
            bool "latest"

        config PKG_USING_UAT_V100
            bool "v1.00"
    endchoice

    config PKG_UAT_VER
       string
       default "latest" if PKG_USING_UAT_LATEST_VERSION
       default "v1.00"  if PKG_USING_UAT_V100

endif
```

## peripherals/vdevice/Kconfig
```kconfig
# Kconfig file for package vdevice
menuconfig PKG_USING_VDEVICE
    bool "vdevice: A virtual IO peripheral for virtualized environment."
    default n

if PKG_USING_VDEVICE

    config PKG_VDEVICE_PATH
        string
        default "/packages/peripherals/vdevice"

    config VDEVICE_USING_PIN
        bool "Use virtualized pin"
        select RT_USING_PIN
        default n

        if VDEVICE_USING_PIN
            config VDEVICE_PIN_NAME
                string "vdevice pin name"
                default "vpin"
        endif

    config VDEVICE_USING_LCD
        bool "Use virtualized lcd"
        default n

        if VDEVICE_USING_LCD
            config VDEVICE_LCD_NAME
                string "vdevice lcd name"
                default "vlcd"
        endif

    config VDEVICE_USING_TOUCH
        bool "Use virtualized touch"
        select RT_USING_TOUCH
        default n

        if VDEVICE_USING_TOUCH
            config VDEVICE_TOUCH_NAME
                string "vdevice touch name"
                default "vtouch"
        endif

    choice
        prompt "Version"
        default PKG_USING_VDEVICE_LATEST_VERSION
        help
            Select the package version

        config PKG_USING_VDEVICE_V100
            bool "v1.0.0"

        config PKG_USING_VDEVICE_LATEST_VERSION
            bool "latest"
    endchoice

    config PKG_VDEVICE_VER
       string
       default "v1.0.0"    if PKG_USING_VDEVICE_V100
       default "latest"    if PKG_USING_VDEVICE_LATEST_VERSION

endif
```

## peripherals/vs1003/Kconfig
```kconfig
# Kconfig file for package vs1003
menuconfig PKG_USING_VS1003
    bool "vs1003 driver"
    select RT_USING_PIN
    select RT_USING_SPI
    select BSP_USING_SPI
    default n

if PKG_USING_VS1003

    config PKG_VS1003_PATH
        string
        default "/packages/peripherals/vs1003"

    config VS1003_EXAMPLE
        bool
        prompt "vs1003_example"
        default n

    choice
        prompt "Version"
        default PKG_USING_VS1003_LATEST_VERSION
        help
            Select the package version

        config PKG_USING_VS1003_V100
            bool "v1.0.0"

        config PKG_USING_VS1003_LATEST_VERSION
            bool "latest"
    endchoice

    config PKG_VS1003_VER
       string
       default "v1.0.0"    if PKG_USING_VS1003_V100
       default "latest"    if PKG_USING_VS1003_LATEST_VERSION

endif
```

## peripherals/vsensor/Kconfig
```kconfig
# Kconfig file for package virtual sensor
menuconfig PKG_USING_VIRTUAL_SENSOR
    bool "VSensor : using virtual sensor device."
    default n

if PKG_USING_VIRTUAL_SENSOR

    config PKG_VIRTUAL_SENSOR_PATH
        string
        default "/packages/peripherals/vsensor"

    choice
        prompt "Version"
        default PKG_USING_VIRTUAL_SENSOR_LATEST_VERSION
        help
            Select the package version

        config PKG_USING_VIRTUAL_SENSOR_V100
            bool "v1.0.0"

        config PKG_USING_VIRTUAL_SENSOR_LATEST_VERSION
            bool "latest"
    endchoice

    menuconfig PKG_USING_VIRTUAL_SENSOR_ACCE
        bool "SENS : Enable virtual sensor Accelerometer"
        default n
        if PKG_USING_VIRTUAL_SENSOR_ACCE
            config V_SENS_ACCE_DEV_NAME
                string "SENS : the sensor device name for Accelerometer"
                default "accelerometer"
        endif

    menuconfig PKG_USING_VIRTUAL_SENSOR_GYRO
        bool "SENS : Enable virtual sensor Gyroscope"
        default n
        if PKG_USING_VIRTUAL_SENSOR_GYRO
            config V_SENS_GYRO_DEV_NAME
                string "SENS : the sensor device name for Gyroscope"
                default "gyroscope"
        endif

    menuconfig PKG_USING_VIRTUAL_SENSOR_MAG
        bool "SENS : Enable virtual sensor Magnetometer"
        default n
        if PKG_USING_VIRTUAL_SENSOR_MAG
            config V_SENS_MAG_DEV_NAME
                string "SENS : the sensor device name for Magnetometer"
                default "magnetometer"
        endif

    menuconfig PKG_USING_VIRTUAL_SENSOR_TEMP
        bool "SENS : Enable virtual sensor Temperature"
        default n
        if PKG_USING_VIRTUAL_SENSOR_TEMP
            config V_SENS_TEMP_DEV_NAME
                string "SENS : the sensor device name for Temperature"
                default "temperature"
        endif

    menuconfig PKG_USING_VIRTUAL_SENSOR_HUMI
        bool "SENS : Enable virtual sensor Humidity"
        default n
        if PKG_USING_VIRTUAL_SENSOR_HUMI
            config V_SENS_HUMI_DEV_NAME
                string "SENS : the sensor device name for Humidity"
                default "humidity"
        endif

    menuconfig PKG_USING_VIRTUAL_SENSOR_BARO
        bool "SENS : Enable virtual sensor Barometer"
        default n
        if PKG_USING_VIRTUAL_SENSOR_BARO
            config V_SENS_BARO_DEV_NAME
                string "SENS : the sensor device name for Barometer"
                default "barometer"
        endif

    menuconfig PKG_USING_VIRTUAL_SENSOR_LIGHT
        bool "SENS : Enable virtual sensor Light"
        default n
        if PKG_USING_VIRTUAL_SENSOR_LIGHT
            config V_SENS_LIGHT_DEV_NAME
                string "SENS : the sensor device name for Light"
                default "light"
        endif

    menuconfig PKG_USING_VIRTUAL_SENSOR_PROX
        bool "SENS : Enable virtual sensor Proximity"
        default n
        if PKG_USING_VIRTUAL_SENSOR_PROX
            config V_SENS_PROX_DEV_NAME
                string "SENS : the sensor device name for Proximity"
                default "proximity"
        endif

    menuconfig PKG_USING_VIRTUAL_SENSOR_HR
        bool "SENS : Enable virtual sensor HeartRate"
        default n
        if PKG_USING_VIRTUAL_SENSOR_HR
            config V_SENS_HR_DEV_NAME
                string "SENS : the sensor device name for HeartRate"
                default "heartRate"
        endif

    menuconfig PKG_USING_VIRTUAL_SENSOR_TVOC
        bool "SENS : Enable virtual sensor TVOC"
        default n
        if PKG_USING_VIRTUAL_SENSOR_TVOC
            config V_SENS_TVOC_DEV_NAME
                string "SENS : the sensor device name for TVOC"
                default "tvoc_tvo"
        endif

    menuconfig PKG_USING_VIRTUAL_SENSOR_NOISE
        bool "SENS : Enable virtual sensor NOISE"
        default n
        if PKG_USING_VIRTUAL_SENSOR_NOISE
            config V_SENS_NOISE_DEV_NAME
                string "SENS : the sensor device name for Noise"
                default "noise"
        endif

    menuconfig PKG_USING_VIRTUAL_SENSOR_STEP
        bool "SENS : Enable virtual sensor StepCounter"
        default n
        if PKG_USING_VIRTUAL_SENSOR_STEP
            config V_SENS_STEP_DEV_NAME
                string "SENS : the sensor device name for StepCounter"
                default "stepcounter"
        endif

    menuconfig PKG_USING_VIRTUAL_SENSOR_FORCE
        bool "SENS : Enable virtual sensor Force"
        default n
        if PKG_USING_VIRTUAL_SENSOR_FORCE
            config V_SENS_FORCE_DEV_NAME
                string "SENS : the sensor device name for Force"
                default "force"
        endif

    menuconfig PKG_USING_VIRTUAL_SENSOR_SPO2
        bool "SENS : Enable virtual sensor Spo2"
        default n
        if PKG_USING_VIRTUAL_SENSOR_SPO2
            config V_SENS_SPO2_DEV_NAME
                string "SENS : the sensor device name for Spo2"
                default "spo2"
        endif

    config PKG_USING_VIRTUAL_SENSOR_DBG
        bool "SENS : Enable virtual sensor debug log"
        default y

    config PKG_VIRTUAL_SENSOR_VER
       string
       default "v1.0.0"    if PKG_USING_VIRTUAL_SENSOR_V100
       default "latest"    if PKG_USING_VIRTUAL_SENSOR_LATEST_VERSION

endif
```

## peripherals/wk2124/Kconfig
```kconfig
# Kconfig file for package wk2124
menuconfig PKG_USING_WK2124
    bool "wk2124: spi wk2124 driver library."
    default n
    select RT_USING_PIN
    select RT_USING_SPI

if PKG_USING_WK2124

    config PKG_WK2124_PATH
        string
        default "/packages/peripherals/wk2124"

    config PKG_USING_UART_SWK1
        bool "Enable UART SWK1"
        default y

    config PKG_USING_UART_SWK2
        bool "Enable UART SWK2"
        default y

    config PKG_USING_UART_SWK3
        bool "Enable UART SWK3"
        default y

    config PKG_USING_UART_SWK4
        bool "Enable UART SWK4"
        default y

    config WK2124_DEVICE_EXTERN_CONFIG
         bool
         default n

    if !WK2124_DEVICE_EXTERN_CONFIG
        menu "WK2124 device configure"

            config WK2124_SPI_DEVICE
                string "SPI device name"
                default "spi00"

            config WK2124_IRQ_PIN
                int "IRQ pin number"
                default 66

            choice
                prompt "Select crystal frequency"
                default WK2124_Fosc_14745600

                config WK2124_Fosc_1843200
                    bool "1.8432MHz"
                config WK2124_Fosc_3686400
                    bool "3.6864MHz"
                config WK2124_Fosc_7372800
                    bool "7.3728MHz"
                config WK2124_Fosc_11059200
                    bool "11.0592MHz"
                config WK2124_Fosc_14745600
                    bool "14.7456MHz"
                config WK2124_Fosc_8000000
                    bool "8MHz"
                config WK2124_Fosc_16000000
                    bool "16MHz"
                config WK2124_Fosc_24000000
                    bool "24MHz"
                config WK2124_Fosc_32000000
                    bool "32MHz"
            endchoice
        endmenu
    endif

    choice
        prompt "Version"
        default PKG_USING_WK2124_LATEST_VERSION
        help
            Select the package version

        config PKG_USING_WK2124_V100
            bool "v1.0.0"

        config PKG_USING_WK2124_V101
            bool "v1.0.1"

        config PKG_USING_WK2124_V200
            bool "v2.0.0"

        config PKG_USING_WK2124_LATEST_VERSION
            bool "latest"
    endchoice

    config PKG_WK2124_VER
       string
       default "v2.0.0"    if PKG_USING_WK2124_V200
       default "latest"    if PKG_USING_WK2124_LATEST_VERSION

endif
```

## peripherals/wm_libraries/Kconfig
```kconfig
# Kconfig file for package wm_libraries
menuconfig PKG_USING_WM_LIBRARIES
    bool "wm_libraries: a library package for WinnerMicro devices."
    depends on ARCH_ARM_CORTEX_M3
    default n

if PKG_USING_WM_LIBRARIES

    config PKG_WM_LIBRARIES_PATH
        string
        default "/packages/peripherals/wm_libraries"

    choice
        prompt "Version"
        default PKG_USING_WM_LIBRARIES_LATEST_VERSION
        help
            Select the package version

        config PKG_USING_WM_LIBRARIES_V100
            bool "v1.0.0"

        config PKG_USING_WM_LIBRARIES_LATEST_VERSION
            bool "latest"
    endchoice

    config PKG_WM_LIBRARIES_VER
       string
       default "v1.0.0"    if PKG_USING_WM_LIBRARIES_V100
       default "latest"    if PKG_USING_WM_LIBRARIES_LATEST_VERSION

endif
```

## peripherals/x9555/Kconfig
```kconfig
# Kconfig file for package x9555
menuconfig PKG_USING_X9555
    bool "x9555: I/O expander with interrupt, weak pull-up & config registers"
    default n
    help
       enable : using x9555 pkgs.
       disable: donot using x9555 pkgs.

if PKG_USING_X9555

    config PKG_X9555_PATH
        string
        default "/packages/peripherals/x9555"

    menuconfig PKG_USING_X9555_EXAMPLE
        bool "Enable X9555 example"
        default n
        help
           enable : using x9555 pkgs example.
           disable: donot using x9555 pkgs example.

        select RT_USING_PIN
        select RT_USING_I2C

    choice
        prompt "Version"
        default PKG_USING_X9555_LATEST_VERSION
        help
            Select the package version

        config PKG_USING_X9555_LATEST_VERSION
            bool "latest"

    endchoice

    config PKG_X9555_VER
       string
       default "latest"    if PKG_USING_X9555_LATEST_VERSION

endif
```

## security/Kconfig
```kconfig
menu "security packages"

source "$PKGS_DIR/packages/security/mbedtls/Kconfig"
source "$PKGS_DIR/packages/security/libsodium/Kconfig"
source "$PKGS_DIR/packages/security/libhydrogen/Kconfig"
source "$PKGS_DIR/packages/security/tinycrypt/Kconfig"
source "$PKGS_DIR/packages/security/trusted-firmware-m/Kconfig"
source "$PKGS_DIR/packages/security/yd_crypto/Kconfig"

endmenu
```

## security/libhydrogen/Kconfig
```kconfig
# Kconfig file for package libhydrogen
menuconfig PKG_USING_LIBHYDROGEN
    bool "libhydrogen: A lightweight, secure, easy-to-use crypto library suitable for constrained environments."
    select RT_USING_HWCRYPTO
    select RT_HWCRYPTO_USING_RNG
    select RT_USING_LIBC if RT_VER_NUM < 0x40100
    default n

if PKG_USING_LIBHYDROGEN

    config PKG_LIBHYDROGEN_PATH
        string
        default "/packages/security/libsodium"

    menu "Examples"

        config LIBHYDROGEN_USING_EXAMPLE_RANDOM
            bool "hydrogen rng: returns unpredictable values."
            help
                hydrogen rng: returns unpredictable values.
            default n

        config LIBHYDROGEN_USING_EXAMPLE_GENERIC_HASH
            bool "hydrogen generic hash: transforms an arbitrary-long input into a fixed length fingerprint."
            help
                hydrogen generic hash: transforms an arbitrary-long input into a fixed length fingerprint.
            default n

    endmenu

    choice
        prompt "Version"
        default PKG_USING_LIBHYDROGEN_LATEST_VERSION
        help
            Select the package version

        config PKG_USING_LIBHYDROGEN_LATEST_VERSION
            bool "latest"
    endchoice

    config PKG_LIBHYDROGEN_VER
       string
       default "latest"    if PKG_USING_LIBHYDROGEN_LATEST_VERSION

endif
```
