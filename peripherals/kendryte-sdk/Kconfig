## peripherals/lora_modem_driver/Kconfig
```kconfig
# Kconfig file for package lora_modem_driver
menuconfig PKG_USING_LORA_MODEM_DRIVER
    bool "lora_modem_driver is a serial driver of lora\\lorawan modem."
    default n

if PKG_USING_LORA_MODEM_DRIVER

    config PKG_LORA_MODEM_DRIVER_PATH
        string
        default "/packages/peripherals/lora_modem_driver"

    config LORA_MODEM_UART_DEVICE
        string "Setup LoRa Modem Uart Device Name (eg:uart1,Define BSP_USING_UARTx in [Target Platform]\\Board\\Kconfig)"
        default "uart1"
        help
           Setup LoRa LoRa Modem Uart Device Name,eg:uart1,Please define BSP_USING_UARTx in the [Target Platform]\\Board\\Kconfig

    menu "Select Supported LoRaWAN Module"
        menuconfig LORA_MODEM_DRIVER_USING_LORAWAN_MODULE_LSD4WN_2L_2N_2I_SERIALS
            bool "LSD4WAN-2L\2I\2Nxx Serials [CN470\\CLAA\\ICA\\EU868\\AS923\\AU915..]"
            default n

            if LORA_MODEM_DRIVER_USING_LORAWAN_MODULE_LSD4WN_2L_2N_2I_SERIALS

                config LORA_MODEM_GPIO_SETUP
                    bool "Enable LoRa MODEM GPIO Setup"
                    default n

                    if LORA_MODEM_GPIO_SETUP
                        menu "Select Supported Target Borad"
                            menuconfig LORA_MODEM_DRIVER_USING_TRAGET_BOARD_LSD4RF_TEST2002_AND_LRS101
                                bool "LSD4RF-TEST2002 [STM32L476VG] and LRS101 M3"
                                if LORA_MODEM_DRIVER_USING_TRAGET_BOARD_LSD4RF_TEST2002_AND_LRS101 && !LORA_MODEM_DRIVER_USING_TRAGET_BOARD_ART_PI_AND_LRS007_RF_A

                                    config LORA_MODEM_UART_SETUP
                                        bool
                                        select BSP_USING_UART
                                        select BSP_USING_UART1
                                        default y

                                    config LORA_MODEM_GPIO_SETUP_BY_PIN_NAME
                                        bool "Select LoRa Modem GPIO by Pin Name"
                                        default n
                                    config LORA_MODEM_GPIO_SETUP_BY_PIN_NUMBER
                                        bool "Select LoRa Modem GPIO by Pin Number"
                                        default y

                                        if LORA_MODEM_GPIO_SETUP_BY_PIN_NAME && !LORA_MODEM_GPIO_SETUP_BY_PIN_NUMBER
                                            config LORA_MODEM_WAKE_PIN_NAME
                                                string "WAKE Pin Name"
                                                default "PE.14"
                                            config LORA_MODEM_NRST_PIN_NAME
                                                string "NRST Pin Name"
                                                default "PE.13"
                                            config LORA_MODEM_MODE_PIN_NAME
                                                string "MODE Pin Name"
                                                default "PB.11"
                                            config LORA_MODEM_BUSY_PIN_NAME
                                                string "BUSY Pin Name"
                                                default "PB.10"
                                            config LORA_MODEM_STAT_PIN_NAME
                                                string "STAT Pin Name"
                                                default "PE.15"
                                        endif

                                        if LORA_MODEM_GPIO_SETUP_BY_PIN_NUMBER && !LORA_MODEM_GPIO_SETUP_BY_PIN_NAME
                                            config LORA_MODEM_WAKE_PIN
                                                int "WAKE Pin number"
                                                range 0 127
                                                default 78
                                            config LORA_MODEM_NRST_PIN
                                                int "NRST Pin number"
                                                range 0 127
                                                default 77
                                            config LORA_MODEM_MODE_PIN
                                                int "MODE Pin number"
                                                range 0 127
                                                default 27
                                             config LORA_MODEM_BUSY_PIN
                                                int "BUSY Pin number"
                                                range 0 127
                                                default 26
                                             config LORA_MODEM_STAT_PIN
                                                int "STAT Pin number"
                                                range 0 127
                                                default 79
                                        endif
                                endif


                                menuconfig LORA_MODEM_DRIVER_USING_TRAGET_BOARD_ART_PI_AND_LRS007_RF_A
                                    bool "APR-Pi [STM32H750XB] and LRS007 RF_A CON3"

                                    if LORA_MODEM_DRIVER_USING_TRAGET_BOARD_ART_PI_AND_LRS007_RF_A && !LORA_MODEM_DRIVER_USING_TRAGET_BOARD_LSD4RF_TEST2002

                                        config LORA_MODEM_UART_SETUP
                                            bool
                                            select BSP_USING_UART
                                            select BSP_USING_UART1
                                            default y

                                            config LORA_MODEM_GPIO_SETUP_BY_PIN_NAME
                                                bool "Select LoRa Chip GPIO by Pin Name"
                                                default n
                                            config LORA_MODEM_GPIO_SETUP_BY_PIN_NUMBER
                                                bool "Select LoRa Chip GPIO by Pin Number"
                                                default y

                                                if LORA_MODEM_GPIO_SETUP_BY_PIN_NAME && !LORA_MODEM_GPIO_SETUP_BY_PIN_NUMBER
                                                    config LORA_MODEM_WAKE_PIN_NAME
                                                        string "WAKE Pin Name"
                                                        default "PH.14"
                                                    config LORA_MODEM_NRST_PIN_NAME
                                                        string "NRST Pin Name"
                                                        default "PA.15"
                                                    config LORA_MODEM_MODE_PIN_NAME
                                                        string "MODE Pin Name"
                                                        default "PA.8"
                                                    config LORA_MODEM_STAT_PIN_NAME
                                                        string "STAT Pin Name"
                                                        default "PH.13"
                                                    config LORA_MODEM_BUSY_PIN_NAME
                                                        string "BUSY Pin Name"
                                                        default "PH.15"
                                                endif

                                                if LORA_MODEM_GPIO_SETUP_BY_PIN_NUMBER && !LORA_MODEM_GPIO_SETUP_BY_PIN_NAME
                                                    config LORA_MODEM_WAKE_PIN
                                                        int "WAKE Pin number"
                                                        range 0 175
                                                        default 126
                                                    config LORA_MODEM_NRST_PIN
                                                        int "NRST Pin number"
                                                        range 0 175
                                                        default 15
                                                    config LORA_MODEM_MODE_PIN
                                                        int "MODE Pin number"
                                                        range 0 175
                                                        default 8
                                                     config LORA_MODEM_STAT_PIN
                                                        int "STAT Pin number"
                                                        range 0 175
                                                        default 125
                                                     config LORA_MODEM_BUSY_PIN
                                                        int "BUSY Pin number"
                                                        range 0 175
                                                        default 127
                                                endif
                                    endif
                        endmenu
                    endif
            endif
    endmenu


    config LORA_MODEM_DRIVER_USING_LORA_MODEM_DEBUG
         bool "Enable LoRa Modem Debug"
         default n

         if LORA_MODEM_DRIVER_USING_LORA_MODEM_DEBUG

            config LWM_DBG_CORE_CONFIG
                bool "Enable LoRa Modem Core Debug"
                default n
            config LWM_DBG_CORE
                int
                default 1 if LWM_DBG_CORE_CONFIG

            config LWM_DBG_DATA_HEX_DUMP_CONFIG
                bool "Enable LoRa Modem Data Hex Dump Debug"
                default n
            config LWM_DBG_DATA_HEX_DUMP
                int
                default 1 if LWM_DBG_DATA_HEX_DUMP_CONFIG
        endif

    config LORA_MODEM_DRIVER_USING_SAMPLES
         bool "Enable LoRa Modem Examples"
         default n
         if LORA_MODEM_DRIVER_USING_SAMPLES
             config LORA_MODEM_DRIVER_USING_SAMPLE_LORAWAN_CLASS_A
                bool "Use LoRaWAN Class A"
                default n
         endif

    choice
        prompt "Version"
        default PKG_USING_LORA_MODEM_DRIVER_LATEST_VERSION
        help
            Select the package version

        config PKG_USING_LORA_MODEM_DRIVER_V050
            bool "v0.5.0"

        config PKG_USING_LORA_MODEM_DRIVER_LATEST_VERSION
            bool "latest"
    endchoice

    config PKG_LORA_MODEM_DRIVER_VER
       string
       default "v0.5.0"    if PKG_USING_LORA_MODEM_DRIVER_V050
       default "latest"    if PKG_USING_LORA_MODEM_DRIVER_LATEST_VERSION


endif
```

## peripherals/lrf-nv7lidar/Kconfig
```kconfig
# Kconfig file for package lrf-nv7lidar
menuconfig PKG_USING_LRF_NV7LIDAR
    bool "LRF-NV7 laser ranging module"
    default n

if PKG_USING_LRF_NV7LIDAR

    config PKG_LRF_NV7LIDAR_PATH
        string
        default "/packages/peripherals/lrf-nv7lidar"

    config NV7LIDAR_UART_NAME
        string "uart name"
        default "uart3"

    config PKG_USING_NV7LIDAR_SAMPLE
        bool "Enable nv7lidar sample"
        default n

    choice
        prompt "Version"
        default PKG_USING_LRF_NV7LIDAR_LATEST_VERSION
        help
            Select the package version

        config PKG_USING_LRF_NV7LIDAR_LATEST_VERSION
            bool "latest"
    endchoice

    config PKG_LRF_NV7LIDAR_VER
       string
       default "latest"    if PKG_USING_LRF_NV7LIDAR_LATEST_VERSION

endif
```

## peripherals/ly68l6400/Kconfig
```kconfig
# Kconfig file for package ly68l6400
menuconfig PKG_USING_LY68L6400
    bool "ly68l6400:a device drive and frame for ly68l6400"
    default n

if PKG_USING_LY68L6400

    config PKG_LY68L6400_PATH
        string
        default "/packages/peripherals/ly68l6400"

    config PKG_LY68L6400_SPI_BUS_NAME
        string "Set spi bus name"
        default "spi1"

    config BSP_LY68L6400_DEVICE_NAME
        string "device name"
        default "spisram"

    config PKG_LY68L6400_USING_EXAMPLE
        bool "enable ly68l6400 test example"
        default n

    choice
        prompt "Version"
        default PKG_USING_LY68L6400_LATEST_VERSION
        help
            Select the package version

        config PKG_USING_LY68L6400_LATEST_VERSION
            bool "latest"
    endchoice

    config PKG_LY68L6400_VER
       string
       default "v1.0.0"    if PKG_USING_LY68L6400_V100
       default "latest"    if PKG_USING_LY68L6400_LATEST_VERSION

endif
```

## peripherals/max17048/Kconfig
```kconfig
# Kconfig file for package max17048
menuconfig PKG_USING_MAX17048
    bool "MAX17048: Bat monitor"
    default n

if PKG_USING_MAX17048

    config PKG_MAX17048_PATH
        string
        default "/packages/peripherals/max17048"

    choice
        prompt "Version"
        default PKG_USING_MAX17048_LATEST_VERSION
        help
            Select the package version

        config PKG_USING_MAX17048_LATEST_VERSION
            bool "latest"
    endchoice
          
    config PKG_MAX17048_VER
       string
       default "latest"    if PKG_USING_MAX17048_LATEST_VERSION

endif
```

## peripherals/max7219/Kconfig
```kconfig
# Kconfig file for package max7219
menuconfig PKG_USING_MAX7219
    bool "MAX7219: for the digital tube"
    select RT_USING_PIN
    select RT_USING_SPI
    default n

if PKG_USING_MAX7219

    config PKG_MAX7219_CHIPS_NUMBER
            int "the chips of digital tubes"
            default 1

    config PKG_MAX7219_SPI_BUS_NAME
            string "spi bus name"
            default "spi1"

    config PKG_MAX7219_SPI_DEVICE_NAME
            string "spi device name"
            default "spi10"

    config PKG_MAX7219_PATH
        string
        default "/packages/peripherals/max7219"

    choice
        prompt "Version"
        default PKG_USING_MAX7219_V100
        help
            Select the package version

        config PKG_USING_MAX7219_V100
            bool "v1.0.0"

        config PKG_USING_MAX7219_LATEST_VERSION
            bool "latest"
    endchoice

    config PKG_MAX7219_VER
       string
       default "v1.0.0"    if PKG_USING_MAX7219_V100
       default "latest"    if PKG_USING_MAX7219_LATEST_VERSION

endif
```

## peripherals/mb85rs16/Kconfig
```kconfig
# Kconfig file for package mb85rs16
menuconfig PKG_USING_MB85RS16
    bool "mb85rs16: 16K(2K x 8)Bit SPI FRAM Driver"
    default n

if PKG_USING_MB85RS16

    config PKG_MB85RS16_PATH
        string
        default "/packages/peripherals/mb85rs16"

    config PKG_USING_MB85RS16_SAMPLE
        bool "Enable mb85rs16 sample"
        default n

    choice
        prompt "Version"
        default PKG_USING_MB85RS16_LATEST_VERSION
        help
            Select the package version

        config PKG_USING_MB85RS16_V100
            bool "v1.0.0"

        config PKG_USING_MB85RS16_LATEST_VERSION
            bool "latest"
    endchoice

    config PKG_MB85RS16_VER
       string
       default "v1.0.0"    if PKG_USING_MB85RS16_V100
       default "latest"    if PKG_USING_MB85RS16_LATEST_VERSION

endif
```
