## language/micropython/Kconfig
```kconfig
menuconfig PKG_USING_MICROPYTHON
    bool "MicroPython: A lean and efficient Python implementation for microcontrollers and constrained systems."
    select RT_USING_LIBC
    select RT_USING_RTC
    default n

if PKG_USING_MICROPYTHON

    config PKG_MICROPYTHON_PATH
        string
        default "/packages/language/micropython"

    menu "Hardware Module"
        config MICROPYTHON_USING_MACHINE_I2C
            bool "machine i2c: enable i2c functions for machine module"
            select RT_USING_I2C
            default n

        config MICROPYTHON_USING_MACHINE_SPI
            bool "machine spi: enable spi functions for machine module"
            select RT_USING_SPI
            default n

        config MICROPYTHON_USING_MACHINE_UART
            bool "machine uart: enable uart functions for machine module"
            select RT_USING_SERIAL
            default n

        config MICROPYTHON_USING_MACHINE_RTC
            bool "machine rtc: enable rtc functions for machine module"
            select RT_USING_RTC
            default n

        config MICROPYTHON_USING_MACHINE_PWM
            bool "machine pwm: enable pwm functions for machine module"
            select RT_USING_PWM
            default n

        config MICROPYTHON_USING_MACHINE_ADC
            bool "machine adc: enable adc functions for machine module"
            select RT_USING_ADC
            default n
            
        config MICROPYTHON_USING_MACHINE_WDT
            bool "machine watchdog: enable watchdog functions for machine module"
            select RT_USING_WDT
            default n
       
        config MICROPYTHON_USING_MACHINE_TIMER
            bool "machine timer: enable timer functions for machine module"
            select RT_USING_HWTIMER
            default n

        config MICROPYTHON_USING_NETWORK
            bool "network: network drivers and routing configuration"
            default n

        if MICROPYTHON_USING_NETWORK
            config MICROPYTHON_USING_WLAN
            bool "network.WLAN: network WLAN framework configuration"
            default n
        endif

        config MICROPYTHON_USING_MACHINE_LCD
            bool "machine LCD: enable LCD functions for machine module"
            select BSP_USING_LCD
            select MICROPYTHON_USING_UOS
            default n
    endmenu

    menu "System Module"
        config MICROPYTHON_USING_UOS
            bool "uos: basic 'operating system' services"
            select RT_USING_DFS
            default n

        if MICROPYTHON_USING_UOS
            config MICROPYTHON_USING_FILE_SYNC_VIA_IDE
                bool "filesync: sync files through MicroPython IDE"
                default y
        endif

        config MICROPYTHON_USING_THREAD
            bool "_thread: multithreading support"
            default n

        config MICROPYTHON_USING_USELECT
            bool "uselect: wait for events on a set of streams"
            default n

        config MICROPYTHON_USING_UCTYPES
            bool "uctypes: create and manipulate C data types in Python"
            default n

        config MICROPYTHON_USING_UERRNO
            bool "uerrno: system error codes"
            default n

        if PKG_MICROPYTHON_VER_NUM > 0x11000
            config MICROPYTHON_USING_FFI
                bool "ffi: foreign function interface for native program"
                select RT_USING_MODULE
                default n
        endif
    endmenu

    menu "Tools Module"
        config MICROPYTHON_USING_CMATH
            bool "cmath: mathematical functions for complex numbers"
            default n

        config MICROPYTHON_USING_UBINASCII
            bool "ubinascii: binary/ASCII conversions"
            default n

        config MICROPYTHON_USING_UHASHLIB
            bool "uhashlib: hashing algorithms"
            default n

        config MICROPYTHON_USING_UHEAPQ
            bool "uheapq: heap queue algorithm"
            default n

        config MICROPYTHON_USING_UJSON
            bool "ujson: JSON encoding and decoding"
            select MICROPYTHON_USING_UOS
            default n

        config MICROPYTHON_USING_URE
            bool "ure: simple regular expressions"
            default n

        config MICROPYTHON_USING_UZLIB
            bool "uzlib: zlib decompression"
            default n

        config MICROPYTHON_USING_URANDOM
            bool "urandom: random variable generators"
            default n
    endmenu

    menu "Network Module"
        config MICROPYTHON_USING_USOCKET
            bool "usocket: socket operations and some related functions"
            select RT_USING_SAL
            select SAL_USING_POSIX
            select RT_LWIP_IGMP
            default n

        config MICROPYTHON_USING_USSL
            bool "ussl: secure sockets layer for https protocol"
            select PKG_USING_MBEDTLS
            default n
    endmenu

    config PKG_MICROPYTHON_HEAP_SIZE
        int
        prompt "Heap size for python run environment"
        default 8192

    choice
        prompt "Version"
        help
            Select the this package version

        config PKG_USING_MICROPYTHON_V11004
            bool "v1.10.4"

        config PKG_USING_MICROPYTHON_V11003
            bool "v1.10.3"

        config PKG_USING_MICROPYTHON_V11002
            bool "v1.10.2"

        config PKG_USING_MICROPYTHON_V11001
            bool "v1.10.1"

        config PKG_USING_MICROPYTHON_V11000
            bool "v1.10"

        config PKG_USING_MICROPYTHON_V10903
            bool "v1.9.3"

        config PKG_USING_MICROPYTHON_LATEST_VERSION
            bool "latest"
    endchoice

    config PKG_MICROPYTHON_VER
        string
        default "v1.10.4"  if PKG_USING_MICROPYTHON_V11004
        default "v1.10.3"  if PKG_USING_MICROPYTHON_V11003
        default "v1.10.2"  if PKG_USING_MICROPYTHON_V11002
        default "v1.10.1"  if PKG_USING_MICROPYTHON_V11001
        default "v1.10"    if PKG_USING_MICROPYTHON_V11000
        default "v1.9.3"   if PKG_USING_MICROPYTHON_V10903
        default "latest"   if PKG_USING_MICROPYTHON_LATEST_VERSION

    config PKG_MICROPYTHON_VER_NUM
        hex
        default 0x99999    if PKG_USING_MICROPYTHON_LATEST_VERSION
        default 0x11004    if PKG_USING_MICROPYTHON_V11004
        default 0x11003    if PKG_USING_MICROPYTHON_V11003
        default 0x11002    if PKG_USING_MICROPYTHON_V11002
        default 0x11001    if PKG_USING_MICROPYTHON_V11001
        default 0x11000    if PKG_USING_MICROPYTHON_V11000
        default 0x10903    if PKG_USING_MICROPYTHON_V10903

endif
```

## language/pikascript/Kconfig
```kconfig
menuconfig PKG_USING_PIKASCRIPT
    bool "PikaScript : ultra-lightweight python engine"
    select PKG_USING_RT_VSNPRINTF_FULL if RT_VER_NUM < 0x50200
    select RT_KLIBC_USING_VSNPRINTF_STANDARD if RT_VER_NUM >= 0x50200
    default n

if PKG_USING_PIKASCRIPT

    config PKG_PIKASCRIPT_PATH
        string
        default "/packages/language/pikascript"

    config PKG_PIKASCRIPT_USING_AUTORUNNING
        bool "Enable auto-running PikaScript"
        default n

        if PKG_PIKASCRIPT_USING_AUTORUNNING
            config PKG_PIKASCRIPT_STACK_SIZE
                int "PikaScript thread's size"
                default 4096

            config PKG_PIKASCRIPT_STACK_PRIO
                int "PikaScript thread's priority"
                default 20
        endif

    choice
        prompt "Version"
        default PKG_USING_PIKASCRIPT_LATEST_VERSION
        help
            Select the package version

        config PKG_USING_PIKASCRIPT_LATEST_VERSION
            bool "latest"

    endchoice

    config PKG_PIKASCRIPT_VER
       string
       default "latest"    if PKG_USING_PIKASCRIPT_LATEST_VERSION

endif
```

## language/rtt_rust/Kconfig
```kconfig
# Kconfig file for package rtt_rust
menuconfig PKG_USING_RTT_RUST
    bool "Rust support for rt-thread."
    default n

if PKG_USING_RTT_RUST

    config PKG_RTT_RUST_PATH
        string
        default "/packages/language/rtt_rust"

    choice
        prompt "Version"
        default PKG_USING_RTT_RUST_LATEST_VERSION
        help
            Select the package version

        config PKG_USING_RTT_RUST_V010
            bool "v0.1.0"

        config PKG_USING_RTT_RUST_LATEST_VERSION
            bool "latest"
    endchoice

    config PKG_RTT_RUST_VER
       string
       default "v0.1.0"    if PKG_USING_RTT_RUST_V010
       default "latest"    if PKG_USING_RTT_RUST_LATEST_VERSION

endif
```

## misc/CanFestival/Kconfig
```kconfig
# Kconfig file for package CanFestival
menuconfig PKG_USING_CANFESTIVAL
    bool "CanFestival: A free software CANopen framework"
    select RT_USING_CAN
    select RT_USING_HWTIMER
    default n
    help
        CanFestival focuses on providing an ANSI-C platform independent
        CANOpen® stack that can be built as master or slave nodes on
        PCs, Real-time IPCs, and Microcontrollers.

if PKG_USING_CANFESTIVAL

    config CANFESTIVAL_CAN_DEVICE_NAME
        string "CAN device name for CanFestival"
        default "bxcan1"

    config CANFESTIVAL_TIMER_DEVICE_NAME
        string "hwtimer device name for CanFestival"
        default "timer0"

    config CANFESTIVAL_RECV_THREAD_PRIO
        int "The priority level value of can receive thread"
        default 9

    config CANFESTIVAL_TIMER_THREAD_PRIO
        int "The priority level value of timer thread"
        default 10

    config CANFESTIVAL_USING_EG_MASTER402
        bool "Enable Cia402 Master example"
        default n

    config PKG_CANFESTIVAL_PATH
        string
        default "/packages/misc/CanFestival"

    choice
        prompt "version"
        help
            Select the CanFestival version

        config PKG_USING_CANFESTIVAL_V100
            bool "v1.0.0"

        config PKG_USING_CANFESTIVAL_LATEST_VERSION
            bool "latest"
    endchoice

    if PKG_USING_CANFESTIVAL_V100
        config PKG_CANFESTIVAL_VER
        string
        default "v1.0.0"
    endif

    if PKG_USING_CANFESTIVAL_LATEST_VERSION
       config PKG_CANFESTIVAL_VER
       string
       default "latest"
    endif

endif
```

## misc/Controller/Kconfig
```kconfig
# Kconfig file for package Controller
menuconfig PKG_USING_CONTROLLER
    bool "Controller: PI, PR and RC controller library"
    default n
    help
        controller is a digital control algorithm implementation of PI, PR and RC algorithms.

if PKG_USING_CONTROLLER

    config PKG_CONTROLLER_PATH
        string
        default "/packages/misc/Controller"

    choice
        prompt "Version"
        default PKG_USING_CONTROLLER_LATEST_VERSION
        help
            Select the Controller version

        config PKG_USING_CONTROLLER_LATEST_VERSION
            bool "latest"

        config PKG_USING_CONTROLLER_V1_0_0
            bool "v1.0.0"
    endchoice

    config PKG_CONTROLLER_VER
        string
        default "latest" if PKG_USING_CONTROLLER_LATEST_VERSION
        default "v1.0.0" if PKG_USING_CONTROLLER_V1_0_0
endif
```

## misc/CorevMCU_CLI/Kconfig
```kconfig
# Kconfig file for package CorevMCU_CLI
menuconfig PKG_USING_CorevMCU_CLI
    bool "CorevMCU_CLI: CLI components of Core-V-MCU."
    default n
    select PKG_USING_FREERTOS_WRAPPER

if PKG_USING_CorevMCU_CLI

    config PKG_COREVMCU_CLI_PATH
        string
        default "/packages/misc/CorevMCU_CLI"

    choice
        prompt "Version"
        default PKG_USING_COREVMCU_CLI_LATEST_VERSION
        help
            Select the package version

        config PKG_USING_COREVMCU_CLI_LATEST_VERSION
            bool "latest"
    endchoice

    config PKG_COREVMCU_CLI_VER
       string
       default "latest"    if PKG_USING_COREVMCU_CLI_LATEST_VERSION

endif
```

## misc/FlexibleButton/Kconfig
```kconfig
menuconfig PKG_USING_FLEXIBLE_BUTTON
    bool "FlexibleButton: Small and flexible button driver"
    default n

if PKG_USING_FLEXIBLE_BUTTON

    config PKG_FLEXIBLE_BUTTON_PATH
        string
        default "/packages/misc/FlexibleButton"

    config PKG_USING_FLEXIBLE_BUTTON_DEMO
        bool "Enable flexible button demo"
        default n

    choice
        prompt "version"
        help
            Select the package version
        default PKG_USING_FLEXIBLE_BUTTON_V100

        config PKG_USING_FLEXIBLE_BUTTON_V100
            bool "v1.0.0"

        config PKG_USING_FLEXIBLE_BUTTON_LATEST
            bool "latest"
    endchoice

    config PKG_FLEXIBLE_BUTTON_VER
       string
       default "v1.0.0"    if PKG_USING_FLEXIBLE_BUTTON_V100
       default "latest"    if PKG_USING_FLEXIBLE_BUTTON_LATEST

endif
```

## misc/Kconfig
```kconfig
menu "miscellaneous packages"

source "$PKGS_DIR/packages/misc/projects/Kconfig"
source "$PKGS_DIR/packages/misc/samples/Kconfig"
source "$PKGS_DIR/packages/misc/entertainment/Kconfig"
source "$PKGS_DIR/packages/misc/libcsv/Kconfig"
source "$PKGS_DIR/packages/misc/optparse/Kconfig"
source "$PKGS_DIR/packages/misc/fastlz/Kconfig"
source "$PKGS_DIR/packages/misc/miniLZO/Kconfig"
source "$PKGS_DIR/packages/misc/quicklz/Kconfig"
source "$PKGS_DIR/packages/misc/lzma/Kconfig"
source "$PKGS_DIR/packages/misc/ralarm/Kconfig"
source "$PKGS_DIR/packages/misc/MultiButton/Kconfig"
source "$PKGS_DIR/packages/misc/FlexibleButton/Kconfig"
source "$PKGS_DIR/packages/misc/CanFestival/Kconfig"
source "$PKGS_DIR/packages/misc/zlib/Kconfig"
source "$PKGS_DIR/packages/misc/minizip/Kconfig"
source "$PKGS_DIR/packages/misc/heatshrink/Kconfig"
source "$PKGS_DIR/packages/misc/dstr/Kconfig"
source "$PKGS_DIR/packages/misc/TinyFrame/Kconfig"
source "$PKGS_DIR/packages/misc/kendryte-demo/Kconfig"
source "$PKGS_DIR/packages/misc/upacker/Kconfig"
source "$PKGS_DIR/packages/misc/uparam/Kconfig"
source "$PKGS_DIR/packages/misc/hello/Kconfig"
source "$PKGS_DIR/packages/misc/vi/Kconfig"
source "$PKGS_DIR/packages/misc/ki/Kconfig"
source "$PKGS_DIR/packages/misc/armv7m_dwt/Kconfig"
source "$PKGS_DIR/packages/misc/crclib/Kconfig"
source "$PKGS_DIR/packages/misc/libcrc/Kconfig"
source "$PKGS_DIR/packages/misc/lwgps/Kconfig"
source "$PKGS_DIR/packages/misc/state_machine/Kconfig"
source "$PKGS_DIR/packages/misc/design_pattern/Kconfig"
source "$PKGS_DIR/packages/misc/Controller/Kconfig"
source "$PKGS_DIR/packages/misc/phase-locked-loop/Kconfig"
source "$PKGS_DIR/packages/misc/MFBD/Kconfig"
source "$PKGS_DIR/packages/misc/slcan2rtt/Kconfig"
source "$PKGS_DIR/packages/misc/soem/Kconfig"
source "$PKGS_DIR/packages/misc/qparam/Kconfig"
source "$PKGS_DIR/packages/misc/CorevMCU_CLI/Kconfig"
source "$PKGS_DIR/packages/misc/get_irq_priority/Kconfig"
source "$PKGS_DIR/packages/misc/drmp/Kconfig"
endmenu
```
