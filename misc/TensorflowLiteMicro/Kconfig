## misc/TensorflowLiteMicro/Kconfig
```kconfig
# Kconfig file for package TensorflowLiteMicro
menuconfig PKG_USING_TENSORFLOWLITEMICRO
    bool "Tensorflow Lite Micro: a lightweight deep learning end-test inference framework for RT-Thread operating system ."
    select RT_USING_CPLUSPLUS
    default n

if PKG_USING_TENSORFLOWLITEMICRO

    config PKG_TENSORFLOWLITEMICRO_PATH
        string
        default "/packages/misc/TensorflowLiteMicro"

    choice
        prompt "Version"
        default PKG_USING_TENSORFLOWLITEMICRO_LATEST_VERSION
        help
            Select the package version

        config PKG_USING_TENSORFLOWLITEMICRO_V100
            bool "v1.0.0"

        config PKG_USING_TENSORFLOWLITEMICRO_LATEST_VERSION
            bool "latest"
    endchoice
    
    choice
        prompt "Select Offical Example"

        config PKG_USING_TENSORFLOWLITEMICRO_AUDIO_EXAMPLE
            bool "Enable Tensorflow Lite Micro audio example"
            default n

        config PKG_USING_TENSORFLOWLITEMICRO_NO_EXAMPLE
            bool "No Tensorflow Lite Micro Example"
            default y
    endchoice

    config PKG_TENSORFLOWLITEMICRO_VER
       string
       default "v1.0.0"    if PKG_USING_TENSORFLOWLITEMICRO_V100
       default "latest"    if PKG_USING_TENSORFLOWLITEMICRO_LATEST_VERSION

endif
```

## misc/TinyFrame/Kconfig
```kconfig
# Kconfig file for package TinyFrame
menuconfig PKG_USING_TINYFRAME
    bool "TinyFrame: Serial communication protocol."
    default n

if PKG_USING_TINYFRAME

menu "TinyFrame Options"

    config PKG_TINYFRAME_USE_UART1
        bool
        prompt "Enable usart1"
        default n
    config PKG_TINYFRAME_USE_UART2
        bool
        prompt "Enable usart2"
        default n
    config PKG_TINYFRAME_USE_UART3
        bool
        prompt "Enable usart3"
        default n
    config PKG_TINYFRAME_UART_NAME_MAX_LEN
        int
        prompt "Uart name max len"
        default 10
    config PKG_TINYFRAME_USE_EXAMPLE
        bool
        prompt "example"
        default n

endmenu



    config PKG_TINYFRAME_PATH
        string
        default "/packages/misc/TinyFrame"

    choice
        prompt "Version"
        default PKG_USING_TINYFRAME_LATEST_VERSION
        help
            Select the package version

        config PKG_USING_TINYFRAME_V100
            bool "v1.0.0"

        config PKG_USING_TINYFRAME_LATEST_VERSION
            bool "latest"
    endchoice
          
    config PKG_TINYFRAME_VER
       string
       default "v1.0.0"    if PKG_USING_TINYFRAME_V100
       default "latest"    if PKG_USING_TINYFRAME_LATEST_VERSION

endif
```

## misc/armv7m_dwt/Kconfig
```kconfig
# Kconfig file for package armv7m_dwt
menuconfig PKG_USING_ARMv7M_DWT
    bool "armv7m_dwt: High precision timing and delay"
    default n

if PKG_USING_ARMv7M_DWT

    config PKG_ARMv7M_DWT_PATH
        string
        default "/packages/misc/armv7m_dwt"

    choice
        prompt "Version"
        default PKG_USING_ARMv7M_DWT_LATEST_VERSION
        help
            Select this package version
            
        config PKG_USING_ARMv7M_DWT_LATEST_VERSION
            bool "latest"
            
        config PKG_USING_ARMv7M_DWT_V010
            bool "v0.1.0"

    endchoice

    config PKG_ARMv7M_DWT_VER
        string
        default "latest"        if PKG_USING_ARMv7M_DWT_LATEST_VERSION
        default "v0.1.0"        if PKG_USING_ARMv7M_DWT_V010

endif
```

## misc/cowsay/Kconfig
```kconfig
# Kconfig file for package cowsay
menuconfig PKG_USING_COWSAY
    bool "cowsay: greeting from console"
    default n

if PKG_USING_COWSAY

    config PKG_COWSAY_PATH
        string
        default "/packages/misc/cowsay"

    choice
        prompt "Version"
        default PKG_USING_COWSAY_LATEST_VERSION
        help
            Select the package version

        config PKG_USING_COWSAY_LATEST_VERSION
            bool "latest"
    endchoice
          
    config PKG_COWSAY_VER
       string
       default "latest"    if PKG_USING_COWSAY_LATEST_VERSION

endif
```

## misc/crclib/Kconfig
```kconfig
# Kconfig file for package crclib

menuconfig PKG_USING_CRCLIB
    bool "crclib : A library of functions with 8-bit ,16-bit ,32-bit crc check calculations."
    default n

if PKG_USING_CRCLIB

    config PKG_CRCLIB_PATH
        string
        default "/packages/misc/crclib"

    config CRCLIB_USING_CRC8
        bool "using 8 bit crc"
        default y

    if CRCLIB_USING_CRC8
        config CRC8_USING_CONST_TABLE
            bool "using const table"
            default y

        choice
            prompt "crc8 polynome"
            default CRC8_POLY_8C
            help
                Select crc8 polynome
            config CRC8_POLY_8C
                bool "x8+x5+x4+1"
            config CRC8_POLY_D9
                bool "x8+x7+x4+x3+x+1"
            config CRC8_POLY_CUSTOM
                bool "custom value"
        endchoice

        if CRC8_POLY_CUSTOM
            config CRC8_POLY_CUSTOM_STRING
                int "crc8 polynome value (int)"
                default 0
        endif

        config CRC8_POLY
            int
            default 140 if CRC8_POLY_8C
            default 217 if CRC8_POLY_D9
            default CRC8_POLY_CUSTOM_STRING if CRC8_POLY_CUSTOM
    endif

    config CRCLIB_USING_CRC16
        bool "using 16 bit crc"
        default y

    if CRCLIB_USING_CRC16
        config CRC16_USING_CONST_TABLE
            bool "using const table"
            default y

        choice
            prompt "crc16 polynome"
            default CRC16_POLY_A001
            help
                Select crc16 polynome
            config CRC16_POLY_A001
                bool "x16+x15+x2+1 (MODBUS,IBM,SDLC)"
            config CRC16_POLY_8404
                bool "x16+x12+x5+1 (CCITT,ISO,HDLC,ITUX25,PPP-FCS)"
            config CRC16_POLY_CUSTOM
                bool "custom value"
        endchoice

        if CRC16_POLY_CUSTOM
            config CRC16_POLY_CUSTOM_STRING
                int "crc16 polynome value (int)"
                default 0
        endif

        config CRC16_POLY
            int
            default 40961 if CRC16_POLY_A001
            default 33800 if CRC16_POLY_8404
            default CRC16_POLY_CUSTOM_STRING if CRC16_POLY_CUSTOM
    endif

    config CRCLIB_USING_CRC32
        bool "using 32 bit crc"
        default y

    if CRCLIB_USING_CRC32
        config CRC32_USING_CONST_TABLE
            bool "using const table"
            default y

        choice
            prompt "crc32 polynome"
            default CRC32_POLY_EDB88320
            help
                Select crc32 polynome
            config CRC32_POLY_EDB88320
                bool "x32+x26+x23+...+x2+x+1 (ZIP,RAR,IEEE,LAN/FDDI,PPP-FCS)"
            config CRC32_POLY_82F63B78
                bool "x32+x28+x27+...+x8+x6+1 (SCTP)"
            config CRC32_POLY_CUSTOM
                bool "custom value"
        endchoice

        if CRC32_POLY_CUSTOM
            config CRC32_POLY_CUSTOM_STRING
                int "crc32 polynome value (int)"
                default 0
        endif

        config CRC32_POLY
            int
            default 3988292384 if CRC32_POLY_EDB88320
            default 2197175160 if CRC32_POLY_82F63B78
            default CRC32_POLY_CUSTOM_STRING if CRC32_POLY_CUSTOM
    endif

    config CRCLIB_USING_CRC8_EX
        bool "using 8 bit crc expand"
        default n

    config CRCLIB_USING_CRC16_EX
        bool "using 16 bit crc expand"
        default n

    config CRCLIB_USING_CRC32_EX
        bool "using 32 bit crc expand"
        default n

    config CRCLIB_USING_CRC16_EX_SAMPLE
        bool "using 16 bit crc expand sample"
        default n

    config CRCLIB_USING_CRC_HW
        bool "using hardware crc"
        default n

    config CRCLIB_USING_CRC_HW_SAMPLE
        bool "using hardware crc sample"
        default n

    choice
        prompt "Version"
        default PKG_USING_CRCLIB_V102
        help
            Select the package version
        config PKG_USING_CRCLIB_LATEST_VERSION
            bool "latest"
        config PKG_USING_CRCLIB_V102
            bool "v1.02"
        config PKG_USING_CRCLIB_V101
            bool "v1.01"
        config PKG_USING_CRCLIB_V100
            bool "v1.00"
    endchoice

    config PKG_CRCLIB_VER
       string
       default "latest" if PKG_USING_CRCLIB_LATEST_VERSION
       default "v1.02"  if PKG_USING_CRCLIB_V102
       default "v1.01"  if PKG_USING_CRCLIB_V101
       default "v1.00"  if PKG_USING_CRCLIB_V100

endif
```

## misc/design_pattern/Kconfig
```kconfig
# Kconfig file for package design_pattern
menuconfig PKG_USING_DESIGN_PATTERN
    bool "a design pattern demo package."
    default n

if PKG_USING_DESIGN_PATTERN

    config PKG_DESIGN_PATTERN_PATH
        string
        default "/packages/misc/design_pattern"

    config PKG_USING_DESIGN_PATTERN_OBSERVER
            bool "Using observer design pattern"
            default n

    choice
        prompt "Version"
        default PKG_USING_DESIGN_PATTERN_LATEST_VERSION
        help
            Select the package version

        config PKG_USING_DESIGN_PATTERN_V100
            bool "v1.0.0"

        config PKG_USING_DESIGN_PATTERN_LATEST_VERSION
            bool "latest"
    endchoice

    config PKG_DESIGN_PATTERN_VER
       string
       default "v1.0.0"    if PKG_USING_DESIGN_PATTERN_V100
       default "latest"    if PKG_USING_DESIGN_PATTERN_LATEST_VERSION

endif
```

## misc/drmp/Kconfig
```kconfig
# Kconfig file for package drmp

menuconfig PKG_USING_DRMP
    bool "A protocol stack used for remote device maintenance"
    default n

if PKG_USING_DRMP

    config PKG_DRMP_PATH
        string
        default "/packages/misc/drmp"

    config DRMP_VCOM_TOTAL
        int "vcom total (2 - 16)"
        default 2
        
    config DRMP_USING_SAMPLE
        bool "using sample"
        default n

    choice
        prompt "Version"
        default PKG_USING_DRMP_LATEST_VERSION
        help
            Select the package version

        config PKG_USING_DRMP_LATEST_VERSION
            bool "latest"

        config PKG_USING_DRMP_V100
            bool "v1.00"
    endchoice

    config PKG_DRMP_VER
       string
       default "latest" if PKG_USING_DRMP_LATEST_VERSION
       default "v1.00"  if PKG_USING_DRMP_V100

endif
```

## misc/dstr/Kconfig
```kconfig
menuconfig PKG_USING_DSTR
    bool "dstr: a dynaminc string package for rt-thread"
    default n

if PKG_USING_DSTR

    config PKG_DSTR_PATH
        string
        default "/packages/misc/dstr"

    choice
        prompt "Version"
        help
            Select this package version

        config PKG_USING_DSTR_V010
            bool "v0.1.0"

        config PKG_USING_DSTR_V020
            bool "v0.2.0"

        config PKG_USING_DSTR_LATEST_VERSION
            bool "latest"
    endchoice

    config PKG_DSTR_VER
       string
       default "v0.1.0"    if PKG_USING_DSTR_V010
       default "v0.2.0"    if PKG_USING_DSTR_V020
       default "latest"    if PKG_USING_DSTR_LATEST_VERSION

menu "dstr Options"
    config DSTR_USING_EXAMPLE
        bool
        prompt "dstr test example"
        default n
endmenu

endif
```

## misc/elapack/Kconfig
```kconfig
# Kconfig file for package elapack
menuconfig PKG_USING_ELAPACK
    select RT_USING_LIBC
    bool "elapack: linear algebra library for embedded devices, compatible with matlab."
    default n

if PKG_USING_ELAPACK

    config PKG_ELAPACK_PATH
        string
        default "/packages/misc/elapack"

    config ELAPACK_USING_LINSOLVE
        bool "Linear equation solver example"
        help
            Linear equation solver example.
        default n

    config ELAPACK_USING_EIG
        bool "Eigenvalues and eigenvectors example"
        help
            Eigenvalues and eigenvectors example
        default n

    config ELAPACK_USING_LU
        bool "LU decomposition example"
        help
            LU decomposition example
        default n

    config ELAPACK_USING_QR
        bool "QR decomposition example"
        help
            QR decomposition example
        default n

    config ELAPACK_USING_SVD
        bool "SVD decomposition example"
        help
            SVD decomposition example
        default n

    config ELAPACK_USING_MODEL_PREDICTIVE
        bool "Model predictive control example"
        help
            Model predictive control example
        default n

    config ELAPACK_USING_STATE_SPACE
        bool "State space example"
        help
            State space example
        default n

    choice
        prompt "Version"
        default PKG_USING_ELAPACK_LATEST_VERSION
        help
            Select the package version
        config PKG_USING_ELAPACK_V100
            bool "v1.0.0"
        config PKG_USING_ELAPACK_LATEST_VERSION
            bool "latest"
    endchoice

    config PKG_ELAPACK_VER
       string
       default "v1.0.0"    if PKG_USING_ELAPACK_V100
       default "latest"    if PKG_USING_ELAPACK_LATEST_VERSION

    config PKG_ELAPACK_VER_NUM
        hex
        default 0x10000 if PKG_USING_ELAPACK_V100
        default 0x99999 if PKG_USING_ELAPACK_LATEST_VERSION

endif
```

## misc/entertainment/Kconfig
```kconfig
menu "entertainment: terminal games and other interesting software packages"

rsource "cmatrix/Kconfig"
rsource "sl/Kconfig"
rsource "cal/Kconfig"
rsource "aclock/Kconfig"
rsource "threes/Kconfig"
rsource "c2048/Kconfig"
rsource "snake/Kconfig"
rsource "tetris/Kconfig"
rsource "donut/Kconfig"
rsource "cowsay/Kconfig"
rsource "morse/Kconfig"
rsource "TinySquare/Kconfig"

endmenu
```

## misc/entertainment/TinySquare/Kconfig
```kconfig
# Kconfig file for package TinySquare
menuconfig PKG_USING_TINYSQUARE
    bool "TinySquare: a lightweight square game engine running on Cortex-M."
    depends on ARCH_ARM_CORTEX_M
    select PKG_USING_CMSIS_DSP
    select PKG_CMSIS_DSP_BASIC_MATH
    select PKG_CMSIS_DSP_FAST_MATH
    select PKG_CMSIS_DSP_COMMON_TABLES
    default n

if PKG_USING_TINYSQUARE

    config PKG_TINYSQUARE_PATH
        string
        default "/packages/misc/entertainment/TinySquare"

    config TINYSQUARE_USING_PIKASCRIPT
        bool "using pikaScript lib"
        default n

    config TINYSQUARE_USING_EXAMPLES_SNAKE
        bool "using snake example"
        default n

    config TINYSQUARE_USING_EXAMPLES_TETRIS
        bool "using tetris example"
        default n

    choice
        prompt "Version"
        default PKG_USING_TINYSQUARE_LATEST_VERSION
        help
            Select the package version

        config PKG_USING_TINYSQUARE_LATEST_VERSION
            bool "latest"
    endchoice

    config PKG_TINYSQUARE_VER
       string
       default "latest"    if PKG_USING_TINYSQUARE_LATEST_VERSION

endif
```

## misc/entertainment/aclock/Kconfig
```kconfig
# Kconfig file for package aclock
menuconfig PKG_USING_ACLOCK
    bool "aclock: a terminal clock"
    default n

if PKG_USING_ACLOCK

    config PKG_ACLOCK_PATH
        string
        default "/packages/misc/entertainment/aclock"

    config PKG_ACLOCK_VER
       string
       default "latest"

endif
```

## misc/entertainment/c2048/Kconfig
```kconfig
# Kconfig file for package 2048
menuconfig PKG_USING_2048
    bool "2048: An indie puzzle video game run on RT-Thread console"
    select RT_USING_DFS         if RT_VER_NUM < 0x40100
    select RT_USING_POSIX       if RT_VER_NUM < 0x40100
    select RT_USING_LIBC        if RT_VER_NUM < 0x40100
    select RT_USING_POSIX_FS    if RT_VER_NUM >= 0x40100
    select RT_USING_POSIX_POLL  if RT_VER_NUM >= 0x40100
    select RT_USING_POSIX_TERMIOS
    default n


if PKG_USING_2048

    config PKG_2048_PATH
        string
        default "/packages/misc/entertainment/c2048"

    config PKG_2048_VER
       string
       default "latest"

endif
```
