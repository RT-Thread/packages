## peripherals/ST7789_SPI/Kconfig
```kconfig
# Kconfig file for package ST7789_SPI
menuconfig PKG_USING_ST7789_SPI
    bool "ST7789 driver package for RT-Thread using SPI interface."
    default n

if PKG_USING_ST7789_SPI
    config PKG_ST_7789_SPI_BUS_NAME
        string "spi bus name"
        default "spi0"

    config PKG_ST_7789_SPI_DEVICE_NAME
            string "spi device name"
            default "spi_lcd"

    config PKG_ST_7789_WIDTH
        int "Width of the LCD display"
        default 240

    config PKG_ST_7789_HEIGHT
        int "Height of the LCD display"
        default 320

    config PKG_ST_7789_DC_PIN
        int "DC pin connected to the LCD display"
        default 83

    config PKG_ST_7789_RES_PIN
        int "RESET pin connected to the LCD display"
        default 47

    config PKG_ST_7789_CS_PIN
        int "CS pin connected to the LCD display"
        default 5

    config PKG_ST_7789_BLK_PIN
        int "Backlight pin connected to the LCD display"
        default 93
    
    config PKG_USING_ST7789_SPI_SAMPLE
        bool "Enable st7789_spi sample"
        default n

    config PKG_ST7789_PATH
        string
        default "/packages/peripherals/ST7789"

    choice
        prompt "Version"
        default PKG_USING_ST7789_LATEST_VERSION
        help
            Select the package version

        config PKG_USING_ST7789_V100
            bool "v1.0.0"

        config PKG_USING_ST7789_LATEST_VERSION
            bool "latest"
    endchoice

    config PKG_ST7789_VER
       string
       default "v1.0.0"    if PKG_USING_ST7789_V100
       default "latest"    if PKG_USING_ST7789_LATEST_VERSION

endif
```

## peripherals/STM32F4_Drivers/Kconfig
```kconfig
menuconfig PKG_USING_STM32F4_DRIVERS
    bool "STM32F4_Drivers: RT-Thread Drivers for STM32F4 Series"
    default n

if PKG_USING_STM32F4_DRIVERS

    config PKG_STM32F4_DRIVERS_PATH
        string
        default "/packages/peripherals/STM32F4_Drivers"

    choice
        prompt "Version"
        default PKG_USING_STM32F4_DRIVERS_LATEST_VERSION
        help 
            Select this package version

        config PKG_USING_STM32F4_DRIVERS_V10000
            bool "v1.0.0"

        config PKG_USING_STM32F4_DRIVERS_LATEST_VERSION
            bool "latest"
    endchoice

    config PKG_STM32F4_DRIVERS_VER
        string
        default "v1.0.0" if PKG_USING_STM32F4_DRIVERS_V10000
        default "latest" if PKG_USING_STM32F4_DRIVERS_LATEST_VERSION

endif
```

## peripherals/STM32F4_HAL/Kconfig
```kconfig
menuconfig PKG_USING_STM32F4_HAL
    bool "STM32F4_HAL: STM32F4 HAL library"
    default n

if PKG_USING_STM32F4_HAL

    config PKG_STM32F4_HAL_PATH
        string
        default "/packages/peripherals/STM32F4_HAL"

    choice
        prompt "Version"
        default PKG_USING_STM32F4_HAL_LATEST_VERSION
        help 
            Select this package version

        config PKG_USING_STM32F4_HAL_V10702
            bool "v1.7.2"

        config PKG_USING_STM32F4_HAL_LATEST_VERSION
            bool "latest"
    endchoice

    config PKG_STM32F4_HAL_VER
        string
        default "v1.7.2" if PKG_USING_STM32F4_HAL_V10702
        default "latest" if PKG_USING_STM32F4_HAL_LATEST_VERSION

endif
```

## peripherals/ST_STM32F4_HAL/Kconfig
```kconfig
config PKG_USING_STM32F4_HAL
    bool "STM32F4_HAL: STM32F4 HAL library"
    default n

if PKG_USING_STM32F4_HAL

    config PKG_STM32F4_HAL_PATH
        string
        default "/packages/peripherals/ST_STM32F4_HAL"

    choice
        prompt "Version"
        help 
            Select this package version

        config PKG_USING_STM32F4_HAL_V10000
            bool "v1.0.0"

        config PKG_USING_STM32F4_HAL_LATEST_VERSION
            bool "latest"
    endchoice

    config PKG_STM32F4_HAL_VER
        string
        default "v1.0.0" if PKG_USING_STM32F4_HAL_V10000
        default "latest" if PKG_USING_STM32F4_HAL_LATEST_VERSION

endif
```

## peripherals/Servo_sg90/Kconfig
```kconfig
# Kconfig file for package Servo_sg90
menuconfig PKG_USING_SERVO
    bool "Servo : you can use it to control servo,such as sg90"
    default n

if PKG_USING_SERVO

    config PKG_SERVO_SG90_PATH
        string
        default "/packages/peripherals/Servo_sg90"

    menuconfig PKG_USING_SG90
        bool "Enable SG90"
        default n

        if PKG_USING_SG90
            config PKG_USING_SG90_DEMO
                bool "Enable sg90 demo"
                default n
            config PKG_USING_PWM_DEV_NAME
                string "pwm device name,example: pwm2"
                default "pwm2"
            config PKG_USING_PWM_DEV_CHANNEL
                int "the channel of PKG_USING_PWM_DEV_NAME"
                range 0 10
                default 1
            config PKG_USING_MAX_ANGLE
                int "the max pulse ns"
                range 0 999999999
                default 2500000
            config PKG_USING_MIN_ANGLE
                int "the min pulse ns"
                range 0 999999999
                default 500000
            config PKG_USING_SG90_MAX_ANGLE
                int "the max angle of your servo"
                range 0 360
                default 180
            config PKG_USING_SG90_PERIOD
                int "the period of sg90"
                range 0 999999999
                default 20000000
                
        endif


    choice
        prompt "Version"
        help
            Select the package version

        config PKG_USING_SERVO_V100
            bool "v1.0.0"

        config PKG_USING_SERVO_LATEST_VERSION
            bool "latest"
    endchoice

    config PKG_SERVO_SG90_VER
       string
       default "v1.0.0"    if PKG_USING_SERVO_V100
       default "latest"    if PKG_USING_SERVO_LATEST_VERSION

endif
```

## peripherals/SignalLed/Kconfig
```kconfig
# Kconfig file for package SignalLed
menuconfig PKG_USING_SIGNAL_LED
    bool "SignalLed:a signal led package for rt-thread"
    default n

if PKG_USING_SIGNAL_LED

    config PKG_SIGNAL_LED_PATH
        string
        default "/packages/peripherals/SignalLed"

    choice
        prompt "Version"
        default PKG_USING_SIGNAL_LED_LATEST_VERSION
        help
            Select the package version

        config PKG_USING_SIGNAL_LED_V120
            bool "v1.2.0"

        config PKG_USING_SIGNAL_LED_V110
            bool "v1.1.0"

        config PKG_USING_SIGNAL_LED_LATEST_VERSION
            bool "latest"
    endchoice
          
    config PKG_SIGNAL_LED_VER
       string
       default "v1.2.0"    if PKG_USING_SIGNAL_LED_V120
       default "v1.1.0"    if PKG_USING_SIGNAL_LED_V110
       default "latest"    if PKG_USING_SIGNAL_LED_LATEST_VERSION

    menu "signalLed Options"
        config SIGNAL_LED_USING_SAMPLE
            bool
            prompt "signal led example"
            default n
    endmenu       

endif
```

## peripherals/System_Run_LED/Kconfig
```kconfig
# Kconfig file for package System_Run_LED
menuconfig PKG_USING_SYSTEM_RUN_LED
    bool "System_Run_LED: System Run LED Control thread."
    select RT_USING_PIN
    default n

if PKG_USING_SYSTEM_RUN_LED

    config PKG_SYSTEM_RUN_LED_PATH
        string
        default "/packages/peripherals/System_Run_LED"

        config System_Run_LED_Pin_Name
            string "System Run LED Pin Name. [ Example : PA.00 ]"
            default "PA.00"

        config System_Run_LED_Flash_Time
            int "System Run LED Flash Time. [ Unit : ms ]"
            default 500

        config System_Run_LED_THREAD_PRIORITY
            int "System Run LED Thread Priority."
            default 20

        config System_Run_LED_THREAD_STACK_SIZE
            int "System Run LED Thread Stack Size."
            default 250

        config System_Run_LED_THREAD_TIMESLICE
            int "System Run LED Thread Timeslice."
            default 1

    choice
        prompt "Version"
        default PKG_USING_SYSTEM_RUN_LED_LATEST_VERSION
        help
            Select the package version

        config PKG_USING_SYSTEM_RUN_LED_LATEST_VERSION
            bool "latest"

    endchoice

    config PKG_SYSTEM_RUN_LED_VER
       string
       default "latest"    if PKG_USING_SYSTEM_RUN_LED_LATEST_VERSION

endif
```

## peripherals/agile_button/Kconfig
```kconfig
# Kconfig file for package agile_button
menuconfig PKG_USING_AGILE_BUTTON
    bool "agile_button: A agile button package."
    default n
    select RT_USING_PIN

if PKG_USING_AGILE_BUTTON

    config PKG_AGILE_BUTTON_PATH
        string
        default "/packages/peripherals/agile_button"

    config PKG_AGILE_BUTTON_DEBUG
        bool "Enable debug log output"
        default n

    config PKG_AGILE_BUTTON_USING_THREAD_AUTO_INIT
        bool "Enable agile_button auto initialize thread"
        default y

    if PKG_AGILE_BUTTON_USING_THREAD_AUTO_INIT

        config PKG_AGILE_BUTTON_THREAD_STACK_SIZE
            int "Set agile_button thread stack size"
            default 256

        config PKG_AGILE_BUTTON_THREAD_PRIORITY
            int "Set agile_button thread priority"
            default 28

    endif

    config PKG_AGILE_BUTTON_USING_EXAMPLE
        bool "Enable agile_button example"
        default n

    choice
        prompt "Version"
        default PKG_USING_AGILE_BUTTON_V111
        help
            Select the package version

        config PKG_USING_AGILE_BUTTON_V110
            bool "v1.1.0"

        config PKG_USING_AGILE_BUTTON_V111
            bool "v1.1.1"

        config PKG_USING_AGILE_BUTTON_LATEST_VERSION
            bool "latest"
    endchoice

    config PKG_AGILE_BUTTON_VER
       string
       default "v1.1.0"    if PKG_USING_AGILE_BUTTON_V110
       default "v1.1.1"    if PKG_USING_AGILE_BUTTON_V111
       default "latest"    if PKG_USING_AGILE_BUTTON_LATEST_VERSION

    config PKG_AGILE_BUTTON_VER_NUM
        hex
        default 0x10100    if PKG_USING_AGILE_BUTTON_V110
        default 0x10101    if PKG_USING_AGILE_BUTTON_V111
        default 0x99999    if PKG_USING_AGILE_BUTTON_LATEST_VERSION

endif
```

## peripherals/agile_console/Kconfig
```kconfig
# Kconfig file for package agile_console
menuconfig PKG_USING_AGILE_CONSOLE
    bool "agile_console: Simple debugging device Middleware."
    default n
    select RT_USING_DEVICE_IPC

if PKG_USING_AGILE_CONSOLE

    config PKG_AGILE_CONSOLE_PATH
        string
        default "/packages/peripherals/agile_console"

    config PKG_AGILE_CONSOLE_RX_BUFFER_SIZE
        int "Set agile_console rx buffer size"
        default 1024

    config PKG_AGILE_CONSOLE_DEVICE_NAME
        string "Set agile_console device name"
        default "tty"

    config PKG_AGILE_CONSOLE_THREAD_PRIORITY
        int "Set agile_console thread priority"
        default 9

    config PKG_AGILE_CONSOLE_THREAD_STACK_SIZE
        int "Set agile_console thread stack size"
        default 2048

    config PKG_USING_AGILE_CONSOLE_SERIAL_EXAMPLE
        bool "Enable agile_console serial example"
        default n

    if PKG_USING_AGILE_CONSOLE_SERIAL_EXAMPLE

        config PKG_AGILE_CONSOLE_SERIAL_DEVICE_NAME
            string "Set serial device name"
            default "uart"

    endif

    if PKG_AGILE_CONSOLE_VER_NUM > 0x10001

        config PKG_AGILE_CONSOLE_USING_TELNET
            bool "Enable telnet plugin"
            default n
            select PKG_USING_AGILE_TELNET

        config PKG_AGILE_CONSOLE_USING_TINYUSB
            bool "Enable tinyusb plugin"
            depends on RT_VER_NUM >= 0x40100
            default n
            select PKG_USING_TINYUSB
            select PKG_TINYUSB_DEVICE_ENABLE
            select PKG_TINYUSB_DEVICE_CDC
            select RT_USING_TIMER_SOFT

    endif

    choice
        prompt "Version"
        default PKG_USING_AGILE_CONSOLE_V110
        help
            Select the package version

        config PKG_USING_AGILE_CONSOLE_V110
            bool "v1.1.0"

        config PKG_USING_AGILE_CONSOLE_LATEST_VERSION
            bool "latest"
    endchoice

    config PKG_AGILE_CONSOLE_VER
       string
       default "v1.1.0"    if PKG_USING_AGILE_CONSOLE_V110
       default "latest"    if PKG_USING_AGILE_CONSOLE_LATEST_VERSION

    config PKG_AGILE_CONSOLE_VER_NUM
        hex
        default 0x10100    if PKG_USING_AGILE_CONSOLE_V110
        default 0x99999    if PKG_USING_AGILE_CONSOLE_LATEST_VERSION
endif
```

## peripherals/agile_led/Kconfig
```kconfig
# Kconfig file for package agile_led
menuconfig PKG_USING_AGILE_LED
    bool "agile_led: A agile led package."
    default n
    select RT_USING_PIN

if PKG_USING_AGILE_LED

    config PKG_AGILE_LED_PATH
        string
        default "/packages/peripherals/agile_led"

    config PKG_AGILE_LED_DEBUG
        bool "Enable debug log output"
        default n

    config PKG_AGILE_LED_USING_THREAD_AUTO_INIT
        bool "Enable agile_led auto initialize thread"
        default y

    if PKG_AGILE_LED_USING_THREAD_AUTO_INIT

        config PKG_AGILE_LED_THREAD_STACK_SIZE
            int "Set agile_led thread stack size"
            default 256

        config PKG_AGILE_LED_THREAD_PRIORITY
            int "Set agile_led thread priority"
            default 28

    endif

    config PKG_AGILE_LED_USING_EXAMPLE
        bool "Enable agile_led example"
        default n

    choice
        prompt "Version"
        default PKG_USING_AGILE_LED_V111
        help
            Select the package version

        config PKG_USING_AGILE_LED_V110
            bool "v1.1.0"

        config PKG_USING_AGILE_LED_V111
            bool "v1.1.1"

        config PKG_USING_AGILE_LED_LATEST_VERSION
            bool "latest"
    endchoice

    config PKG_AGILE_LED_VER
       string
       default "v1.1.0"    if PKG_USING_AGILE_LED_V110
       default "v1.1.1"    if PKG_USING_AGILE_LED_V111
       default "latest"    if PKG_USING_AGILE_LED_LATEST_VERSION

    config PKG_AGILE_LED_VER_NUM
        hex
        default 0x10100    if PKG_USING_AGILE_LED_V110
        default 0x10101    if PKG_USING_AGILE_LED_V111
        default 0x99999    if PKG_USING_AGILE_LED_LATEST_VERSION

endif
```

## peripherals/aht10/Kconfig
```kconfig
# Kconfig file for package aht10
menuconfig PKG_USING_AHT10
    bool "aht10: digital humidity and temperature sensor aht10 driver library"
    default n

if PKG_USING_AHT10

    config PKG_AHT10_PATH
        string
        default "/packages/peripherals/aht10"
        
    config SHT20_USING_SOFT_FILTER
        bool "Enable average filter by software"
        default n
        help
            "It will automatic sample sensor's data by average filter thread."

    choice
        prompt "Version"
        default PKG_USING_AHT10_LATEST_VERSION
        help
            Select the package version

        config PKG_USING_AHT10_V100
            bool "v1.0.0"

        config PKG_USING_AHT10_LATEST_VERSION
            bool "latest"
    endchoice
          
    config PKG_AHT10_VER
       string
       default "v1.0.0"    if PKG_USING_AHT10_V100
       default "latest"    if PKG_USING_AHT10_LATEST_VERSION

endif
```

## peripherals/aip650/Kconfig
```kconfig
# Kconfig file for package aip650

menuconfig PKG_USING_AIP650
    bool "aip650/tm1650 : A quick and easy-to-use digit led and key driver package"
    default n

if PKG_USING_AIP650

    config PKG_AIP650_PATH
        string
        default "/packages/peripherals/aip650"

    config PKG_AIP650_I2C_NAME
        string "i2c bus"
        default "i2c1"

    config AIP650_USING_EXAMPLE
        bool "example for aip650/tm1650"
        default n

    config AIP650_TEST_KEY
        bool "test one key in example"
        depends on AIP650_USING_EXAMPLE
        default n

    choice
        prompt "Version"
        default PKG_USING_AIP650_LATEST_VERSION
        help
            Select the this package version

        config PKG_USING_AIP650_LATEST_VERSION
            bool "latest"
    endchoice

    config PKG_AIP650_VER
        string
        default "latest" if PKG_USING_AIP650_LATEST_VERSION

endif
```
