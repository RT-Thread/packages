## peripherals/sensors/mlx90632/Kconfig
```kconfig
# Kconfig file for package mlx90632
menuconfig PKG_USING_MLX90632
    bool "mlx90632: a mlx90632 package for rt-thread."
    default n

if PKG_USING_MLX90632

    config PKG_MLX90632_USING_SENSOR_V1
        bool "Enable sensor_v1 device framework"
        select RT_USING_SENSOR
        default n

    if PKG_MLX90632_USING_SENSOR_V1
        config PKG_USING_MLX90632_SENSOR_V1_EXAMPLE
            bool "Enable mlx90632 example"
            default n
    endif

    config PKG_MLX90632_PATH
        string
        default "/packages/peripherals/sensors/mlx90632"

    choice
        prompt "Version"
        default PKG_USING_MLX90632_LATEST_VERSION
        help
            Select the package version

        config PKG_USING_MLX90632_V100
            bool "v1.0.0"

        config PKG_USING_MLX90632_LATEST_VERSION
            bool "latest"
    endchoice

    config PKG_MLX90632_VER
       string
       default "latest"    if PKG_USING_MLX90632_LATEST_VERSION

endif
```

## peripherals/sensors/mmc3680kj/Kconfig
```kconfig
# Kconfig file for package mmc3680kj
menuconfig PKG_USING_MMC3680KJ
    bool "mmc3680kj:mmc3680kj iic sensor driver package,support:Magnetometer"
    default n

if PKG_USING_MMC3680KJ

    config PKG_MMC3680KJ_PATH
        string
        default "/packages/peripherals/sensors/mmc3680kj"

    config PKG_MMC3680KJ_USING_SENSOR_V1
        bool "Enable sensor_v1 device framework"
        select RT_USING_SENSOR
        default n

    choice
        prompt "Version"
        default PKG_USING_MMC3680KJ_LATEST_VERSION
        help
            Select the package version

        config PKG_USING_MMC3680KJ_V100
            bool "v1.0.0"

        config PKG_USING_MMC3680KJ_LATEST_VERSION
            bool "latest"
    endchoice

    config PKG_MMC3680KJ_VER
       string
       default "v1.0.0"    if PKG_USING_MMC3680KJ_V100
       default "latest"    if PKG_USING_MMC3680KJ_LATEST_VERSION

endif
```

## peripherals/sensors/mpu6xxx/Kconfig
```kconfig
# Kconfig file for package mpu6xxx
menuconfig PKG_USING_MPU6XXX
    bool "mpu6xxx: Universal 6-axis sensor driver package,support: accelerometer, gyroscope."
    default n

if PKG_USING_MPU6XXX

    config PKG_MPU6XXX_USING_SENSOR_V1
        bool "Enable sensor divce framework"
        depends on RT_VER_NUM >= 0x50001
        select RT_USING_SENSOR
        default n

    config PKG_MPU6XXX_PATH
        string
        default "/packages/peripherals/sensors/mpu6xxx"

    choice
        prompt "Version"
        help
            Select the package version

        config PKG_USING_MPU6XXX_LATEST_VERSION
            bool "latest"
            depends on RT_VER_NUM >= 0x50000

        config PKG_USING_MPU6XXX_V111
            bool "v1.1.1"
            depends on RT_VER_NUM < 0x50000 || !RT_USING_SENSOR_V2

        config PKG_USING_MPU6XXX_V110
            bool "v1.1.0"
            depends on RT_VER_NUM < 0x50000

        config PKG_USING_MPU6XXX_V100
            bool "v1.0.0"
            depends on RT_VER_NUM < 0x50000
    endchoice

    config PKG_MPU6XXX_VER
       string
       default "v1.0.0"    if PKG_USING_MPU6XXX_V100
       default "v1.1.0"    if PKG_USING_MPU6XXX_V110
       default "v1.1.1"    if PKG_USING_MPU6XXX_V111
       default "latest"    if PKG_USING_MPU6XXX_LATEST_VERSION


    config PKG_USING_MPU6XXX_SAMPLE
        bool "Enable mpu6xxx sample"
        default n

    config PKG_USING_MPU6XXX_ACCE
        bool "Enable mpu6xxx acce"
        default y

    config PKG_USING_MPU6XXX_GYRO
        bool "Enable mpu6xxx gyro"
        default y

    config PKG_USING_MPU6XXX_MAG
        bool "Enable mpu6xxx mag"
        depends on !PKG_USING_MPU6XXX_V100
        default y

endif
```

## peripherals/sensors/ms5611/Kconfig
```kconfig
# Kconfig file for package ms5611
menuconfig PKG_USING_MS5611
    bool "MS5611: Digital pressure sensor"
    default n

if PKG_USING_MS5611

    config PKG_MS5611_PATH
        string
        default "/packages/peripherals/sensors/ms5611"

    config PKG_MS5611_USING_SENSOR_V1
        bool "Enable sensor_v1 device framework"
        select RT_USING_SENSOR
        default n
    
    config PKG_MS5611_USING_TEMP
        bool "Enable MS5611 temperature"
        default n
    
    config PKG_MS5611_USING_BARO
        bool "Enable MS5611 pressure"
        default n

    choice
        prompt "Version"
        default PKG_USING_MS5611_LATEST_VERSION
        help
            Select the package version

        config PKG_USING_MS5611_V100
            bool "v1.0.0"

        config PKG_USING_MS5611_LATEST_VERSION
            bool "latest"
    endchoice

    config PKG_MS5611_VER
       string
       default "v1.0.0"    if PKG_USING_MS5611_V100
       default "latest"    if PKG_USING_MS5611_LATEST_VERSION

endif
```

## peripherals/sensors/ms5805/Kconfig
```kconfig
# Kconfig file for package ms5805
menuconfig PKG_USING_MS5805
    bool "MS5805: Digital pressure sensor"
    default n

if PKG_USING_MS5805

    config PKG_MS5805_PATH
        string
        default "/packages/peripherals/sensors/ms5805"

    config PKG_MS5805_USING_SENSOR_V1
        bool "Enable sensor_v1 device framework"
        select RT_USING_SENSOR
        default n

    if PKG_MS5805_USING_SENSOR_V1
        config PKG_USING_MS5805_SAMPLE
            bool "Enable MS5805 sensor_v1 example"
            default n
    endif

    config PKG_MS5805_USING_TEMP
        bool "Enable MS5805 temperature"
        default n

    config PKG_MS5805_USING_BARO
        bool "Enable MS5805 pressure"
        default n

    choice
        prompt "Version"
        default PKG_USING_MS5805_LATEST_VERSION
        help
            Select the package version

        config PKG_USING_MS5805_V100
            bool "v1.0.0"

        config PKG_USING_MS5805_LATEST_VERSION
            bool "latest"
    endchoice

    config PKG_MS5805_VER
       string
       default "v1.0.0"    if PKG_USING_MS5805_V100
       default "latest"    if PKG_USING_MS5805_LATEST_VERSION

endif
```

## peripherals/sensors/p3t1755/Kconfig
```kconfig
# Kconfig file for package p3t1755
menuconfig PKG_USING_P3T1755
    bool "p3t1755: a p3t1755 package for rt-thread."
    default n
    select RT_USING_I2C
    help
        A temperature detection chip from nxp, driven through the SENSOR frame.

if PKG_USING_P3T1755
    config P3T1755_I2C_BUS_NAME
        string "The name of the I2C bus used by P3T1755"
        default "i2c0"

    config PKG_P3T1755_USING_SENSOR_V2
        bool "Enable sensor divce framework"
        depends on RT_VER_NUM >= 0x50001
        select RT_USING_SENSOR
        select RT_USING_SENSOR_V2
        default n

    config PKG_P3T1755_PATH
        string
        default "/packages/peripherals/sensors/p3t1755"

    choice
        prompt "Version"
        default PKG_USING_P3T1755_LATEST_VERSION
        help
            Select the package version

        config PKG_USING_P3T1755_LATEST_VERSION
            bool "latest"
    endchoice

    config PKG_P3T1755_VER
       string
       default "latest"    if PKG_USING_P3T1755_LATEST_VERSION

endif
```

## peripherals/sensors/pmsxx/Kconfig
```kconfig
# Kconfig file for package pmsxx
menuconfig PKG_USING_PMSXX
    bool "PMSxx: Plantower pms serial PM2.5 sensor driver."
    default n

if PKG_USING_PMSXX

    config PKG_PMSXX_PATH
        string
        default "/packages/peripherals/sensors/pmsxx"
        
    config PKG_PMSXX_USING_SENSOR_V1
        bool "Enable sensor_v1 device framework"
        select RT_USING_SENSOR
        default n

    if PKG_PMSXX_USING_SENSOR_V1
        config PKG_USING_SENSOR_V1_PMSXX_SAMPLE
            bool "Enable pmsxx sensor_v1 sample"
            default n
    endif

    choice
        prompt "Select pms sensor type"
        default PKG_USING_PMSXX_BASIC
        help
            Basic type for PMSxx model, like PMS1003/PMS3003/PMS5003/PMS7003/PMS9003/PMSA003
            Enhanced type for PMSxxST model, like PMS5003ST

        config PKG_USING_PMSXX_BASIC
            bool "Basic"

        config PKG_USING_PMSXX_ENHANCED
            bool "Enhanced"
    endchoice

    config PKG_USING_PMSXX_SEND_WAIT_TIME
        int "The waiting time after send command (ms)"
        default 2000

    config PKG_USING_PMSXX_INIT_ASYN
        bool "Enable initialize by thread"
        default n

    config PKG_USING_PMSXX_UART_DMA
        bool "Enable serial device DMA RX"
        default n

    config PKG_USING_PMSXX_DEBUG
        bool "Debug command and response"
        default n

    config PKG_USING_PMSXX_DEBUG_SHOW_CMD
        bool "Show commands"
        depends on PKG_USING_PMSXX_DEBUG
        default n

    config PKG_USING_PMSXX_DEBUG_SHOW_RESP
        bool "Show response data"
        depends on PKG_USING_PMSXX_DEBUG
        default n

    config PKG_USING_PMSXX_DEBUG_DUMP_RESP
        bool "Dump raw response data"
        depends on PKG_USING_PMSXX_DEBUG
        default n

    config PKG_USING_PMSXX_DEBUG_SHOW_RULER
        bool "Show ruler for raw response data"
        depends on PKG_USING_PMSXX_DEBUG && PKG_USING_PMSXX_DEBUG_DUMP_RESP
        default n

    config PKG_USING_PMSXX_SAMPLE
        bool "Enable pmsxx sample"
        default n

    config PKG_USING_PMSXX_SAMPLE_UART
        string "Select uart device name"
        depends on PKG_USING_PMSXX_SAMPLE
        default "uart3"

    choice
        prompt "Version"
        default PKG_USING_PMSXX_LATEST_VERSION
        help
            Select the package version

        config PKG_USING_PMSXX_V100
            bool "v1.0.0"

        config PKG_USING_PMSXX_LATEST_VERSION
            bool "latest"
    endchoice

    config PKG_PMSXX_VER
       string
       default "v1.0.0"    if PKG_USING_PMSXX_V100
       default "latest"    if PKG_USING_PMSXX_LATEST_VERSION

endif
```

## peripherals/sensors/qmi8658/Kconfig
```kconfig
# Kconfig file for package qmi8658
menuconfig PKG_USING_QMI8658
    bool "qmi8658: a 3-axis gyroscope and a 3-axis accelerometer driver library"
    select RT_USING_I2C
    default n

if PKG_USING_QMI8658

    config PKG_QMI8658_PATH
        string
        default "/packages/peripherals/sensors/qmi8658"

    config PKG_QMI_USING_8658A
        bool "using qmi8658A"
        default y

    choice
        prompt "Version"
        default PKG_USING_QMI8658_LATEST_VERSION
        help
            Select the package version

        config PKG_USING_QMI8658_LATEST_VERSION
            bool "latest"
    endchoice

    config PKG_QMI8658_VER
       string
       default "latest"    if PKG_USING_QMI8658_LATEST_VERSION

endif
```

## peripherals/sensors/qmp6989/Kconfig
```kconfig
# Kconfig file for package qmp6989
menuconfig PKG_USING_QMP6989
    bool "qmp6989: High accuracy and small size barometric pressure sensor,support: barometer, temperature."
    default n

if PKG_USING_QMP6989

    choice
        prompt "qmp6989 select intf"
        default PKG_QMP6989_USING_INTF_I2C

        config PKG_QMP6989_USING_INTF_I2C
            bool "intf i2c"

        config PKG_QMP6989_USING_INTF_SPI
            bool "intf spi"

    endchoice

    if PKG_QMP6989_USING_INTF_I2C
        config PKG_QMP6989_INTF_I2C_BUS_NAME
            string "qmp6989 intf i2c bus name"
            default "i2c0"

        config PKG_QMP6989_INTF_I2C_ADDR
            hex "qmp6989 intf i2c addr"
            default 0x6c
    endif

    if PKG_QMP6989_USING_INTF_SPI
        config PKG_QMP6989_INTF_SPI_BUS_NAME
            string "qmp6989 intf spi bus name"
            default "spi0"

        config PKG_QMP6989_INTF_SPI_CS_PIN
            int "qmp6989 intf spi cs pin"
            default -1
    endif

    config PKG_QMP6989_USING_SENSOR_V1
        bool "Enable sensor_v1 device framework"
        select RT_USING_SENSOR
        default n

    if PKG_QMP6989_USING_SENSOR_V1
        config PKG_QMP6989_SENSOR_V1_DEMO
            bool "Enable qmp6989 sensor_v1 demo"
            default n
    endif

    config PKG_QMP6989_SUPPORT_FLOAT
        bool "support float"
        default n
        
    config PKG_QMP6989_PATH
        string
        default "/packages/peripherals/sensors/qmp6989"

    choice
        prompt "Version"
        default PKG_USING_QMP6989_LATEST_VERSION
        help
            Select the package version

        config PKG_USING_QMP6989_LATEST_VERSION
            bool "latest"
    endchoice

    config PKG_QMP6989_VER
       string
       default "latest"    if PKG_USING_QMP6989_LATEST_VERSION

endif
```

## peripherals/sensors/rt3020/Kconfig
```kconfig
# Kconfig file for package rt3020
menuconfig PKG_USING_RT3020
    bool "RT3020 sensor driver package, support: accelerometer."
    default n

if PKG_USING_RT3020

    config PKG_RT3020_PATH
        string
        default "/packages/peripherals/sensors/rt3020"

	config PKG_USING_RT3020_ACCE
		bool "Enable rt3020 acce"
		default y
	
	choice
        prompt "Version"
        default PKG_USING_RT3020_LATEST_VERSION
        help
            Select the package version

        config PKG_USING_RT3020_V100
            bool "v1.0.0"

        config PKG_USING_RT3020_LATEST_VERSION
            bool "latest"
    endchoice
          
    config PKG_RT3020_VER
       string
       default "v1.0.0"    if PKG_USING_RT3020_V100
       default "latest"    if PKG_USING_RT3020_LATEST_VERSION

endif
```

## peripherals/sensors/scd4x/Kconfig
```kconfig
# Kconfig file for package scd4x
menuconfig PKG_USING_SCD4X
    bool "SCD4x: Sensirion CO2, Temperature and Humidity Sensor"
    default n
    select RT_USING_I2C

if PKG_USING_SCD4X
    config PKG_SCD4X_PATH
        string
        default "/packages/peripherals/sensors/scd4x"

    config PKG_SCD4X_I2C_BUS
        string "I2C bus name"
        default "i2c1"

    config PKG_SCD4X_ASC_ENABLE
        bool "Enable Automatic Self Calibration (ASC)"
        default y

    config PKG_USING_SCD4X_SAMPLE
        bool "Enable SCD4x sample application"
        default n

    config PKG_USING_SCD4X_SHELL
        bool "Enable SCD4x FinSH shell commands"
        default y

    choice
        prompt "Version"
        default PKG_USING_SCD4X_LATEST_VERSION
        config PKG_USING_SCD4X_V100
            bool "v1.0.0"
        config PKG_USING_SCD4X_LATEST_VERSION
            bool "latest"
    endchoice

    config PKG_SCD4X_VER
       string
       default "v1.0.0"    if PKG_USING_SCD4X_V100
       default "latest"    if PKG_USING_SCD4X_LATEST_VERSION
endif
```
