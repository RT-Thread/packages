## iot/ezXML/Kconfig
```kconfig
menuconfig PKG_USING_EZXML
    bool "ezXML is a C library for parsing XML documents."
    default n

if PKG_USING_EZXML

    config PKG_EZXML_PATH
        string
        default "/packages/iot/ezXML"

	choice
        prompt "version"
        help
            Select the ezXML version

        config PKG_USING_EZXML_LATEST_VERSION
            bool "latest"

        config PKG_USING_EZXML_V068
            bool "v0.8.6"
    endchoice

    config PKG_EZXML_VER
        string
        default "v0.8.6" if PKG_USING_EZXML_V068
        default "latest" if PKG_USING_EZXML_LATEST_VERSION

endif
```

## iot/freemodbus/Kconfig
```kconfig
# Kconfig file for package freemodbus
menuconfig PKG_USING_FREEMODBUS
    bool "FreeModbus: Modbus master and slave stack"
    default n

if PKG_USING_FREEMODBUS

    config PKG_FREEMODBUS_PATH
        string
        default "/packages/iot/freemodbus"

    menuconfig PKG_MODBUS_MASTER
        bool "Master mode"
        default n
        if PKG_MODBUS_MASTER
            menu "advanced configuration"
                config RT_M_DISCRETE_INPUT_START
                    int "master discrete input start address"
                    default 0
                config RT_M_DISCRETE_INPUT_NDISCRETES
                    int "master discrete input discretes numbers"
                    default 16
                config RT_M_COIL_START
                    int "master coil start address"
                    default 0
                config RT_M_COIL_NCOILS
                    int "master coils numbers"
                    default 64
                config RT_M_REG_INPUT_START
                    int "master input start address"
                    default 0
                config RT_M_REG_INPUT_NREGS
                    int "master input regs numbers"
                    default 100
                config RT_M_REG_HOLDING_START
                    int "master holding start address"
                    default 0
                config RT_M_REG_HOLDING_NREGS
                    int "master holding regs numbers"
                    default 100
                config RT_M_HD_RESERVE
                    int "master holding reserve numbers"
                    default 0
                config RT_M_IN_RESERVE
                    int "master input reserve numbers"
                    default 0
                config RT_M_CO_RESERVE
                    int "master coil reserve numbers"
                    default 0
                config RT_M_DI_RESERVE
                    int "master discrete reserve numbers"
                    default 0
            endmenu

            config PKG_MODBUS_MASTER_RTU
                bool "Enable RTU master mode"
                default y
                if PKG_MODBUS_MASTER_RTU
                    config PKG_MODBUS_MASTER_SAMPLE
                        bool "Enable master sample"
                        default n
                        if PKG_MODBUS_MASTER_SAMPLE
                            config MB_SAMPLE_TEST_SLAVE_ADDR
                                int "Test slave device address"
                                default 1
                            config MB_MASTER_USING_PORT_NUM
                                int "uart number used by master sample, e.g. 2 means uart2"
                                default 2
                            config MB_MASTER_USING_PORT_BAUDRATE
                                int "uart baudrate used by master sample"
                                default 115200
                        endif
                endif
        endif

    menuconfig PKG_MODBUS_SLAVE
        bool "Slave mode"
        default n
        if PKG_MODBUS_SLAVE
            menu "advanced configuration"
                config RT_S_DISCRETE_INPUT_START
                    int "slave discrete input start address"
                    default 0
                config RT_S_DISCRETE_INPUT_NDISCRETES
                    int "slave discrete input discretes numbers"
                    default 16
                config RT_S_COIL_START
                    int "slave coil start address"
                    default 0
                config RT_S_COIL_NCOILS
                    int "slave coils numbers"
                    default 64
                config RT_S_REG_INPUT_START
                    int "slave input start address"
                    default 0
                config RT_S_REG_INPUT_NREGS
                    int "slave input regs numbers"
                    default 100
                config RT_S_REG_HOLDING_START
                    int "slave holding start address"
                    default 0
                config RT_S_REG_HOLDING_NREGS
                    int "slave holding regs numbers"
                    default 100
                config RT_S_HD_RESERVE
                    int "slave holding reserve numbers"
                    default 0
                config RT_S_IN_RESERVE
                    int "slave input reserve numbers"
                    default 0
                config RT_S_CO_RESERVE
                    int "slave coil reserve numbers"
                    default 0
                config RT_S_DI_RESERVE
                    int "slave discrete reserve numbers"
                    default 0
            endmenu

            config PKG_MODBUS_SLAVE_RTU
                bool "Enable RTU slave mode"
                default y
            config PKG_MODBUS_SLAVE_ASCII
                bool "Enable ASCII slave mode"
                default n
            config PKG_MODBUS_SLAVE_TCP
                bool "Enable TCP slave mode"
                select PKG_USING_TCPSERVER
                default n
            config RT_MODBUS_SLAVE_USE_CONTROL_PIN
                bool "Use Contorl Pin"
                default n
                if RT_MODBUS_SLAVE_USE_CONTROL_PIN
                    config MODBUS_SLAVE_RT_CONTROL_PIN_INDEX
                        int "pin index for RS485 TX/RX select"
                        default 10
                endif
            config PKG_MODBUS_SLAVE_SAMPLE
                bool "Enable slave sample"
                default n
                if PKG_MODBUS_SLAVE_SAMPLE
                    config MB_SAMPLE_SLAVE_ADDR
                        int "Slave device address"
                        default 1
                    config MB_SLAVE_USING_PORT_NUM
                        int "uart number used by slave sample, e.g. 2 means uart2"
                        default 2
                    config MB_SLAVE_USING_PORT_BAUDRATE
                        int "uart baudrate used by slave sample"
                        default 115200
                endif
        endif
        
    choice
        prompt "Version"
        default PKG_USING_FREEMODBUS_LATEST_VERSION
        help
            Select the package version

        config PKG_USING_FREEMODBUS_V160
            bool "v1.6.0"

        config PKG_USING_FREEMODBUS_LATEST_VERSION
            bool "latest"
    endchoice
          
    config PKG_FREEMODBUS_VER
       string
       default "v1.6.0"    if PKG_USING_FREEMODBUS_V160
       default "latest"    if PKG_USING_FREEMODBUS_LATEST_VERSION

endif
```

## iot/hm/Kconfig
```kconfig
# Kconfig file for package hm
menuconfig PKG_USING_HM
    bool "HM: A generic Bluetooth HCI transport layer"
    default n

if PKG_USING_HM

    config PKG_HM_PATH
        string
        default "/packages/iot/hm"

    choice
        prompt "Version"
        default PKG_USING_HM_V100
        help
            Select the package version

        config PKG_USING_HM_V100
            bool "v1.0.0"

        config PKG_USING_HM_LATEST_VERSION
            bool "latest"
    endchoice

    config PKG_HM_VER
       string
       default "v1.0.0"    if PKG_USING_HM_V100
       default "latest"    if PKG_USING_HM_LATEST_VERSION

    config HM_USING_STACK
        bool "Enable Stack Port"
        default n

        if HM_USING_STACK
            choice
                prompt "Select stack port"
                default HM_USING_STACK_BTSTACK

                config HM_USING_STACK_BTSTACK
                    bool "Using BTStack"

                config HM_USING_STACK_NIMBLE
                    bool "Using NimBLE"
            endchoice
        endif

    config HM_USING_CHIPSET
        bool "Enable Chipset Port"
        default n

        if HM_USING_CHIPSET
            choice
                prompt "Select chipset port"
                default HM_USING_CHIPSET_BCM

                config HM_USING_CHIPSET_BCM
                    bool "Using AP6212A(BCM)"
                config HM_USING_CHIPSET_CSR8311
                    bool "Using CSR8311"
                config HM_USING_CHIPSET_ZEPHYR
                    bool "Using Zephyr Controller"
            endchoice
        endif

    if HM_USING_CHIPSET_BCM
        config HM_USING_BOARD_ART_PI
        bool "Using ART-Pi"
        default n
    endif

    config HM_USING_TEST
        bool "Enable Testcases"
        default n

endif
```

## iot/iot_cloud/GAgent/Kconfig
```kconfig
menuconfig PKG_USING_GAGENT_CLOUD
    bool "GAgent: GAgent of Gizwits in RT-Thread"
    select RT_USING_LWIP
    select RT_LWIP_NETIF_LOOPBACK
    select PKG_USING_WEBCLIENT
    select PKG_USING_PAHOMQTT
    select PKG_USING_TINYCRYPT
    select TINY_CRYPT_AES
    default n

if PKG_USING_GAGENT_CLOUD

    config PKG_GAGENT_CLOUD_EXAMPLE
    bool "Enable GAgent example"
    default n

    config PKG_GAGENT_CLOUD_DEBUG
    bool "Enable GAgent debug"
    default n

    config PKG_GAGENT_PATH
        string
        default "/packages/iot/iot_cloud/GAgent"

    choice
        prompt "Version"
        help
            Select the GAgent version

        config PKG_USING_GAGENT_LATEST_VERSION
            bool "latest"

        config PKG_USING_GAGENT_V100
            bool "v1.0.0"

    endchoice

    config PKG_GAGENT_VER
    string
    default "v1.0.0" if PKG_USING_GAGENT_V100
    default "latest" if PKG_USING_GAGENT_LATEST_VERSION

endif
```

## iot/iot_cloud/Kconfig
```kconfig
menu "IoT Cloud"

source "$PKGS_DIR/packages/iot/iot_cloud/onenet/Kconfig"
source "$PKGS_DIR/packages/iot/iot_cloud/GAgent/Kconfig"
source "$PKGS_DIR/packages/iot/iot_cloud/ali-iotkit/Kconfig"
source "$PKGS_DIR/packages/iot/iot_cloud/azure-iot-sdk/Kconfig"
source "$PKGS_DIR/packages/iot/iot_cloud/tencent-iot-sdk/Kconfig"
source "$PKGS_DIR/packages/iot/iot_cloud/jiot-c-sdk/Kconfig"
source "$PKGS_DIR/packages/iot/iot_cloud/ucloud_iot_sdk/Kconfig"
source "$PKGS_DIR/packages/iot/iot_cloud/joylink/Kconfig"
#source "$PKGS_DIR/packages/iot/iot_cloud/ez_iot_os/Kconfig"  #missing repo
source "$PKGS_DIR/packages/iot/iot_cloud/iotsharp-c-sdk/Kconfig"

endmenu
```

## iot/iot_cloud/ali-iotkit/Kconfig
```kconfig
# Kconfig file for package ali-iotkit
menuconfig PKG_USING_ALI_IOTKIT
    bool "Ali-iotkit: Aliyun cloud sdk 'iotkit-embedded' for RT-Thread"
    select RT_USING_SAL
    select SAL_USING_POSIX
    default n

if PKG_USING_ALI_IOTKIT

    config PKG_ALI_IOTKIT_PATH
        string
        default "/packages/iot/iot_cloud/ali-iotkit"

    config PKG_USING_ALI_IOTKIT_PRODUCT_KEY
        string "Config Product Key"
        default a1dSQSGZ77X

    config PKG_USING_ALI_IOTKIT_PRODUCT_SECRET
        string "Config Product Secret"
        default NfIdVcfBP7rtH24H

    config PKG_USING_ALI_IOTKIT_DEVICE_NAME
        string "Config Device Name"
        default RGB-LED-DEV-1        

    config PKG_USING_ALI_IOTKIT_DEVICE_SECRET
        string "Config Device Secret"
        default Ghuiyd9nmGowdZzjPqFtxhm3WUHEbIlI

    if (PKG_ALI_IOTKIT_VER_NUM >= 0x30000)
        config PKG_ALI_IOTKIT_SELECT_ITEM
            bool
            select PLATFORM_HAS_OS
            select PLATFORM_HAS_STDINT
            default y

        source "$PKGS_DIR/packages/iot/iot_cloud/ali-iotkit/menu/Config.infra"
        source "$PKGS_DIR/packages/iot/iot_cloud/ali-iotkit/menu/Config.dev_sign"
        source "$PKGS_DIR/packages/iot/iot_cloud/ali-iotkit/menu/Config.mqtt"
        source "$PKGS_DIR/packages/iot/iot_cloud/ali-iotkit/menu/Config.dynamic_register"
        source "$PKGS_DIR/packages/iot/iot_cloud/ali-iotkit/menu/Config.dev_model"
        source "$PKGS_DIR/packages/iot/iot_cloud/ali-iotkit/menu/Config.wrappers"
        source "$PKGS_DIR/packages/iot/iot_cloud/ali-iotkit/menu/Config.atm"
        source "$PKGS_DIR/packages/iot/iot_cloud/ali-iotkit/menu/Config.ota"
        source "$PKGS_DIR/packages/iot/iot_cloud/ali-iotkit/menu/Config.coap"
        source "$PKGS_DIR/packages/iot/iot_cloud/ali-iotkit/menu/Config.dev_reset"
        source "$PKGS_DIR/packages/iot/iot_cloud/ali-iotkit/menu/Config.http"
        source "$PKGS_DIR/packages/iot/iot_cloud/ali-iotkit/menu/Config.http2"
        source "$PKGS_DIR/packages/iot/iot_cloud/ali-iotkit/menu/Config.wifi_provision"
        source "$PKGS_DIR/packages/iot/iot_cloud/ali-iotkit/menu/Config.dev_bind"

        config PKG_USING_ALI_IOTKIT_SAMPLES
            bool "Samples"
            default n 

        if PKG_USING_ALI_IOTKIT_SAMPLES
            config PKG_USING_ALI_IOTKIT_MQTT_SAMPLE
                bool "Enable MQTT sample"
                depends on MQTT_COMM_ENABLED
                default y
            config PKG_USING_ALI_IOTKIT_COAP_SAMPLE
                bool "Enable COAP sample"
                depends on COAP_COMM_ENABLED
                default n
            config PKG_USING_ALI_IOTKIT_DEV_MODEL_SAMPLE
                bool "Enable device model sample"
                depends on DEVICE_MODEL_ENABLED
                default n
            config PKG_USING_ALI_IOTKIT_OTA_SAMPLE
                bool "Enable OTA sample"
                depends on OTA_ENABLED
                default n
        endif
    endif

    if (PKG_ALI_IOTKIT_VER_NUM < 0x30000)
		source "$PKGS_DIR/packages/iot/iot_cloud/ali-iotkit/v20x/Kconfig"
    endif

    choice
        prompt "Version"
        default PKG_USING_ALI_IOTKIT_V20004
        help
            Select the ali-iotkit version

        config PKG_USING_ALI_IOTKIT_V20003
            bool "v2.0.3"

        config PKG_USING_ALI_IOTKIT_V20004
            bool "v2.0.4"

        config PKG_USING_ALI_IOTKIT_LATEST_VERSION
            bool "latest"

    endchoice

    config PKG_ALI_IOTKIT_VER
       string
       default "v2.0.3"    if PKG_USING_ALI_IOTKIT_V20003
       default "v2.0.4"    if PKG_USING_ALI_IOTKIT_V20004
       default "latest"    if PKG_USING_ALI_IOTKIT_LATEST_VERSION

    config PKG_ALI_IOTKIT_VER_NUM
        hex
        default 0x99999    if PKG_USING_ALI_IOTKIT_LATEST_VERSION
        default 0x20004    if PKG_USING_ALI_IOTKIT_V20004
        default 0x20003    if PKG_USING_ALI_IOTKIT_V20003

endif
```
