## peripherals/hal-sdk/gd32/gd32-riscv-series/Kconfig
```kconfig
# Kconfig file for package gd32_riscv_series_driver
menuconfig PKG_USING_GD32_RISCV_SERIES_DRIVER
    bool "GD32 RISCV SERIES DRIVER PACKAGE"
    select PKG_USING_GD32_RISCV_CMSIS_DRIVER
    default n

if PKG_USING_GD32_RISCV_SERIES_DRIVER

    config PKG_GD32_RISCV_SERIES_DRIVER_PATH
        string
        default "/packages/peripherals/hal-sdk/gd32/gd32-riscv-series"
    choice
        prompt "Version"
        help
            Select the package version

        config PKG_USING_GD32_RISCV_SERIES_DRIVER_LATEST_VERSION
            bool "latest"
    endchoice

    config PKG_GD32_RISCV_SERIES_DRIVER_VER
       string
       default "latest"    if PKG_USING_GD32_RISCV_SERIES_DRIVER_LATEST_VERSION

endif
```

## peripherals/hal-sdk/gd32/gd32vw55x-wifi/Kconfig
```kconfig
menuconfig PKG_USING_GD32VW55X_WIFI
    bool "GD32VW55x WIFI DRIVER PACKAGE"
    default n
    select RT_USING_LWIP
    select RT_USING_LIBC

if PKG_USING_GD32VW55X_WIFI

    config PKG_GD32VW55X_WIFI_PATH
        string
        default "/packages/peripherals/hal-sdk/gd32/gd32vw55x-wifi"

    config GD32VW55X_WIFI_STATION_MODE
        bool "Enable Station Mode"
        default y
        help
            Enable WIFI Station (STA) mode to connect to access points.

    config GD32VW55X_WIFI_SOFTAP_MODE
        bool "Enable SoftAP Mode"
        default n
        help
            Enable WIFI SoftAP mode to act as an access point.

    menu "Security Configuration"

        config GD32VW55X_WIFI_WPA_SECURITY
            bool "Enable WPA/WPA2 Security"
            default y
            help
                Enable WPA and WPA2 security protocols.

        config GD32VW55X_WIFI_WPA3_SECURITY
            bool "Enable WPA3 Security"
            default n
            depends on GD32VW55X_WIFI_WPA_SECURITY
            help
                Enable WPA3 security protocol (SAE).

        config GD32VW55X_WIFI_WPS_SUPPORT
            bool "Enable WPS (Wi-Fi Protected Setup)"
            default n
            help
                Enable WPS for easy network setup.

    endmenu

    menu "Advanced Configuration"

        config GD32VW55X_WIFI_TASK_STACK_SIZE
            int "WIFI Task Stack Size"
            default 4096
            range 2048 8192
            help
                Stack size for WIFI tasks in bytes.

        config GD32VW55X_WIFI_TASK_PRIORITY
            int "WIFI Task Priority"
            default 10
            range 1 31
            help
                Priority for WIFI management tasks.

        config GD32VW55X_WIFI_RX_BUFFER_SIZE
            int "WIFI RX Buffer Size"
            default 1600
            range 1024 4096
            help
                Receive buffer size for WIFI packets.

        config GD32VW55X_WIFI_MAX_SCAN_RESULTS
            int "Maximum Scan Results"
            default 32
            range 8 128
            help
                Maximum number of scan results to store.

    endmenu

    menu "Power Management"

        config GD32VW55X_WIFI_POWER_SAVE
            bool "Enable Power Save Mode"
            default n
            help
                Enable WIFI power saving features.

        if GD32VW55X_WIFI_POWER_SAVE

            config GD32VW55X_WIFI_PS_DTIM_PERIOD
                int "DTIM Period for Power Save"
                default 3
                range 1 10
                help
                    DTIM period for power save mode.

        endif

    endmenu

    config GD32VW55X_WIFI_DEBUG
        bool "Enable WIFI Debug Output"
        default n
        help
            Enable detailed debug output for WIFI operations.

    if GD32VW55X_WIFI_DEBUG

        config GD32VW55X_WIFI_DEBUG_LEVEL
            int "Debug Level (0-4)"
            default 2
            range 0 4
            help
                Debug level: 0=None, 1=Error, 2=Warning, 3=Info, 4=Verbose

    endif
    choice
        prompt "Version"
        help
            Select the package version

        config PKG_USING_GD32VW55X_WIFI_LATEST_VERSION
            bool "latest"
    endchoice

    config PKG_GD32VW55X_WIFI_VER
        string
        default "latest"    if PKG_USING_GD32VW55X_WIFI_LATEST_VERSION
endif
```

## peripherals/hal-sdk/hc32/Kconfig
```kconfig
menu "HC32 DDL Drivers"

#HC32F3
source "$PKGS_DIR/packages/peripherals/hal-sdk/hc32/hc32-f3-cmsis/Kconfig"
source "$PKGS_DIR/packages/peripherals/hal-sdk/hc32/hc32-f3-series/Kconfig"

#HC32F4
source "$PKGS_DIR/packages/peripherals/hal-sdk/hc32/hc32-f4-cmsis/Kconfig"
source "$PKGS_DIR/packages/peripherals/hal-sdk/hc32/hc32-f4-series/Kconfig"

endmenu
```

## peripherals/hal-sdk/hc32/hc32-f3-series/Kconfig
```kconfig
# Kconfig file for package hc32f3_series_driver
menuconfig PKG_USING_HC32F3_SERIES_DRIVER
    bool "HC32F3 SERIES DRIVER PACKAGE"
    select PKG_USING_HC32F3_CMSIS_DRIVER
    default n

if PKG_USING_HC32F3_SERIES_DRIVER

    config PKG_HC32F3_SERIES_DRIVER_PATH
        string
        default "/packages/peripherals/hal-sdk/hc32/hc32-f3-series"

    choice
        prompt "Version"
        help
            Select the package version

        config PKG_USING_HC32F3_SERIES_DRIVER_LATEST_VERSION
            bool "latest"
    endchoice

    config PKG_HC32F3_SERIES_DRIVER_VER
       string
       default "latest"    if PKG_USING_HC32F3_SERIES_DRIVER_LATEST_VERSION

endif
```

## peripherals/hal-sdk/hc32/hc32-f4-series/Kconfig
```kconfig
# Kconfig file for package hc32f4_series_driver
menuconfig PKG_USING_HC32F4_SERIES_DRIVER
    bool "HC32F4 SERIES DRIVER PACKAGE"
    select PKG_USING_HC32F4_CMSIS_DRIVER
    default n

if PKG_USING_HC32F4_SERIES_DRIVER

    config PKG_HC32F4_SERIES_DRIVER_PATH
        string
        default "/packages/peripherals/hal-sdk/hc32/hc32-f4-series"

    choice
        prompt "Version"
        help
            Select the package version

        config PKG_USING_HC32F4_SERIES_DRIVER_LATEST_VERSION
            bool "latest"
    endchoice

    config PKG_HC32F4_SERIES_DRIVER_VER
       string
       default "latest"    if PKG_USING_HC32F4_SERIES_DRIVER_LATEST_VERSION

endif
```

## peripherals/hal-sdk/hc32/hc32_f4_cmsis/Kconfig
```kconfig
# Kconfig file for package HC32F4_cmsis_driver
menuconfig PKG_USING_HC32F4_CMSIS_DRIVER
    bool "HC32F4 CMSIS DRIVER PACKAGE"
    default n

if PKG_USING_HC32F4_CMSIS_DRIVER

    config PKG_HC32F4_CMSIS_DRIVER_PATH
        string
        default "/packages/peripherals/hal-sdk/hc32/hc32_f4_cmsis"

    choice
        prompt "Version"
        help
            Select the package version

        config PKG_USING_HC32F4_CMSIS_DRIVER_LATEST_VERSION
            bool "latest"
    endchoice

    config PKG_HC32F4_CMSIS_DRIVER_VER
       string
       default "latest"    if PKG_USING_HC32F4_CMSIS_DRIVER_LATEST_VERSION

endif
```

## peripherals/hal-sdk/hc32/hc32f334_ddl/Kconfig
```kconfig
# Kconfig file for package hc32f334_ddl
menuconfig PKG_USING_HC32F334_DDL
    bool "Add the HC32F334 library files."
    default n

if PKG_USING_HC32F334_DDL

    config PKG_HC32F334_DDL_PATH
        string
        default "/packages/peripherals/hal-sdk/hc32/hc32f334_ddl"

    choice
        prompt "Version"
        help
            Select the package version

        config PKG_USING_HC32F334_DDL_LATEST_VERSION
            bool "latest"
    endchoice

    config PKG_HC32F334_DDL_VER
       string
       default "latest"    if PKG_USING_HC32F334_DDL_LATEST_VERSION

endif
```

## peripherals/hal-sdk/hc32/hc32f4a8_ddl/Kconfig
```kconfig
# Kconfig file for package hc32f4a8_ddl
menuconfig PKG_USING_HC32F4A8_DDL
    bool "Add the HC32F4A8 library files."
    default n

if PKG_USING_HC32F4A8_DDL

    config PKG_HC32F4A8_DDL_PATH
        string
        default "/packages/peripherals/hal-sdk/hc32/hc32f4a8_ddl"

    choice
        prompt "Version"
        help
            Select the package version

        config PKG_USING_HC32F4A8_DDL_LATEST_VERSION
            bool "latest"
    endchoice

    config PKG_HC32F4A8_DDL_VER
       string
       default "latest"    if PKG_USING_HC32F4A8_DDL_LATEST_VERSION

endif
```

## peripherals/hal-sdk/hpmicro/Kconfig
```kconfig
menu "HPMicro SDK"

source "$PKGS_DIR/packages/peripherals/hal-sdk/hpmicro/hpm_sdk/Kconfig"

endmenu
```

## peripherals/hal-sdk/hpmicro/hpm_sdk/Kconfig
```kconfig
# Kconfig file for package hpm_sdk
menuconfig PKG_USING_HPM_SDK
    bool "HPM_SDK"
    default n

if PKG_USING_HPM_SDK

    config PKG_HPM_SDK_PATH
        string
        default "/packages/peripherals/hal-sdk/hpmicro/hpm_sdk"

    choice
        prompt "Version"
        help
            Select the package version

        config PKG_USING_HPM_SDK_V110
            bool "v1.10.0"

        config PKG_USING_HPM_SDK_LATEST_VERSION
            bool "latest"
    endchoice

    config PKG_HPM_SDK_VER
        string
        default "v1.10.0"   if PKG_USING_HPM_SDK_V110
        default "latest"    if PKG_USING_HPM_SDK_LATEST_VERSION

endif
```

## peripherals/hal-sdk/kendryte-sdk/K210-SDK/Kconfig
```kconfig
# Kconfig file for package k210_sdk
menuconfig PKG_USING_K210_SDK
    bool "Kendryte K210 SDK"
    default n

if PKG_USING_K210_SDK

    config PKG_K210_SDK_PATH
        string
        default "/packages/peripherals/hal-sdk/kendryte-sdk/K210-SDK"

    choice
        prompt "Version"
        default PKG_USING_K210_SDK_LATEST_VERSION
        help
            Select the package version

        config PKG_USING_K210_SDK_LATEST_VERSION
            bool "latest"
    endchoice

    config PKG_K210_SDK_VER
       string
       default "latest"    if PKG_USING_K210_SDK_LATEST_VERSION

endif
```

## peripherals/hal-sdk/kendryte-sdk/K210-SDK/kendryte-sdk/Kconfig
```kconfig
# Kconfig file for package kendryte-sdk
menuconfig PKG_USING_KENDRYTE_SDK
    bool "kendryte K210 SDK package for rt-thread (legacy)"
    default n

if PKG_USING_KENDRYTE_SDK

    config PKG_KENDRYTE_SDK_PATH
        string
        default "/packages/peripherals/hal-sdk/kendryte-sdk/K210-SDK/kendryte-sdk"

    choice
        prompt "Version"
        default PKG_USING_KENDRYTE_SDK_V057
        help
            Select the package version

        config PKG_USING_KENDRYTE_SDK_LATEST_VERSION
            bool "latest"

        config PKG_USING_KENDRYTE_SDK_V057
            bool "v0.5.7"

        config PKG_USING_KENDRYTE_SDK_V056
            bool "v0.5.6"
            depends on RT_VER_NUM < 0x40004

        config PKG_USING_KENDRYTE_SDK_V055
            bool "v0.5.5"
            depends on RT_VER_NUM < 0x40004

        config PKG_USING_KENDRYTE_SDK_V054
            bool "v0.5.4"
            depends on RT_VER_NUM < 0x40004

        config PKG_USING_KENDRYTE_SDK_V053
            bool "v0.5.3"
            depends on RT_VER_NUM < 0x40004

        config PKG_USING_KENDRYTE_SDK_V052
            bool "v0.5.2"
            depends on RT_VER_NUM < 0x40004
    endchoice

    config PKG_KENDRYTE_SDK_VER
       string
       default "v0.5.2"    if PKG_USING_KENDRYTE_SDK_V052
       default "v0.5.3"    if PKG_USING_KENDRYTE_SDK_V053
       default "v0.5.4"    if PKG_USING_KENDRYTE_SDK_V054
       default "v0.5.5"    if PKG_USING_KENDRYTE_SDK_V055
       default "v0.5.6"    if PKG_USING_KENDRYTE_SDK_V056
       default "v0.5.7"    if PKG_USING_KENDRYTE_SDK_V057
       default "latest"    if PKG_USING_KENDRYTE_SDK_LATEST_VERSION

    config PKG_KENDRYTE_SDK_VERNUM
        hex
        default 0x0052     if PKG_USING_KENDRYTE_SDK_V052
        default 0x0053     if PKG_USING_KENDRYTE_SDK_V053
        default 0x0054     if PKG_USING_KENDRYTE_SDK_V054
        default 0x0055     if PKG_USING_KENDRYTE_SDK_V055
        default 0x0056     if PKG_USING_KENDRYTE_SDK_V056
        default 0x0057     if PKG_USING_KENDRYTE_SDK_V057
        default 0x9999     if PKG_USING_KENDRYTE_SDK_LATEST_VERSION

endif
```

## peripherals/hal-sdk/kendryte-sdk/Kconfig
```kconfig
menu "Kendryte SDK"

rsource "K210-SDK/Kconfig"
rsource "K210-SDK/kendryte-sdk/Kconfig"

endmenu
```

## peripherals/hal-sdk/mm32/Kconfig
```kconfig
menu "MM32 HAL & SDK Drivers"

# MM32 CMSIS
source "$PKGS_DIR/packages/peripherals/hal-sdk/mm32/mm32f103xx-cmsis/Kconfig"
source "$PKGS_DIR/packages/peripherals/hal-sdk/mm32/mm32f3270x-cmsis/Kconfig"
source "$PKGS_DIR/packages/peripherals/hal-sdk/mm32/mm32f5260x-cmsis/Kconfig"
source "$PKGS_DIR/packages/peripherals/hal-sdk/mm32/mm32l0xx-cmsis/Kconfig"
source "$PKGS_DIR/packages/peripherals/hal-sdk/mm32/mm32l3xx-cmsis/Kconfig"

# MM32 HAL
source "$PKGS_DIR/packages/peripherals/hal-sdk/mm32/mm32f103xx-hal-driver/Kconfig"
source "$PKGS_DIR/packages/peripherals/hal-sdk/mm32/mm32f3270x-hal-driver/Kconfig"
source "$PKGS_DIR/packages/peripherals/hal-sdk/mm32/mm32f5260x-hal-driver/Kconfig"
source "$PKGS_DIR/packages/peripherals/hal-sdk/mm32/mm32l0xx-hal-driver/Kconfig"
source "$PKGS_DIR/packages/peripherals/hal-sdk/mm32/mm32l3xx-hal-driver/Kconfig"

endmenu
```

## peripherals/hal-sdk/mm32/mm32f103xx-hal-driver/Kconfig
```kconfig
# Kconfig file for package mm32f103xx-hal-driver
menuconfig PKG_USING_MM32F103XX_HAL_DRIVER
    bool "MM32F103xx HAL driver package"
    select PKG_USING_MM32F103XX_CMSIS
    default n

if PKG_USING_MM32F103XX_HAL_DRIVER

    config PKG_MM32F103XX_HAL_DRIVER_PATH
        string
        default "/packages/peripherals/hal-sdk/mm32/mm32f103xx-hal-driver"

    choice
        prompt "Version"
        help
            Select the package version

        config PKG_USING_MM32F103XX_HAL_DRIVER_LATEST_VERSION
            bool "latest"
    endchoice

    config PKG_MM32F103XX_HAL_DRIVER_VER
       string
       default "latest"    if PKG_USING_MM32F103XX_HAL_DRIVER_LATEST_VERSION

endif
```

## peripherals/hal-sdk/mm32/mm32f3270x-cmsis/Kconfig
```kconfig
# Kconfig file for package mm32f3270x-cmsis
menuconfig PKG_USING_MM32F3270X_CMSIS
    bool "MM32F3270x CMSIS package"
    select PKG_USING_CMSIS_CORE
    default n

if PKG_USING_MM32F3270X_CMSIS

    config PKG_MM32F3270X_CMSIS_PATH
        string
        default "/packages/peripherals/hal-sdk/mm32/mm32f3270x-cmsis"

    choice
        prompt "Version"
        help
            Select the package version

        config PKG_USING_MM32F3270X_CMSIS_LATEST_VERSION
            bool "latest"
    endchoice

    config PKG_MM32F3270X_CMSIS_VER
       string
       default "latest"    if PKG_USING_MM32F3270X_CMSIS_LATEST_VERSION

endif
```

## peripherals/hal-sdk/mm32/mm32f3270x-hal-driver/Kconfig
```kconfig
# Kconfig file for package mm32f3270x-hal-driver
menuconfig PKG_USING_MM32F3270X_HAL_DRIVER
    bool "MM32F3270x HAL driver package"
    select PKG_USING_MM32F3270X_CMSIS
    default n

if PKG_USING_MM32F3270X_HAL_DRIVER

    config PKG_MM32F3270X_HAL_DRIVER_PATH
        string
        default "/packages/peripherals/hal-sdk/mm32/mm32f3270x-hal-driver"

    choice
        prompt "Version"
        help
            Select the package version

        config PKG_USING_MM32F3270X_HAL_DRIVER_LATEST_VERSION
            bool "latest"
    endchoice

    config PKG_MM32F3270X_HAL_DRIVER_VER
       string
       default "latest"    if PKG_USING_MM32F3270X_HAL_DRIVER_LATEST_VERSION

endif
```

## peripherals/hal-sdk/mm32/mm32f5260x-cmsis/Kconfig
```kconfig
# Kconfig file for package mm32f5260x-cmsis
menuconfig PKG_USING_MM32F5260X_CMSIS
    bool "MM32F5260x CMSIS package"
    select PKG_USING_CMSIS_CORE
    default n

if PKG_USING_MM32F5260X_CMSIS

    config PKG_MM32F5260X_CMSIS_PATH
        string
        default "/packages/peripherals/hal-sdk/mm32/mm32f5260x-cmsis"

    choice
        prompt "Version"
        help
            Select the package version

        config PKG_USING_MM32F5260X_CMSIS_LATEST_VERSION
            bool "latest"
    endchoice

    config PKG_MM32F5260X_CMSIS_VER
       string
       default "latest"    if PKG_USING_MM32F5260X_CMSIS_LATEST_VERSION

endif
```
