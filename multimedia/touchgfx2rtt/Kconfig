## peripherals/ap3216c/Kconfig
```kconfig
# Kconfig file for package ap3216c
menuconfig PKG_USING_AP3216C
    bool "a ap3216c package for rt-thread"
    default n

if PKG_USING_AP3216C

    config PKG_AP3216C_PATH
        string
        default "/packages/iot/ap3216c"

    choice
        prompt "Version"
        default PKG_USING_AP3216C_LATEST_VERSION
        help
            Select the package version

        config PKG_USING_AP3216C_V100
            bool "v1.0.0"

        config PKG_USING_AP3216C_LATEST_VERSION
            bool "latest"
    endchoice
          
    config PKG_AP3216C_VER
       string
       default "v1.0.0"    if PKG_USING_AP3216C_V100
       default "latest"    if PKG_USING_AP3216C_LATEST_VERSION

endif
```

## peripherals/as608/Kconfig
```kconfig
# Kconfig file for package as608
menuconfig PKG_USING_AS608
    bool "AS608 fingerprint module driver"
    default n

if PKG_USING_AS608

    config AS60X_UART_NAME
        string "as60x uart name"
        default "uart3"

	comment "Notice: PI8 --> 136" 
	config PKG_AS608_WAK_PIN
		int "AS608 WAK pin num"
		range 1 176
		default 136

	config PKG_USING_AS608_SAMPLE
		bool "Enable AS608 SAMPLE"
		default n

    config PKG_AS608_PATH
        string
        default "/packages/peripherals/as608"

    choice
        prompt "Version"
        default PKG_USING_AS608_LATEST_VERSION
        help
            Select the package version

        config PKG_USING_AS608_V102
            bool "v1.0.2"

        config PKG_USING_AS608_LATEST_VERSION
            bool "latest"
    endchoice

    config PKG_AS608_VER
       string
       default "v1.0.2"    if PKG_USING_AS608_V102
       default "latest"    if PKG_USING_AS608_LATEST_VERSION

endif
```
