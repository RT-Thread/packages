## iot/wiznet/Kconfig
```kconfig
# Kconfig file for package wiznet
menuconfig PKG_USING_WIZNET
    bool "WIZnet: WIZnet TCP/IP chips SAL framework implement"
    default n
    select RT_USING_PIN
    select RT_USING_SPI
    select RT_USING_LIBC
    select RT_USING_SAL

if PKG_USING_WIZNET

    config PKG_WIZNET_PATH
        string
        default "/packages/iot/wiznet"

    choice
        prompt "WIZnet device type"
        default WIZ_USING_W5500
        help
            Select the wiznet type

        config WIZ_USING_W5500
            bool "W5500"

    endchoice
    
    config WIZNET_DEVICE_EXTERN_CONFIG
         bool
         default n

    if !WIZNET_DEVICE_EXTERN_CONFIG
        menu "WIZnet device configure"

            config WIZ_SPI_DEVICE
                string "SPI device name"
                default "spi30"

            config WIZ_RST_PIN
                int "Reset PIN number"
                default 10

            config WIZ_IRQ_PIN
                int "IRQ PIN number"
                default 11
        endmenu
    endif

    config WIZ_USING_DHCP
        bool "Enable alloc IP address through DHCP"
        default y
      
    if !WIZ_USING_DHCP
    
        menu "WIZnet network configure"
        
            config WIZ_IPADDR
                string "IPv4: IP address"
                default 192.168.1.10

            config WIZ_GWADDR
                string "IPv4: Gateway address"
                default 192.168.1.1

            config WIZ_MSKADDR
                string "IPv4: Mask address"
                default 255.255.255.0    
        
        endmenu
        
    endif
    
    config WIZ_USING_PING
        bool "Enable Ping utility"
        default y

    config WIZ_DEBUG
        bool "Enable debug log output"
        default n
    
    choice
        prompt "Version"
        default PKG_USING_WIZNET_V100
        help
            Select the wiznet version

        config PKG_USING_WIZNET_V100
            bool "v1.0.0"

        config PKG_USING_WIZNET_LATEST_VERSION
            bool "latest"
    endchoice
  
    config PKG_WIZNET_VER
       string
       default "v1.0.0"    if PKG_USING_WIZNET_V100
       default "latest"    if PKG_USING_WIZNET_LATEST_VERSION

endif
```

## iot/wol/Kconfig
```kconfig
menuconfig PKG_USING_WOL
    bool "WOL: wake-on-lan package for rt-thread"
    default n
    select RT_USING_SAL             if RT_VER_NUM < 0x40100
    select SAL_USING_POSIX          if RT_VER_NUM < 0x40100
    select RT_USING_POSIX_SOCKET    if RT_VER_NUM >= 0x40100

if PKG_USING_WOL

    config PKG_WOL_PATH
        string
        default "/packages/iot/wol"

    choice
        prompt "Version"
        default PKG_USING_WOL_V100
        help
            Select the package version

        config PKG_USING_WOL_V100
            bool "v1.0.0"

        config PKG_USING_WOL_LATEST_VERSION
            bool "latest"
    endchoice

    config PKG_WOL_VER
       string
       default "v1.0.0"    if PKG_USING_WOL_V100
       default "latest"    if PKG_USING_WOL_LATEST_VERSION

endif
```

## iot/zFTP/Kconfig
```kconfig
# Kconfig file for package zFTP
menuconfig PKG_USING_ZFTP
    bool "ligth weight zFTP client"
    default n
    select RT_USING_SAL
    select SAL_USING_POSIX
    select RT_USING_DFS

if PKG_USING_ZFTP

    config PKG_ZFTP_PATH
        string
        default "/packages/iot/zFTP"

        config ZFTP_USING_SAMPLE
            bool "Enable zFTP samples"
            default n

    choice
        prompt "Version"
        default PKG_USING_ZFTP_LATEST_VERSION
        help
            Select the package version

        config PKG_USING_ZFTP_V10
            bool "V1.0"

        config PKG_USING_ZFTP_LATEST_VERSION
            bool "latest"
    endchoice

    config PKG_ZFTP_VER
       string
       default "V1.0"    if PKG_USING_ZFTP_V10
       default "latest"    if PKG_USING_ZFTP_LATEST_VERSION

endif
```

## iot/zb_coordinator/Kconfig
```kconfig
# Kconfig file for package zb_coordinator
menuconfig PKG_USING_ZB_COORDINATOR
    bool "Application of AT Command on ZigBee Coordinator."
    default n
    select RT_USING_AT
    select AT_USING_CLIENT

if PKG_USING_ZB_COORDINATOR

    config PKG_ZB_COORDINATOR_PATH
        string
        default "/packages/iot/zb_coordinator"

    choice
        prompt "Version"
        default PKG_USING_ZB_COORDINATOR_LATEST_VERSION
        help
            Select the package version

        config PKG_USING_ZB_COORDINATOR_V100
            bool "v1.0.0"

        config PKG_USING_ZB_COORDINATOR_LATEST_VERSION
            bool "latest"
    endchoice

    config PKG_ZB_COORDINATOR_VER
       string
       default "v1.0.0"    if PKG_USING_ZB_COORDINATOR_V100
       default "latest"    if PKG_USING_ZB_COORDINATOR_LATEST_VERSION

    config AT_MG21_SAMPLE_CLIENT_NAME
        string "the client name for at_mg21"
        default "uart2"
    config AT_MG21_SAMPLE_RECV_BUFF_LEN
        int "the buffer length for at_mg21"
        default 512

endif
```

## iot/zephyr_polling/Kconfig
```kconfig
# Kconfig file for package zephyr_polling
menuconfig PKG_USING_ZEPHYR_POLLING
    bool "zephyr_polling: Bluetooth BLE Stack."
    default n

if PKG_USING_ZEPHYR_POLLING

    config PKG_ZEPHYR_POLLING_PATH
        string
        default "/packages/iot/zephyr_polling"

    choice
        prompt "Version"
        default PKG_USING_ZEPHYR_POLLING_LATEST_VERSION
        help
            Select the package version

        config PKG_USING_ZEPHYR_POLLING_V100
            bool "v1.0.0"

        config PKG_USING_ZEPHYR_POLLING_LATEST_VERSION
            bool "latest"
    endchoice

    config PKG_ZEPHYR_POLLING_VER
        string
        default "v1.0.0"    if PKG_USING_ZEPHYR_POLLING_V100
        default "latest"    if PKG_USING_ZEPHYR_POLLING_LATEST_VERSION



    # chipset
    choice
        prompt "Select ChipSet"
        default PKG_ZEPHYR_POLLING_CHIPSET_COMMON
        help
            select the zephyr_polling chipset

        config PKG_ZEPHYR_POLLING_CHIPSET_ARTPI_AP6212
            bool "artpi_ap6212"

        config PKG_ZEPHYR_POLLING_CHIPSET_CSR8910
            bool "csr8910"

        config PKG_ZEPHYR_POLLING_CHIPSET_PTS_DONGLE
            bool "pts_dongle"

        config PKG_ZEPHYR_POLLING_CHIPSET_COMMON
            bool "common"

        config PKG_ZEPHYR_POLLING_CHIPSET_BLUENRG2
            bool "bluenrg2"

    endchoice


    config PKG_ZEPHYR_POLLING_CHIPSET
        string
        default "artpi_ap6212"    if PKG_ZEPHYR_POLLING_CHIPSET_ARTPI_AP6212
        default "csr8910"    if PKG_ZEPHYR_POLLING_CHIPSET_CSR8910
        default "pts_dongle"    if PKG_ZEPHYR_POLLING_CHIPSET_PTS_DONGLE
        default "common"    if PKG_ZEPHYR_POLLING_CHIPSET_COMMON
        default "bluenrg2"    if PKG_ZEPHYR_POLLING_CHIPSET_BLUENRG2






    # example
    choice
        prompt "Select Example"
        default PKG_ZEPHYR_POLLING_EXAMPLE_BEACON
        help
            select the zephyr_polling samples

        config PKG_ZEPHYR_POLLING_EXAMPLE_EMPTY
            bool "empty"

        config PKG_ZEPHYR_POLLING_EXAMPLE_BEACON
            bool "beacon"

        config PKG_ZEPHYR_POLLING_EXAMPLE_BROADCASTER
            bool "broadcaster"

        config PKG_ZEPHYR_POLLING_EXAMPLE_CENTRAL
            bool "central"

        config PKG_ZEPHYR_POLLING_EXAMPLE_CENTRAL_GATT_WRITE
            bool "central_gatt_write"

        config PKG_ZEPHYR_POLLING_EXAMPLE_CENTRAL_HR
            bool "central_hr"

        config PKG_ZEPHYR_POLLING_EXAMPLE_CENTRAL_HT
            bool "central_ht"

        config PKG_ZEPHYR_POLLING_EXAMPLE_EDDYSTONE
            bool "eddystone"

        config PKG_ZEPHYR_POLLING_EXAMPLE_IBEACON
            bool "ibeacon"

        config PKG_ZEPHYR_POLLING_EXAMPLE_OBSERVER
            bool "observer"

        config PKG_ZEPHYR_POLLING_EXAMPLE_PERIPHERAL
            bool "peripheral"

        config PKG_ZEPHYR_POLLING_EXAMPLE_PERIPHERAL_CSC
            bool "peripheral_csc"

        config PKG_ZEPHYR_POLLING_EXAMPLE_PERIPHERAL_DIS
            bool "peripheral_dis"

        config PKG_ZEPHYR_POLLING_EXAMPLE_PERIPHERAL_ESP
            bool "peripheral_esp"

        config PKG_ZEPHYR_POLLING_EXAMPLE_PERIPHERAL_GATT_WRITE
            bool "peripheral_gatt_write"

        config PKG_ZEPHYR_POLLING_EXAMPLE_PERIPHERAL_HIDS
            bool "peripheral_hids"

        config PKG_ZEPHYR_POLLING_EXAMPLE_PERIPHERAL_HR
            bool "peripheral_hr"

        config PKG_ZEPHYR_POLLING_EXAMPLE_PERIPHERAL_HT
            bool "peripheral_ht"

        config PKG_ZEPHYR_POLLING_EXAMPLE_PERIPHERAL_THROUGHPUT
            bool "peripheral_throughput"

    endchoice

    config PKG_ZEPHYR_POLLING_EXAMPLE
        string
        default "empty"    if PKG_ZEPHYR_POLLING_EXAMPLE_EMPTY
        default "beacon"    if PKG_ZEPHYR_POLLING_EXAMPLE_BEACON
        default "broadcaster"    if PKG_ZEPHYR_POLLING_EXAMPLE_BROADCASTER
        default "central"    if PKG_ZEPHYR_POLLING_EXAMPLE_CENTRAL
        default "central_gatt_write"    if PKG_ZEPHYR_POLLING_EXAMPLE_CENTRAL_GATT_WRITE
        default "central_hr"    if PKG_ZEPHYR_POLLING_EXAMPLE_CENTRAL_HR
        default "central_ht"    if PKG_ZEPHYR_POLLING_EXAMPLE_CENTRAL_HT
        default "eddystone"    if PKG_ZEPHYR_POLLING_EXAMPLE_EDDYSTONE
        default "ibeacon"    if PKG_ZEPHYR_POLLING_EXAMPLE_IBEACON
        default "observer"    if PKG_ZEPHYR_POLLING_EXAMPLE_OBSERVER
        default "peripheral"    if PKG_ZEPHYR_POLLING_EXAMPLE_PERIPHERAL
        default "peripheral_csc"    if PKG_ZEPHYR_POLLING_EXAMPLE_PERIPHERAL_CSC
        default "peripheral_dis"    if PKG_ZEPHYR_POLLING_EXAMPLE_PERIPHERAL_DIS
        default "peripheral_esp"    if PKG_ZEPHYR_POLLING_EXAMPLE_PERIPHERAL_ESP
        default "peripheral_gatt_write"    if PKG_ZEPHYR_POLLING_EXAMPLE_PERIPHERAL_GATT_WRITE
        default "peripheral_hids"    if PKG_ZEPHYR_POLLING_EXAMPLE_PERIPHERAL_HIDS
        default "peripheral_hr"    if PKG_ZEPHYR_POLLING_EXAMPLE_PERIPHERAL_HR
        default "peripheral_ht"    if PKG_ZEPHYR_POLLING_EXAMPLE_PERIPHERAL_HT
        default "peripheral_throughput"    if PKG_ZEPHYR_POLLING_EXAMPLE_PERIPHERAL_THROUGHPUT



    # porting
    choice
        prompt "Select Platform"
        default PKG_ZEPHYR_POLLING_PORT_RTTHREAD_UART
        help
            select the zephyr_polling chipset

        config PKG_ZEPHYR_POLLING_PORT_RTTHREAD_UART
            bool "rtthread_uart: generate uart interface"

        config PKG_ZEPHYR_POLLING_PORT_RTTHREAD_ARTPI
            bool "rtthread_artpi: use AP6212 in ArtPi"

        config PKG_ZEPHYR_POLLING_PORT_RTTHREAD_SPI_BLUENRG2
            bool "rtthread_spi_bluenrg2: use BLENRG2 with SPI"

    endchoice


    config PKG_ZEPHYR_POLLING_PORTING
        string
        default "rtthread_uart"    if PKG_ZEPHYR_POLLING_PORT_RTTHREAD_UART
        default "rtthread_artpi"    if PKG_ZEPHYR_POLLING_PORT_RTTHREAD_ARTPI
        default "rtthread_spi"    if PKG_ZEPHYR_POLLING_PORT_RTTHREAD_SPI_BLUENRG2




menu "HCI Transport Set"

    choice
        prompt "HCI Transport Select"
        default PKG_ZEPHYR_POLLING_HCI_USING_UART
        help
            Select the package version

        config PKG_ZEPHYR_POLLING_HCI_USING_UART
            bool "HCI Transport using rt-thread uart"

        config PKG_ZEPHYR_POLLING_HCI_USING_UART1
            bool "HCI Transport using rt-thread uart1"

        config PKG_ZEPHYR_POLLING_HCI_USING_SPI
            bool "HCI Transport using rt-thread spi"

    endchoice

    if PKG_ZEPHYR_POLLING_HCI_USING_UART
        config PKG_ZEPHYR_POLLING_HCI_UART_INDEX
            int "The uart index for HCI Transport"
            default 3 if PKG_ZEPHYR_POLLING_CHIPSET_ARTPI_AP6212
            default 1

        config PKG_ZEPHYR_POLLING_HCI_UART_BAUDRATE
            int "The uart index for HCI Transport"
            default 115200 if PKG_ZEPHYR_POLLING_CHIPSET_ARTPI_AP6212
            default 115200

        config PKG_ZEPHYR_POLLING_HCI_UART_BAUDRATE_FLOWCONTROL
            bool "Enable uart flowcontrol CTS/RTS"
            default y if PKG_ZEPHYR_POLLING_CHIPSET_ARTPI_AP6212
            default n
    endif

    if PKG_ZEPHYR_POLLING_HCI_USING_SPI
        config PKG_ZEPHYR_POLLING_HCI_SPI_BUS_INDEX
            int "The spi bus index for HCI Transport"
            default 1 if PKG_ZEPHYR_POLLING_CHIPSET_BLUENRG2
            default 1

        config PKG_ZEPHYR_POLLING_HCI_SPI_DEVICE_INDEX
            int "The spi bus index for HCI Transport"
            default 0 if PKG_ZEPHYR_POLLING_CHIPSET_BLUENRG2
            default 0

        config PKG_ZEPHYR_POLLING_HCI_SPI_BAUDRATE
            int "SPI Baudrate for HCI Transport"
            default 1000000 if PKG_ZEPHYR_POLLING_CHIPSET_BLUENRG2
            default 1000000

        config PKG_ZEPHYR_POLLING_HCI_SPI_DATA_WIDTH
            int "The spi data width for HCI Transport: 8bits, 16bits, 32bits"
            default 8 if PKG_ZEPHYR_POLLING_CHIPSET_BLUENRG2
            default 8

        config PKG_ZEPHYR_POLLING_HCI_SPI_CPHA
            int "The spi clock polarity(CPHA) for HCI Transport"
            default 1 if PKG_ZEPHYR_POLLING_CHIPSET_BLUENRG2
            default 0

        config PKG_ZEPHYR_POLLING_HCI_SPI_CPOL
            int "The spi clock polarity(CPOL) for HCI Transport"
            default 0 if PKG_ZEPHYR_POLLING_CHIPSET_BLUENRG2
            default 0

        config PKG_ZEPHYR_POLLING_HCI_SPI_IRQ_PIN_NUM
            int "The RT-Thread drv_gpio number of SPI IRQ PIN for HCI Transport"
            default 0 if PKG_ZEPHYR_POLLING_CHIPSET_BLUENRG2
            default 0

        config PKG_ZEPHYR_POLLING_HCI_SPI_CS_PIN_NUM
            int "The RT-Thread drv_gpio number of SPI CS PIN for HCI Transport"
            default 1 if PKG_ZEPHYR_POLLING_CHIPSET_BLUENRG2
            default 0

    endif

endmenu

endif
```

## language/JSON/Kconfig
```kconfig
menu "JSON: JavaScript Object Notation, a lightweight data-interchange format"

source "$PKGS_DIR/packages/language/JSON/cJSON/Kconfig"
source "$PKGS_DIR/packages/language/JSON/ljson/Kconfig"
source "$PKGS_DIR/packages/language/JSON/rt_cjson_tools/Kconfig"
source "$PKGS_DIR/packages/language/JSON/rapidjson/Kconfig"
source "$PKGS_DIR/packages/language/JSON/jsmn/Kconfig"
source "$PKGS_DIR/packages/language/JSON/agile_jsmn/Kconfig"
source "$PKGS_DIR/packages/language/JSON/parson/Kconfig"
source "$PKGS_DIR/packages/language/JSON/RyanJson/Kconfig"

endmenu
```
