## system/POSIX/ctypes/Kconfig
```kconfig
# Kconfig file for package ctypes
menuconfig PKG_USING_POSIX_CTYPES
    bool "Extension POSIX ctype.h functions (POSIX.1-2001, POSIX.1-2008)"
    default n

if PKG_USING_POSIX_CTYPES

    config PKG_POSIX_CTYPES_PATH
        string
        default "/packages/system/POSIX/ctypes"
 
    config PKG_POSIX_CTYPES_VER
       string
       default "latest"

endif
```

## system/POSIX/getline/Kconfig
```kconfig
# Kconfig file for package getline
menuconfig PKG_USING_POSIX_GETLINE
    bool "Enable getline/getdelim (IEEE Std 1003.1-2008)"
    select RT_USING_POSIX_FS
    select RT_USING_POSIX_STDIO
    default n

if PKG_USING_POSIX_GETLINE

    config PKG_POSIX_GETLINE_PATH
        string
        default "/packages/system/POSIX/getline"
          
    config PKG_POSIX_GETLINE_VER
       string
       default "latest"

endif
```

## system/POSIX/itoa/Kconfig
```kconfig
# Kconfig file for package itoa
menuconfig PKG_USING_POSIX_ITOA
    bool "Enable itoa family (non-standard POSIX)"
    default n

if PKG_USING_POSIX_ITOA

    config PKG_POSIX_ITOA_PATH
        string
        default "/packages/system/POSIX/itoa"

    config PKG_POSIX_ITOA_VER
       string
       default "latest"

endif
```

## system/POSIX/strings/Kconfig
```kconfig
# Kconfig file for package strings
menuconfig PKG_USING_POSIX_STRINGS
    bool "Extension POSIX string.h functions (4.3BSD, POSIX.1-2001)"
    default n

if PKG_USING_POSIX_STRINGS

    config PKG_POSIX_STRINGS_PATH
        string
        default "/packages/system/POSIX/strings"

    config PKG_POSIX_STRINGS_VER
       string
       default "latest"

endif
```

## system/POSIX/wcwidth/Kconfig
```kconfig
# Kconfig file for package wcwidth
menuconfig PKG_USING_POSIX_WCWIDTH
    bool "Enable wcwidth (POSIX.1-2001, POSIX.1-2008)"
    default n

if PKG_USING_POSIX_WCWIDTH

    config PKG_POSIX_WCWIDTH_PATH
        string
        default "/packages/system/POSIX/wcwidth"

    config PKG_POSIX_WCWIDTH_VER
       string
       default "latest"

endif
```

## system/Ppool/Kconfig
```kconfig
# Kconfig file for package Ppool
menuconfig PKG_USING_PPOOL
    bool "Ppool: Pthread-based thread pool library"
    default n
    select RT_USING_PTHREADS

if PKG_USING_PPOOL

    config PKG_PPOOL_PATH
        string
        default "/packages/system/Ppool"

    choice
        prompt "Version"
        default PKG_USING_PPOOL_LATEST_VERSION
        help
            Select the package version

        config PKG_USING_PPOOL_LATEST_VERSION
            bool "latest"
    endchoice

    config PKG_PPOOL_VER
       string
       default "latest"    if PKG_USING_PPOOL_LATEST_VERSION

endif
```

## system/RTduino/Kconfig
```kconfig
# Kconfig file for package RTduino
menuconfig PKG_USING_RTDUINO
    bool "RTduino: Arduino Ecological Compatibility Layer"
    select RT_USING_CPLUSPLUS
    select RT_USING_CPUTIME
    default n
    depends on RT_VER_NUM > 0x40100

if PKG_USING_RTDUINO

    config PKG_RTDUINO_PATH
        string
        default "/packages/system/RTduino"

    config RTDUINO_THREAD_SIZE
        int "Arduino thread's size"
        default 1024

    config RTDUINO_THREAD_PRIO
        int "Arduino thread's priority"
        default 6 if RT_THREAD_PRIORITY_8
        default 30  if RT_THREAD_PRIORITY_32
        default 254  if RT_THREAD_PRIORITY_256

    config RTDUINO_NO_SETUP_LOOP
        bool "Don't use setup-loop structure"
        default n

    config RTDUINO_USING_WIRE
        bool "Enable wire library <Wire.h>"
        select RT_USING_I2C
        default n

    config RTDUINO_WIRE_BUFFER_LENGTH
        int "Wire buffer"
        depends on RTDUINO_USING_WIRE
        default 32
        range 0 512

    config RTDUINO_USING_SPI
        bool "Enable SPI library <SPI.h>"
        select RT_USING_SPI
        default n

    config RTDUINO_USING_SERVO
        bool "Enable servo library <Servo.h>"
        default n

    config RTDUINO_USING_USBSERIAL
        bool "Enable USB Serial"
        select PKG_USING_TINYUSB
        select PKG_TINYUSB_DEVICE_ENABLE
        select PKG_TINYUSB_DEVICE_CDC
        default n

    config RTDUINO_USING_ADAFRUIT
        bool "Enable Adafruit sensor framework"
        select RTDUINO_USING_WIRE
        default n

    config RTDUINO_USING_MSTIMER2
        bool "Enable MsTimer2 library"
        select RT_USING_TIMER_SOFT
        default n

    choice
        prompt "Version"
        default PKG_USING_RTDUINO_LATEST_VERSION
        help
            Select the package version

        config PKG_USING_RTDUINO_LATEST_VERSION
            bool "latest"
    endchoice

    config PKG_RTDUINO_VER
       string
       default "latest"    if PKG_USING_RTDUINO_LATEST_VERSION

endif
```

## system/TFDB/Kconfig
```kconfig
# Kconfig file for package TFDB
menuconfig PKG_USING_TFDB
    bool "Tiny Flash Database for MCU"
    default n

if PKG_USING_TFDB

    config PKG_TFDB_PATH
        string
        default "/packages/system/TFDB"

    choice
        prompt "Version"
        default PKG_USING_TFDB_LATEST_VERSION
        help
            Select the package version

        config PKG_USING_TFDB_V006
            bool "v0.0.6"

        config PKG_USING_TFDB_V005
            bool "v0.0.5"

        config PKG_USING_TFDB_LATEST_VERSION
            bool "latest"
    endchoice

    config PKG_TFDB_VER
       string
       default "v0.0.6"    if PKG_USING_TFDB_V006
       default "v0.0.5"    if PKG_USING_TFDB_V005
       default "latest"    if PKG_USING_TFDB_LATEST_VERSION

endif
```

## system/TaskMsgBus/Kconfig
```kconfig
# Kconfig file for package TaskMsgBus
menuconfig PKG_USING_TASK_MSG_BUS
  bool "TaskMsgBus: For sending and receiving text/object messages between threads"
  default n

if PKG_USING_TASK_MSG_BUS
    config TASK_MSG_THREAD_STACK_SIZE
        int "task message thread stack size"
        default 512
    config TASK_MSG_THREAD_PRIORITY
        int "task message thread priority"
        default 5
    config TASK_MSG_USER_DEF
        bool "task msg name define in user file 'task_msg_user_def.h'"
        default y
    config TASK_MSG_USING_DYNAMIC_MEMORY
      bool "task msg object using dynamic memory"
      default n
    config PKG_USING_TASK_MSG_BUS_SAMPLE
      bool "Enable TaskMsgBus Sample"
      default y
      select TASK_MSG_NAME_USER_DEF
      select RT_USING_ULOG

    config PKG_TASKMSGBUS_PATH
      string
      default "/packages/system/TaskMsgBus"

    choice
      prompt "Version"
      default PKG_USING_TASKMSGBUS_LATEST_VERSION
      help
        Select the package version
      config PKG_USING_TASKMSGBUS_V301
        bool "v3.0.1"
      config PKG_USING_TASKMSGBUS_LATEST_VERSION
        bool "latest"
    endchoice

    config PKG_TASKMSGBUS_VER
      string
        default "v3.0.1"    if PKG_USING_TASKMSGBUS_V301
      default "latest"    if PKG_USING_TASKMSGBUS_LATEST_VERSION
endif
```

## system/TinyUSB/Kconfig
```kconfig
# Kconfig file for package TinyUSB
menuconfig PKG_USING_TINYUSB
    bool "TinyUSB: an open source cross-platform USB stack for embedded system"
    default n
    select RT_USING_SEMAPHORE
    select RT_USING_MUTEX
    select RT_USING_MESSAGEQUEUE
    select RT_USING_USB

if PKG_USING_TINYUSB
    config PKG_TINYUSB_PATH
        string
        default "/packages/system/TinyUSB"

    config PKG_TINYUSB_STACK_SIZE
        int "TinyUSB thread stack size"
        default 2048

    config PKG_TINYUSB_THREAD_PRIORITY
        int "TinyUSB thread priority"
        default 8

    config PKG_TINYUSB_MEM_SECTION
        string "Memory section name"
        default ".noncacheable" if SOC_HPM6000
        default ".data"

    config PKG_TINYUSB_MEM_ALIGN
        int "Memory align size"
        default 4

    choice
        prompt "Port number"
        default PKG_TINYUSB_RHPORT_NUM_1

        config PKG_TINYUSB_RHPORT_NUM_1
            bool "1"

        config PKG_TINYUSB_RHPORT_NUM_2
            bool "2"
    endchoice

    config PKG_TINYUSB_RHPORT_NUM
        int
        default 0 if PKG_TINYUSB_RHPORT_NUM_1
        default 1 if PKG_TINYUSB_RHPORT_NUM_2

    choice
        prompt "Port speed"
        default PKG_TINYUSB_FULL_SPEED

        config PKG_TINYUSB_FULL_SPEED
            bool "Full Speed"

        config PKG_TINYUSB_HIGH_SPEED
            bool "High Speed"
    endchoice

    config PKG_TINYUSB_DEVICE_PORT_SPEED
        hex
        default 0x0200 if PKG_TINYUSB_FULL_SPEED
        default 0x0400 if PKG_TINYUSB_HIGH_SPEED

    menuconfig PKG_TINYUSB_DEVICE_ENABLE
        bool "Using USB device"
        default n

    if PKG_TINYUSB_DEVICE_ENABLE
        config PKG_TINYUSB_DEVICE_VID
            hex "Device Vendor ID"
            default 0xCAFE

        config PKG_TINYUSB_DEVICE_PID
            hex "Device Product ID"
            default 0x4000

        config PKG_TINYUSB_DEVICE_MANUFACTURER
            string "Manufacturer name"
            default "TinyUSB"

        config PKG_TINYUSB_DEVICE_PRODUCT
            string "Device name"
            default "TinyUSB Device"

        config PKG_TINYUSB_EDPT0_SIZE
            int "Endpoint 0 size"
            default 64

        config PKG_TINYUSB_DEVICE_CURRENT
            int "Maximum current (mA)"
            default 100

        menuconfig PKG_TINYUSB_DEVICE_CDC
            bool "Using Communication Device Class (CDC)"
            default n

        if PKG_TINYUSB_DEVICE_CDC
            config CFG_TUD_CDC
                int
                default 1

            config PKG_TINYUSB_DEVICE_CDC_STRING
                string "Description of CDC"
                default "TinyUSB CDC"

            config PKG_TINYUSB_DEVICE_CDC_EPNUM_NOTIF
                int "Notification endpoint number"
                default 1

            config PKG_TINYUSB_DEVICE_CDC_EPNUM
                int "Endpoint number"
                default 2

            config PKG_TINYUSB_DEVICE_CDC_RX_BUFSIZE
                int "Rx buffer size"
                default 64

            config PKG_TINYUSB_DEVICE_CDC_TX_BUFSIZE
                int "Tx buffer size"
                default 64
        endif

        menuconfig PKG_TINYUSB_DEVICE_MSC
            bool "Using Mass Storage Class (MSC)"
            default n

        if PKG_TINYUSB_DEVICE_MSC
            config CFG_TUD_MSC
                int
                default 1

            config PKG_TINYUSB_DEVICE_MSC_STRING
                string "Description of MSC"
                default "TinyUSB MSC"

            config PKG_TINYUSB_DEVICE_MSC_VID
                string "SCSI VID"
                default "TinyUSB"

            config PKG_TINYUSB_DEVICE_MSC_PID
                string "SCSI PID"
                default "Mass Storage"

            config PKG_TINYUSB_DEVICE_MSC_REV
                string "SCSI Product revision"
                default "1.0"

            config PKG_TINYUSB_DEVICE_MSC_EPNUM
                int "Endpoint number"
                default 3

            config PKG_TINYUSB_DEVICE_MSC_EP_BUFSIZE
                int "Endpoint buffer size"
                default 4096

            config PKG_TINYUSB_DEVICE_MSC_NAME
                string "The name of the block device used by MSC"
                default "norflash0"
        endif

        menuconfig PKG_TINYUSB_DEVICE_HID
            bool "Using Human Interface Device (HID)"
            default n

        if PKG_TINYUSB_DEVICE_HID
            config CFG_TUD_HID
                int
                default 1

            config PKG_TINYUSB_DEVICE_HID_STRING
                string "Description of HID"
                default "TinyUSB HID"

            config PKG_TINYUSB_DEVICE_HID_EPNUM
                int "Endpoint number"
                default 4

            config PKG_TINYUSB_DEVICE_HID_INT
                int "Polling interval (ms)"
                default 5

            config PKG_TINYUSB_DEVICE_HID_KEYBOARD
                bool "Keyboard report"
                default n

            config PKG_TINYUSB_DEVICE_HID_MOUSE
                bool "Mouse report"
                default n

            config PKG_TINYUSB_DEVICE_HID_GAMEPAD
                bool "Gamepad report"
                default n

            config PKG_TINYUSB_DEVICE_HID_CONSUMER
                bool "Consumer control report"
                default n

            config PKG_TINYUSB_DEVICE_HID_EP_BUFSIZE
                int "Endpoint buffer size"
                default 16
        endif

        config PKG_TINYUSB_DEVICE_EXAMPLE
            bool "Enable USB device example"
            default n

        if PKG_TINYUSB_DEVICE_EXAMPLE
            config PKG_TINYUSB_DEVICE_EXAMPLE_CDC
                bool "CDC device"
                default n
                select PKG_TINYUSB_DEVICE_CDC

            config PKG_TINYUSB_DEVICE_EXAMPLE_HID
                bool "HID device"
                default n
                select PKG_TINYUSB_DEVICE_HID
                select PKG_TINYUSB_DEVICE_HID_KEYBOARD
                select PKG_TINYUSB_DEVICE_HID_MOUSE
        endif
    endif

    menuconfig PKG_TINYUSB_HOST_ENABLE
        bool "Using USB Host"
        default n

    if PKG_TINYUSB_HOST_ENABLE
        config PKG_TINYUSB_HOST_PORT
            int "BOARD_TUH_RHPORT"
            default 0

        config PKG_TINYUSB_HOST_PORT_SPEED
            hex
            default 0x0200 if PKG_TINYUSB_FULL_SPEED
            default 0x0400 if PKG_TINYUSB_HIGH_SPEED
    endif

    choice
        prompt "TinyUSB debug level"
        default PKG_TINYUSB_DEBUG_NO

        config PKG_TINYUSB_DEBUG_NO
            bool "No debug"
        config PKG_TINYUSB_DEBUG_ERROR
            bool "Error"
        config PKG_TINYUSB_DEBUG_WARNING
            bool "Warning"
        config PKG_TINYUSB_DEBUG_INFO
            bool "Info"
    endchoice

    config CFG_TUSB_DEBUG
        int
        default 0 if PKG_TINYUSB_DEBUG_NO
        default 1 if PKG_TINYUSB_DEBUG_ERROR
        default 2 if PKG_TINYUSB_DEBUG_WARNING
        default 3 if PKG_TINYUSB_DEBUG_INFO

    choice
        prompt "Version"
        help
            Select the package version

        config PKG_USING_TINYUSB_V01401
            bool "v0.14.1"

        config PKG_USING_TINYUSB_V01400
            bool "v0.14.0"

        config PKG_USING_TINYUSB_V01301
            bool "v0.13.1"

        config PKG_USING_TINYUSB_V01300
            bool "v0.13.0"

        config PKG_USING_TINYUSB_LATEST_VERSION
            bool "latest"
    endchoice

    config PKG_TINYUSB_VER
       string
       default "latest"  if PKG_USING_TINYUSB_LATEST_VERSION
       default "v0.14.0" if PKG_USING_TINYUSB_V01400
       default "v0.14.1" if PKG_USING_TINYUSB_V01401
       default "v0.13.0" if PKG_USING_TINYUSB_V01300
       default "v0.13.1" if PKG_USING_TINYUSB_V01301

endif
```

## system/UartFramework/Kconfig
```kconfig
# Kconfig file for package UartFramework
menuconfig PKG_USING_UART_FRAMEWORK
    bool "UartFramework: Serial communication framework software package based on RT thread."
    default n

if PKG_USING_UART_FRAMEWORK
    config PKG_UART_FRAMEWORK_PATH
        string
        default "/packages/system/UartFramework"

    choice
        prompt "Version"
        default PKG_USING_UART_FRAMEWORK_LATEST_VERSION
        help
            Select the package version

        config PKG_USING_UART_FRAMEWORK_V001
            bool "v0.0.1"
        config PKG_USING_UART_FRAMEWORK_LATEST_VERSION
            bool "latest"
    endchoice
          
    config PKG_UART_FRAMEWORK_VER
       string
       default "v0.0.1"    if PKG_USING_UART_FRAMEWORK_V001
       default "latest"    if PKG_USING_UART_FRAMEWORK_LATEST_VERSION

endif
```
