## arduino/sensors/Adafruit-MAX1704X/Kconfig
```kconfig
# Kconfig file for package Adafruit-MAX1704X
menuconfig PKG_USING_ARDUINO_ADAFRUIT_MAX1704X
    bool "Adafruit MAX1704X: MAX17048/MAX17049 battery monitor driver"
    select PKG_USING_RTDUINO
    select RTDUINO_USING_WIRE
    select PKG_USING_ARDUINO_ADAFRUIT_SENSOR
    select PKG_USING_ARDUINO_ADAFRUIT_BUSIO
    default n

if PKG_USING_ARDUINO_ADAFRUIT_MAX1704X

    config PKG_ARDUINO_ADAFRUIT_MAX1704X_PATH
        string
        default "/packages/arduino/sensors/Adafruit-MAX1704X"

    choice
        prompt "Version"
        default PKG_USING_ARDUINO_ADAFRUIT_MAX1704X_LATEST_VERSION
        help
            Select the package version

        config PKG_USING_ARDUINO_ADAFRUIT_MAX1704X_LATEST_VERSION
            bool "latest"
    endchoice

    config PKG_ARDUINO_ADAFRUIT_MAX1704X_VER
       string
       default "latest"    if PKG_USING_ARDUINO_ADAFRUIT_MAX1704X_LATEST_VERSION

endif
```

## arduino/sensors/Adafruit-MAX31850/Kconfig
```kconfig
# Kconfig file for package Adafruit-MAX31850
menuconfig PKG_USING_ARDUINO_ADAFRUIT_MAX31850
    bool "Adafruit MAX31850: Thermocouple Amplifier"
    select PKG_USING_RTDUINO
    select RTDUINO_USING_WIRE
    default n

if PKG_USING_ARDUINO_ADAFRUIT_MAX31850

    config PKG_ARDUINO_ADAFRUIT_MAX31850_PATH
        string
        default "/packages/arduino/sensors/Adafruit-MAX31850"

    choice
        prompt "Version"
        default PKG_USING_ARDUINO_ADAFRUIT_MAX31850_LATEST_VERSION
        help
            Select the package version

        config PKG_USING_ARDUINO_ADAFRUIT_MAX31850_LATEST_VERSION
            bool "latest"
    endchoice

    config PKG_ARDUINO_ADAFRUIT_MAX31850_VER
       string
       default "latest"    if PKG_USING_ARDUINO_ADAFRUIT_MAX31850_LATEST_VERSION

endif
```

## arduino/sensors/Adafruit-MAX31855/Kconfig
```kconfig
# Kconfig file for package Adafruit-MAX31855
menuconfig PKG_USING_ARDUINO_ADAFRUIT_MAX31855
    bool "Adafruit MAX31855: Thermocouple Amplifier"
    select PKG_USING_RTDUINO
    select RTDUINO_USING_SPI
    select PKG_USING_ARDUINO_ADAFRUIT_BUSIO
    default n

if PKG_USING_ARDUINO_ADAFRUIT_MAX31855

    config PKG_ADAFRUIT_MAX31855_PATH
        string
        default "/packages/arduino/sensors/Adafruit-MAX31855"

    choice
        prompt "Version"
        default PKG_USING_ARDUINO_ADAFRUIT_MAX31855_LATEST_VERSION
        help
            Select the package version

        config PKG_USING_ARDUINO_ADAFRUIT_MAX31855_LATEST_VERSION
            bool "latest"
    endchoice

    config PKG_ADAFRUIT_MAX31855_VER
       string
       default "latest"    if PKG_USING_ARDUINO_ADAFRUIT_MAX31855_LATEST_VERSION

endif
```

## arduino/sensors/Adafruit-MAX31856/Kconfig
```kconfig
# Kconfig file for package Adafruit-MAX31856
menuconfig PKG_USING_ARDUINO_ADAFRUIT_MAX31856
    bool "Adafruit MAX31856: Universal Thermocouple Amplifier"
    select PKG_USING_RTDUINO
    select RTDUINO_USING_SPI
    select PKG_USING_ARDUINO_ADAFRUIT_BUSIO
    default n

if PKG_USING_ARDUINO_ADAFRUIT_MAX31856

    config PKG_ARDUINO_ADAFRUIT_MAX31856_PATH
        string
        default "/packages/arduino/sensors/Adafruit-MAX31856"

    choice
        prompt "Version"
        default PKG_USING_ARDUINO_ADAFRUIT_MAX31856_LATEST_VERSION
        help
            Select the package version

        config PKG_USING_ARDUINO_ADAFRUIT_MAX31856_LATEST_VERSION
            bool "latest"
    endchoice

    config PKG_ARDUINO_ADAFRUIT_MAX31856_VER
       string
       default "latest"    if PKG_USING_ARDUINO_ADAFRUIT_MAX31856_LATEST_VERSION

endif
```

## arduino/sensors/Adafruit-MAX31865/Kconfig
```kconfig
# Kconfig file for package Adafruit-MAX31865
menuconfig PKG_USING_ARDUINO_ADAFRUIT_MAX31865
    bool "MAX31865 thermocouple sensor driver library"
    select PKG_USING_RTDUINO
    select RTDUINO_USING_SPI
    select PKG_USING_ARDUINO_ADAFRUIT_BUSIO
    default n

if PKG_USING_ARDUINO_ADAFRUIT_MAX31865

    config PKG_ARDUINO_ADAFRUIT_MAX31865_PATH
        string
        default "/packages/arduino/sensors/Adafruit-MAX31865"

    choice
        prompt "Version"
        default PKG_USING_ARDUINO_ADAFRUIT_MAX31865_LATEST_VERSION
        help
            Select the package version

        config PKG_USING_ARDUINO_ADAFRUIT_MAX31865_LATEST_VERSION
            bool "latest"
    endchoice

    config PKG_ARDUINO_ADAFRUIT_MAX31865_VER
       string
       default "latest"    if PKG_USING_ARDUINO_ADAFRUIT_MAX31865_LATEST_VERSION

endif
```

## arduino/sensors/Adafruit-MAX6675/Kconfig
```kconfig
# Kconfig file for package Adafruit-MAX6675
menuconfig PKG_USING_ARDUINO_ADAFRUIT_MAX6675
    bool "Adafruit MAX6675: Thermocouple Amplifier."
    select PKG_USING_RTDUINO
    default n

if PKG_USING_ARDUINO_ADAFRUIT_MAX6675

    config PKG_ARDUINO_ADAFRUIT_MAX6675_PATH
        string
        default "/packages/arduino/sensors/Adafruit-MAX6675"

    choice
        prompt "Version"
        default PKG_USING_ARDUINO_ADAFRUIT_MAX6675_LATEST_VERSION
        help
            Select the package version

        config PKG_USING_ARDUINO_ADAFRUIT_MAX6675_LATEST_VERSION
            bool "latest"
    endchoice

    config PKG_ARDUINO_ADAFRUIT_MAX6675_VER
       string
       default "latest"    if PKG_USING_ARDUINO_ADAFRUIT_MAX6675_LATEST_VERSION

endif
```

## arduino/sensors/Adafruit-MCP4728/Kconfig
```kconfig
# Kconfig file for package Adafruit-MCP4728
menuconfig PKG_USING_ARDUINO_ADAFRUIT_MCP4728
    bool "Adafruit MCP4728: 4-Channel 12-Bit I2C DAC"
    select PKG_USING_RTDUINO
    select RTDUINO_USING_WIRE
    select PKG_USING_ARDUINO_ADAFRUIT_BUSIO
    default n

if PKG_USING_ARDUINO_ADAFRUIT_MCP4728

    config PKG_ARDUINO_ADAFRUIT_MCP4728_PATH
        string
        default "/packages/arduino/sensors/Adafruit-MCP4728"

    choice
        prompt "Version"
        default PKG_USING_ARDUINO_ADAFRUIT_MCP4728_LATEST_VERSION
        help
            Select the package version

        config PKG_USING_ARDUINO_ADAFRUIT_MCP4728_LATEST_VERSION
            bool "latest"
    endchoice

    config PKG_ARDUINO_ADAFRUIT_MCP4728_VER
       string
       default "latest"    if PKG_USING_ARDUINO_ADAFRUIT_MCP4728_LATEST_VERSION

endif
```

## arduino/sensors/Adafruit-MCP9600/Kconfig
```kconfig
# Kconfig file for package Adafruit-MCP9600
menuconfig PKG_USING_ARDUINO_ADAFRUIT_MCP9600
    bool "Adafruit MCP9600 I2C Thermocouple ADC sensor"
    select PKG_USING_RTDUINO
    select RTDUINO_USING_WIRE
    select PKG_USING_ARDUINO_ADAFRUIT_BUSIO
    default n

if PKG_USING_ARDUINO_ADAFRUIT_MCP9600

    config PKG_ARDUINO_ADAFRUIT_MCP9600_PATH
        string
        default "/packages/arduino/sensors/Adafruit-MCP9600"

    choice
        prompt "Version"
        default PKG_USING_ARDUINO_ADAFRUIT_MCP9600_LATEST_VERSION
        help
            Select the package version

        config PKG_USING_ARDUINO_ADAFRUIT_MCP9600_LATEST_VERSION
            bool "latest"
    endchoice

    config PKG_ARDUINO_ADAFRUIT_MCP9600_VER
       string
       default "latest"    if PKG_USING_ARDUINO_ADAFRUIT_MCP9600_LATEST_VERSION

endif
```

## arduino/sensors/Adafruit-MCP9808/Kconfig
```kconfig
# Kconfig file for package Adafruit-MCP9808
menuconfig PKG_USING_ARDUINO_ADAFRUIT_MCP9808
    bool "Adafruit MCP9808 Precision I2C Temperature Sensor"
    select PKG_USING_RTDUINO
    select RTDUINO_USING_WIRE
    select PKG_USING_ARDUINO_ADAFRUIT_BUSIO
    select PKG_USING_ARDUINO_ADAFRUIT_SENSOR
    default n

if PKG_USING_ARDUINO_ADAFRUIT_MCP9808

    config PKG_ARDUINO_ADAFRUIT_MCP9808_PATH
        string
        default "/packages/arduino/sensors/Adafruit-MCP9808"

    choice
        prompt "Version"
        default PKG_USING_ARDUINO_ADAFRUIT_MCP9808_LATEST_VERSION
        help
            Select the package version

        config PKG_USING_ARDUINO_ADAFRUIT_MCP9808_LATEST_VERSION
            bool "latest"
    endchoice

    config PKG_ARDUINO_ADAFRUIT_MCP9808_VER
       string
       default "latest"    if PKG_USING_ARDUINO_ADAFRUIT_MCP9808_LATEST_VERSION

endif
```

## arduino/sensors/Adafruit-MLX90393/Kconfig
```kconfig
# Kconfig file for package Adafruit-MLX90393
menuconfig PKG_USING_ARDUINO_ADAFRUIT_MLX90393
    bool "Adafruit MLX90393: Magnetic Field Sensor"
    select PKG_USING_RTDUINO
    select RTDUINO_USING_WIRE
    select RTDUINO_USING_SPI
    select PKG_USING_ARDUINO_ADAFRUIT_SENSOR
    select PKG_USING_ARDUINO_ADAFRUIT_BUSIO
    default n

if PKG_USING_ARDUINO_ADAFRUIT_MLX90393

    config PKG_ARDUINO_ADAFRUIT_MLX90393_PATH
        string
        default "/packages/arduino/sensors/Adafruit-MLX90393"

    choice
        prompt "Version"
        default PKG_USING_ARDUINO_ADAFRUIT_MLX90393_LATEST_VERSION
        help
            Select the package version

        config PKG_USING_ARDUINO_ADAFRUIT_MLX90393_LATEST_VERSION
            bool "latest"
    endchoice

    config PKG_ARDUINO_ADAFRUIT_MLX90393_VER
       string
       default "latest"    if PKG_USING_ARDUINO_ADAFRUIT_MLX90393_LATEST_VERSION

endif
```

## arduino/sensors/Adafruit-MLX90395/Kconfig
```kconfig
# Kconfig file for package Adafruit-MLX90395
menuconfig PKG_USING_ARDUINO_ADAFRUIT_MLX90395
    bool "Adafruit MLX90395: Magnetic Field Sensor"
    select PKG_USING_RTDUINO
    select RTDUINO_USING_WIRE
    select RTDUINO_USING_SPI
    select PKG_USING_ARDUINO_ADAFRUIT_SENSOR
    select PKG_USING_ARDUINO_ADAFRUIT_BUSIO
    default n

if PKG_USING_ARDUINO_ADAFRUIT_MLX90395

    config PKG_ARDUINO_ADAFRUIT_MLX90395_PATH
        string
        default "/packages/arduino/sensors/Adafruit-MLX90395"

    choice
        prompt "Version"
        default PKG_USING_ARDUINO_ADAFRUIT_MLX90395_LATEST_VERSION
        help
            Select the package version

        config PKG_USING_ARDUINO_ADAFRUIT_MLX90395_LATEST_VERSION
            bool "latest"
    endchoice

    config PKG_ARDUINO_ADAFRUIT_MLX90395_VER
       string
       default "latest"    if PKG_USING_ARDUINO_ADAFRUIT_MLX90395_LATEST_VERSION

endif
```

## arduino/sensors/Adafruit-MLX90614/Kconfig
```kconfig
# Kconfig file for package Adafruit-MLX90614
menuconfig PKG_USING_ARDUINO_ADAFRUIT_MLX90614
    bool "Adafruit MLX90614: Temperature Sensor"
    select PKG_USING_RTDUINO
    select RTDUINO_USING_WIRE
    select PKG_USING_ARDUINO_ADAFRUIT_BUSIO
    default n

if PKG_USING_ARDUINO_ADAFRUIT_MLX90614

    config PKG_ARDUINO_ADAFRUIT_MLX90614_PATH
        string
        default "/packages/arduino/sensors/Adafruit-MLX90614"

    choice
        prompt "Version"
        default PKG_USING_ARDUINO_ADAFRUIT_MLX90614_LATEST_VERSION
        help
            Select the package version

        config PKG_USING_ARDUINO_ADAFRUIT_MLX90614_LATEST_VERSION
            bool "latest"
    endchoice

    config PKG_ARDUINO_ADAFRUIT_MLX90614_VER
       string
       default "latest"    if PKG_USING_ARDUINO_ADAFRUIT_MLX90614_LATEST_VERSION

endif
```

## arduino/sensors/Adafruit-MLX90640/Kconfig
```kconfig
# Kconfig file for package Adafruit-MLX90640
menuconfig PKG_USING_ARDUINO_ADAFRUIT_MLX90640
    bool "Adafruit MLX90640: IR Thermal Camera"
    select PKG_USING_RTDUINO
    select RTDUINO_USING_WIRE
    select PKG_USING_ARDUINO_ADAFRUIT_BUSIO
    default n

if PKG_USING_ARDUINO_ADAFRUIT_MLX90640

    config PKG_ARDUINO_ADAFRUIT_MLX90640_PATH
        string
        default "/packages/arduino/sensors/Adafruit-MLX90640"

    choice
        prompt "Version"
        default PKG_USING_ARDUINO_ADAFRUIT_MLX90640_LATEST_VERSION
        help
            Select the package version

        config PKG_USING_ARDUINO_ADAFRUIT_MLX90640_LATEST_VERSION
            bool "latest"
    endchoice

    config PKG_ARDUINO_ADAFRUIT_MLX90640_VER
       string
       default "latest"    if PKG_USING_ARDUINO_ADAFRUIT_MLX90640_LATEST_VERSION

endif
```

## arduino/sensors/Adafruit-MMA8451/Kconfig
```kconfig
# Kconfig file for package Adafruit-MMA8451
menuconfig PKG_USING_ARDUINO_ADAFRUIT_MMA8451
    bool "Adafruit MMA8451: Accelerometer Sensor"
    select PKG_USING_RTDUINO
    select RTDUINO_USING_WIRE
    select PKG_USING_ARDUINO_ADAFRUIT_SENSOR
    select PKG_USING_ARDUINO_ADAFRUIT_BUSIO
    default n

if PKG_USING_ARDUINO_ADAFRUIT_MMA8451

    config PKG_ARDUINO_ADAFRUIT_MMA8451_PATH
        string
        default "/packages/arduino/sensors/Adafruit-MMA8451"

    choice
        prompt "Version"
        default PKG_USING_ARDUINO_ADAFRUIT_MMA8451_LATEST_VERSION
        help
            Select the package version

        config PKG_USING_ARDUINO_ADAFRUIT_MMA8451_LATEST_VERSION
            bool "latest"
    endchoice

    config PKG_ARDUINO_ADAFRUIT_MMA8451_VER
       string
       default "latest"    if PKG_USING_ARDUINO_ADAFRUIT_MMA8451_LATEST_VERSION

endif
```

## arduino/sensors/Adafruit-MMC56x3/Kconfig
```kconfig
# Kconfig file for package Adafruit-MMC56x3
menuconfig PKG_USING_ARDUINO_ADAFRUIT_MMC56X3
    bool "Adafruit MMC56x3: MMC5603/MMC5613 Magnetometer Sensor"
    select PKG_USING_RTDUINO
    select RTDUINO_USING_WIRE
    select PKG_USING_ARDUINO_ADAFRUIT_SENSOR
    select PKG_USING_ARDUINO_ADAFRUIT_BUSIO
    default n

if PKG_USING_ARDUINO_ADAFRUIT_MMC56X3

    config PKG_ARDUINO_ADAFRUIT_MMC56X3_PATH
        string
        default "/packages/arduino/sensors/Adafruit-MMC56x3"

    choice
        prompt "Version"
        default PKG_USING_ARDUINO_ADAFRUIT_MMC56X3_LATEST_VERSION
        help
            Select the package version

        config PKG_USING_ARDUINO_ADAFRUIT_MMC56X3_LATEST_VERSION
            bool "latest"
    endchoice

    config PKG_ARDUINO_ADAFRUIT_MMC56X3_VER
       string
       default "latest"    if PKG_USING_ARDUINO_ADAFRUIT_MMC56X3_LATEST_VERSION

endif
```

## arduino/sensors/Adafruit-MPL3115A2/Kconfig
```kconfig
# Kconfig file for package Adafruit-MPL3115A2
menuconfig PKG_USING_ARDUINO_ADAFRUIT_MPL3115A2
    bool "Adafruit MPL3115A2: Pressure/Altitude/Temperature Sensor"
    select PKG_USING_RTDUINO
    select RTDUINO_USING_WIRE
    select PKG_USING_ARDUINO_ADAFRUIT_BUSIO
    default n

if PKG_USING_ARDUINO_ADAFRUIT_MPL3115A2

    config PKG_ARDUINO_ADAFRUIT_MPL3115A2_PATH
        string
        default "/packages/arduino/sensors/Adafruit-MPL3115A2"

    choice
        prompt "Version"
        default PKG_USING_ARDUINO_ADAFRUIT_MPL3115A2_LATEST_VERSION
        help
            Select the package version

        config PKG_USING_ARDUINO_ADAFRUIT_MPL3115A2_LATEST_VERSION
            bool "latest"
    endchoice

    config PKG_ARDUINO_ADAFRUIT_MPL3115A2_VER
       string
       default "latest"    if PKG_USING_ARDUINO_ADAFRUIT_MPL3115A2_LATEST_VERSION

endif
```

## arduino/sensors/Adafruit-MPR121/Kconfig
```kconfig
# Kconfig file for package Adafruit-MPR121
menuconfig PKG_USING_ARDUINO_ADAFRUIT_MPR121
    bool "Adafruit MPR121: Capacitive Touch Sensor"
    select PKG_USING_RTDUINO
    select RTDUINO_USING_WIRE
    select PKG_USING_ARDUINO_ADAFRUIT_BUSIO
    default n

if PKG_USING_ARDUINO_ADAFRUIT_MPR121

    config PKG_ARDUINO_ADAFRUIT_MPR121_PATH
        string
        default "/packages/arduino/sensors/Adafruit-MPR121"

    choice
        prompt "Version"
        default PKG_USING_ARDUINO_ADAFRUIT_MPR121_LATEST_VERSION
        help
            Select the package version

        config PKG_USING_ARDUINO_ADAFRUIT_MPR121_LATEST_VERSION
            bool "latest"
    endchoice

    config PKG_ARDUINO_ADAFRUIT_MPR121_VER
       string
       default "latest"    if PKG_USING_ARDUINO_ADAFRUIT_MPR121_LATEST_VERSION

endif
```
