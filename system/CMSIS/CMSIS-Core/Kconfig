## system/CMSIS/CMSIS-Core/Kconfig
```kconfig
# Kconfig file for package CMSIS-Core
menuconfig PKG_USING_CMSIS_CORE
    bool "CMSIS-Core: Standardized API for the Cortex-A/M processor"
    default n

if PKG_USING_CMSIS_CORE

    config PKG_CMSIS_CORE_PATH
        string
        default "/packages/system/CMSIS/CMSIS-Core"

    choice
        prompt "Version"
        help
            Select the package version

        config PKG_USING_CMSIS_CORE_LATEST_VERSION
            bool "latest"
    endchoice

    config PKG_CMSIS_CORE_VER
       string
       default "latest"    if PKG_USING_CMSIS_CORE_LATEST_VERSION

endif
```

## system/CMSIS/CMSIS-DSP/Kconfig
```kconfig
# Kconfig file for package CMSIS-DSP
menuconfig PKG_USING_CMSIS_DSP
    bool "CMSIS-DSP: A comprehensive DSP library for Cortex-M processor-based devices"
    default n

if PKG_USING_CMSIS_DSP

    config PKG_CMSIS_DSP_PATH
        string
        default "/packages/system/CMSIS/CMSIS-DSP"

    choice
        prompt "Version"
        help
            Select the package version

        config PKG_USING_CMSIS_DSP_LATEST_VERSION
            bool "latest"
    endchoice

    config PKG_CMSIS_DSP_VER
       string
       default "latest"    if PKG_USING_CMSIS_DSP_LATEST_VERSION

endif
```

## system/CMSIS/CMSIS-NN/Kconfig
```kconfig
# Kconfig file for package CMSIS-NN
menuconfig PKG_USING_CMSIS_NN
    bool "CMSIS-NN: Efficient Neural Network Kernels for Arm Cortex-M CPUs"
    default n

if PKG_USING_CMSIS_NN

    config PKG_CMSIS_NN_PATH
        string
        default "/packages/system/CMSIS/CMSIS-NN"

    choice
        prompt "Version"
        help
            Select the package version

        config PKG_USING_CMSIS_NN_LATEST_VERSION
            bool "latest"
    endchoice

    config PKG_CMSIS_NN_VER
       string
       default "latest"    if PKG_USING_CMSIS_NN_LATEST_VERSION

endif
```

## system/CMSIS/CMSIS_5/Kconfig
```kconfig
# Kconfig file for package CMSIS_5
menuconfig PKG_USING_CMSIS_5
    bool "CMSIS-5 Development"
    default n

if PKG_USING_CMSIS_5

    config PKG_CMSIS_5_PATH
        string
        default "/packages/system/CMSIS/CMSIS_5"

    config PKG_CMSIS_CORE
        bool "CMSIS core API for Cortex-M"
        default y

    config PKG_CMSIS_DSP
        bool "A suite of common signal processing (DSP) functions for Cortex-M"
        default n

    if PKG_CMSIS_DSP
        config PKG_CMSIS_DSP_BASIC_MATH
            bool "Basic math functions"
            default y

        config PKG_CMSIS_DSP_BAYES
            bool "Bayes classifier functions"
            default n

        config PKG_CMSIS_DSP_COMMON_TABLES
            bool "Common tables"
            default n

        config PKG_CMSIS_DSP_COMPLEX_MATH
            bool "Complex math functions"
            default n

        config PKG_CMSIS_DSP_CONTROLLER
            bool "Motor control functions"
            default n

        config PKG_CMSIS_DSP_DISTANCE
            bool "Distance functions"
            default n

        config PKG_CMSIS_DSP_FAST_MATH
            bool "Fast math functions"
            default n

        config PKG_CMSIS_DSP_FILTERING
            bool "Filtering functions"
            default n

        config PKG_CMSIS_DSP_INTERPOLATION
            bool "Interpolation functions"
            default n

        config PKG_CMSIS_DSP_MATRIX
            bool "Matrix functions"
            default n

        config PKG_CMSIS_DSP_QUATERNION_MATH
            bool "Quaternion functions"
            default n

        config PKG_CMSIS_DSP_SVM
            bool "Support Vector Machine functions (SVM)"
            default n

        config PKG_CMSIS_DSP_STATISTICS
            bool "Statistical functions"
            default n

        config PKG_CMSIS_DSP_SUPPORT
            bool "Support functions"
            default n

        config PKG_CMSIS_DSP_TRANSFORM
            bool "Transform functions"
            default n
    endif

    config PKG_CMSIS_NN
        bool "A collection of efficient neural network (NN) kernels for Cortex-M"
        default n

    if PKG_CMSIS_NN
        config PKG_CMSIS_NN_ACTIVATION
            bool "Activation Functions"
            default n

        config PKG_CMSIS_NN_BASIC_MATH
            bool "Basic Math Functions"
            default y

        config PKG_CMSIS_NN_CONCATENATION
            bool "Concatenation Functions"
            default n

        config PKG_CMSIS_NN_CONVOLUTION
            bool "Convolution Functions"
            default n

        config PKG_CMSIS_NN_FULLY_CONNECTED
            bool "Fully-connected Layer Functions"
            default n

        config PKG_CMSIS_NN_SUPPORT
            bool "NN Support Functions"
            default n

        config PKG_CMSIS_NN_POOLING
            bool "Pooling Functions"
            default n

        config PKG_CMSIS_NN_RESHAPE
            bool "Reshape Functions"
            default n

        config PKG_CMSIS_NN_SVDF
            bool "SVDF Layer Functions"
            default n

        config PKG_CMSIS_NN_SOFTMAX
            bool "Softmax Functions"
            default n
    endif

    choice
        prompt "Version"
        default PKG_USING_CMSIS_5_V50900
        help
            Select the package version

        config PKG_USING_CMSIS_5_LATEST_VERSION
            bool "latest"

        config PKG_USING_CMSIS_5_V50900
            bool "v5.9.0"

        config PKG_USING_CMSIS_5_V50800
            bool "v5.8.0"
    endchoice

    config PKG_CMSIS_5_VER
       string
       default "v5.9.0"    if PKG_USING_CMSIS_5_V50900
       default "v5.8.0"    if PKG_USING_CMSIS_5_V50800
       default "latest"    if PKG_USING_CMSIS_5_LATEST_VERSION

    config PKG_CMSIS_5_VER_NUM
        hex
        default 0x50900    if PKG_USING_CMSIS_5_V50900
        default 0x50800    if PKG_USING_CMSIS_5_V50800
        default 0x99999    if PKG_USING_FLASHDB_LATEST_VERSION

    # ---- auxiliary package ------
    config PKG_USING_CMSIS_5_AUX
        bool
        default y

    if PKG_USING_CMSIS_5_AUX
        config PKG_CMSIS_5_AUX_PATH
            string
            default "/packages/system/CMSIS/CMSIS_5_AUX"

        config PKG_CMSIS_5_AUX_VER
            string
            default "latest"
    endif

endif
```

## system/CMSIS/CMSIS_5_AUX/Kconfig
```kconfig
# Kconfig file for package CMSIS_5_AUX
menuconfig PKG_USING_CMSIS_5_AUX
    bool "CMSIS-5 Auxiliary Package"
    default n

if PKG_USING_CMSIS_5_AUX

    config PKG_CMSIS_5_AUX_PATH
        string
        default "/packages/system/CMSIS/CMSIS_5_AUX"

    choice
        prompt "Version"
        default PKG_USING_CMSIS_5_AUX_LATEST_VERSION
        help
            Select the package version

        config PKG_USING_CMSIS_5_AUX_LATEST_VERSION
            bool "latest"
    endchoice
          
    config PKG_CMSIS_5_AUX_VER
       string
       default "latest"    if PKG_USING_CMSIS_5_AUX_LATEST_VERSION

endif
```

## system/CMSIS/CMSIS_RTOS1/Kconfig
```kconfig
# Kconfig file for package CMSIS_RTOS1
menuconfig PKG_USING_CMSIS_RTOS1
    bool "CMSIS-RTOS1 wrapper for RT-Thread"
    default n

if PKG_USING_CMSIS_RTOS1

    config PKG_CMSIS_RTOS1_PATH
        string
        default "/packages/system/CMSIS/CMSIS_RTOS1"

    choice
        prompt "Version"
        default PKG_USING_CMSIS_RTOS1_LATEST_VERSION
        help
            Select the package version

        config PKG_USING_CMSIS_RTOS1_LATEST_VERSION
            bool "latest"
    endchoice

    config PKG_CMSIS_RTOS1_VER
       string
       default "latest"    if PKG_USING_CMSIS_RTOS1_LATEST_VERSION

endif
```

## system/CMSIS/CMSIS_RTOS2/Kconfig
```kconfig
# Kconfig file for package CMSIS_RTOS2
menuconfig PKG_USING_CMSIS_RTOS2
    bool "CMSIS-RTOS2 wrapper for RT-Thread"
    select PKG_USING_CMSIS_5
    default n

if PKG_USING_CMSIS_RTOS2

    config PKG_CMSIS_RTOS2_PATH
        string
        default "/packages/system/CMSIS/CMSIS_RTOS2"

    config PKG_CMSIS_RTOS2_COMPATIBLE_CMSIS_RTOS1
        bool "CMSIS RTOS2 compatible with CMSIS RTOS1"
        default n

    choice
        prompt "Version"
        default PKG_USING_CMSIS_RTOS2_LATEST_VERSION
        help
            Select the package version

        config PKG_USING_CMSIS_RTOS2_LATEST_VERSION
            bool "latest"
    endchoice

    config PKG_CMSIS_RTOS2_VER
       string
       default "latest"    if PKG_USING_CMSIS_RTOS2_LATEST_VERSION

endif
```

## system/CMSIS/Kconfig
```kconfig
menu "CMSIS: ARM Cortex-M Microcontroller Software Interface Standard"

rsource "CMSIS_5/Kconfig"
rsource "CMSIS-Core/Kconfig"
rsource "CMSIS-DSP/Kconfig"
rsource "CMSIS-NN/Kconfig"
rsource "CMSIS_RTOS1/Kconfig"
rsource "CMSIS_RTOS2/Kconfig"

endmenu
```

## system/CherryECAT/Kconfig
```kconfig
# Kconfig file for package CherryECAT
menuconfig PKG_USING_CHERRYECAT
    bool "CherryECAT: a tiny and beautiful, high real-time and low-jitter EtherCAT master stack, specially designed for MCUs running with RTOS"
    default n

if PKG_USING_CHERRYECAT

        choice
            prompt "select net device driver"
            default PKG_CHERRYECAT_NETDEV_CUSTOM
            config PKG_CHERRYECAT_NETDEV_CUSTOM
                bool "CUSTOM (Implement it yourself)"
            config PKG_CHERRYECAT_NETDEV_HPMICRO
                bool "hpmicro"
            config PKG_CHERRYECAT_NETDEV_RENESAS
                bool "renesas"
            config PKG_CHERRYECAT_NETDEV_STM32H7
                bool "stm32h7, hal >=1.11.0"
        endchoice

    if PKG_CHERRYECAT_NETDEV_HPMICRO
        choice
            prompt "hpmicro eth driver type"
            default PKG_CHERRYECAT_HPMICRO_RGMII
            config PKG_CHERRYECAT_HPMICRO_RGMII
                bool "RGMII"
            config PKG_CHERRYECAT_HPMICRO_RMII
                bool "RMII"
        endchoice

    endif

    if PKG_CHERRYECAT_NETDEV_STM32H7
        config CONFIG_EC_PHY_RESET_PORT
            int "stm32 eth phy reset port, from 0 to x, 0 means GPIOA"
            default 0
        config CONFIG_EC_PHY_RESET_PIN
            int "stm32 eth phy reset pin, from 0 to 15"
            default 8
    endif

    config PKG_CHERRYECAT_PATH
        string
        default "/packages/system/CherryECAT"

    choice
        prompt "Version"
        default PKG_USING_CHERRYECAT_LATEST_VERSION
        help
            Select the package version

        config PKG_USING_CHERRYECAT_LATEST_VERSION
            bool "latest"
    endchoice

    config PKG_CHERRYECAT_VER
       string
       default "latest"    if PKG_USING_CHERRYECAT_LATEST_VERSION
endif
```

## system/CherryUSB/Kconfig
```kconfig
# Kconfig file for package CherryUSB
menuconfig PKG_USING_CHERRYUSB
    bool "CherryUSB: tiny and portable USB host/device stack for embedded system with USB IP"
    default n
    select RT_USING_LIBC

if PKG_USING_CHERRYUSB

    config PKG_CHERRYUSB_PATH
        string
        default "/packages/system/CherryUSB"

    choice
        prompt "Version"
        default PKG_USING_CHERRYUSB_V010300 if RT_VER_NUM == 0x50000
        default PKG_USING_CHERRYUSB_V010200 if RT_VER_NUM >= 0x40100
        default PKG_USING_CHERRYUSB_LATEST_VERSION
        help
            Select the package version

        config PKG_USING_CHERRYUSB_LATEST_VERSION
            bool "latest"

        config PKG_USING_CHERRYUSB_V010200
            bool "v1.2.0"
        config PKG_USING_CHERRYUSB_V001002
            bool "v0.10.2"
    endchoice

    config PKG_CHERRYUSB_VER
       string
       default "latest"    if PKG_USING_CHERRYUSB_LATEST_VERSION
       default "v1.2.0"   if PKG_USING_CHERRYUSB_V010200
       default "v0.10.2"   if PKG_USING_CHERRYUSB_V001002
endif
```

## system/EV/Kconfig
```kconfig
# Kconfig file for package EV

menuconfig PKG_USING_EV
    bool "EV: Framework for efficient development of vehicles (including drones)"
    default n

if PKG_USING_EV

    config PKG_EV_PATH
        string
        default "/packages/system/EV"

    choice
        prompt "Version"
        default PKG_USING_EV_LATEST_VERSION
        help
            Select the package version

        config PKG_USING_EV_LATEST_VERSION
            bool "latest"
    endchoice

    config PKG_EV_VER
       string
       default "latest"    if PKG_USING_EV_LATEST_VERSION

endif
```

## system/FlashDB/Kconfig
```kconfig
# Kconfig file for package FlashDB
menuconfig PKG_USING_FLASHDB
    bool "FlashDB: A lightweight database that supports key-value and time series data."
    default n

if PKG_USING_FLASHDB

    config PKG_FLASHDB_PATH
        string
        default "/packages/system/FlashDB"

    config FDB_USING_KVDB
        bool
        prompt "Using KVDB feature"
        default y

    if FDB_USING_KVDB
        config FDB_KV_AUTO_UPDATE
            bool
            prompt "Auto update KV to latest default when current KVDB version number is changed."
            default n
    endif

    config FDB_USING_TSDB
        bool
        prompt "Using TSDB (Time series database) feature"
        default y

    config FDB_USING_FAL_MODE
        bool
        prompt "Using FAL storage mode"
        select PKG_USING_FAL if RT_VER_NUM < 0x40100
        select RT_USING_FAL if RT_VER_NUM >= 0x40100
        default y

    if FDB_USING_FAL_MODE
        choice
            prompt "Write minimum granularity"
            default FDB_WRITE_GRAN_1BIT
            config FDB_WRITE_GRAN_1BIT
                bool "1bit   such as Nor Flash"

            config FDB_WRITE_GRAN_8BITS
                bool "8bits  such as STM32F2/F4"

            config FDB_WRITE_GRAN_32BITS
                bool "32bits such as STM32F1"

            config FDB_WRITE_GRAN_64BITS
                bool "64bits such as STM32F7"

            config FDB_WRITE_GRAN_128BITS
                bool "128bits such as STM32H5"
        endchoice

        config FDB_WRITE_GRAN
            int
            default 1 if FDB_WRITE_GRAN_1BIT
            default 8 if FDB_WRITE_GRAN_8BITS
            default 32 if FDB_WRITE_GRAN_32BITS
            default 64 if FDB_WRITE_GRAN_64BITS
            default 128 if FDB_WRITE_GRAN_128BITS
    endif

    if PKG_FLASHDB_VER_NUM > 0x10000
        choice
            prompt "File storage mode"
            default FDB_NOT_USING_FILE_MODE
            config FDB_NOT_USING_FILE_MODE
                bool "Not using file mode"

            config FDB_USING_FILE_LIBC_MODE
                bool "Using LIBC file API"

            config FDB_USING_FILE_POSIX_MODE
                bool "Using POSIX file API"
        endchoice
    endif

    config FLASHDB_USING_SAMPLES
        bool "Enable samples"
        default n

    config FDB_DEBUG_ENABLE
        bool "Enable debug log output"
        default y

    choice
        prompt "Version"
        default PKG_USING_FLASHDB_V20100
        help
            Select the package version

        config PKG_USING_FLASHDB_V20100
            bool "v2.1.0"

        config PKG_USING_FLASHDB_V10102
            bool "v1.1.2"

        config PKG_USING_FLASHDB_V10101
            bool "v1.1.1"

        config PKG_USING_FLASHDB_V10100
            bool "v1.1.0"

        config PKG_USING_FLASHDB_V10000
            bool "v1.0.0"

        config PKG_USING_FLASHDB_LATEST_VERSION
            bool "latest"
    endchoice

    config PKG_FLASHDB_VER
       string
       default "v1.0.0"    if PKG_USING_FLASHDB_V10000
       default "v1.1.0"    if PKG_USING_FLASHDB_V10100
       default "v1.1.1"    if PKG_USING_FLASHDB_V10101
       default "v1.1.2"    if PKG_USING_FLASHDB_V10102
       default "v2.1.0"    if PKG_USING_FLASHDB_V20100
       default "latest"    if PKG_USING_FLASHDB_LATEST_VERSION

    config PKG_FLASHDB_VER_NUM
        hex
        default 0x99999    if PKG_USING_FLASHDB_LATEST_VERSION
        default 0x10000    if PKG_USING_FLASHDB_V10000
        default 0x10100    if PKG_USING_FLASHDB_V10100
        default 0x10101    if PKG_USING_FLASHDB_V10101
        default 0x10102    if PKG_USING_FLASHDB_V10102
        default 0x20100    if PKG_USING_FLASHDB_V20100

endif
```
