## peripherals/sensors/max30102/Kconfig
```kconfig
# Kconfig file for package max30102
menuconfig PKG_USING_MAX30102
    bool "MAX30102: heart rate and oxygen saturation measure"
    default n

if PKG_USING_MAX30102

    config PKG_MAX30102_PATH
        string
        default "/packages/peripherals/sensors/max30102"

    config PKG_MAX30102_USING_SENSOR_V1
        bool "Enable sensor_v1 divce framework"
        select RT_USING_SENSOR
        default n

    config MAX30102_STACK_SIZE
        int "max30102 thread stack size"
        default 1024

    config MAX30102_PRIORITY
        int "max30102 thread priority"
        default 10

    config MAX30102_TICKS
        int "max30102 thread ticks"
        default 10

    config MAX30102_USING_EXAMPLE
        bool "max30102 example"
        default y

    config PKG_MAX30102_VER
       string
       default "v1.0.0"    if PKG_USING_MAX30102_V100
       default "latest"    if PKG_USING_MAX30102_LATEST_VERSION

    choice
        prompt "Version"
        default PKG_USING_MAX30102_LATEST_VERSION
        help
            Select the package version

        config PKG_USING_MAX30102_V100
            bool "v1.0.0"

        config PKG_USING_MAX30102_LATEST_VERSION
            bool "latest"
    endchoice

endif
```

## peripherals/sensors/max31855/Kconfig
```kconfig
# Kconfig file for package max31855
menuconfig PKG_USING_MAX31855
    bool "max31855: a package of digital temperature sensor max31855."
    default n

if PKG_USING_MAX31855

    config PKG_MAX31855_USING_SENSOR_V1
        bool "Enable sensor_v1 divce framework"
        select RT_USING_SENSOR
        default n

    config PKG_MAX31855_PATH
        string
        default "/packages/peripherals/sensors/max31855"

    choice
        prompt "Version"
        default PKG_USING_MAX31855_LATEST_VERSION
        help
            Select the package version

        config PKG_USING_MAX31855_V100
            bool "v1.0.0"

        config PKG_USING_MAX31855_LATEST_VERSION
            bool "latest"
    endchoice

    config PKG_MAX31855_VER
       string
       default "v1.0.0"    if PKG_USING_MAX31855_V100
       default "latest"    if PKG_USING_MAX31855_LATEST_VERSION

endif
```

## peripherals/sensors/max31865/Kconfig
```kconfig
# Kconfig file for package max31865
menuconfig PKG_USING_MAX31865
    bool "max31865: a package of digital temperature sensor."
    default n

if PKG_USING_MAX31865

    config PKG_MAX31865_PATH
        string
        default "/packages/peripherals/sensors/max31865"

    config PKG_MAX31865_USING_SENSOR_V1
        bool "Enable sensor_v1 device framework"
        select RT_USING_SENSOR
        default n
    
    config PKG_MAX31865_REF_RES
        int "MAX31865 reference resistor. Unit: Milliohm"
        default 400000

    choice
        prompt "RTD type"
        default MAX31865_PT100
        help
            Select RTD type

        config MAX31865_PT100
            bool "PT100"

        config MAX31865_PT1000
            bool "PT1000"
    endchoice

    choice
        prompt "Version"
        default PKG_USING_MAX31865_LATEST_VERSION
        help
            Select the package version

        config PKG_USING_MAX31865_V100
            bool "v1.0.0"

        config PKG_USING_MAX31865_LATEST_VERSION
            bool "latest"
    endchoice

    config PKG_MAX31865_VER
       string
       default "v1.0.0"    if PKG_USING_MAX31865_V100
       default "latest"    if PKG_USING_MAX31865_LATEST_VERSION

endif
```

## peripherals/sensors/max6675/Kconfig
```kconfig
# Kconfig file for package max6675
menuconfig PKG_USING_MAX6675
    bool "max6675: a package of digital temperature sensor max6675."
    default n

if PKG_USING_MAX6675

    config PKG_MAX6675_USING_SENSOR_V1
        bool "Enable sensor_v1 divce framework"
        select RT_USING_SENSOR
        default n

    config PKG_MAX6675_PATH
        string
        default "/packages/peripherals/sensors/max6675"

    choice
        prompt "Version"
        default PKG_USING_MAX6675_LATEST_VERSION
        help
            Select the package version

        config PKG_USING_MAX6675_V100
            bool "v1.0.0"

        config PKG_USING_MAX6675_LATEST_VERSION
            bool "latest"
    endchoice

    config PKG_MAX6675_VER
       string
       default "v1.0.0"    if PKG_USING_MAX6675_V100
       default "latest"    if PKG_USING_MAX6675_LATEST_VERSION

endif
```

## peripherals/sensors/mlx90382/Kconfig
```kconfig
# Kconfig file for package mlx90382
menuconfig PKG_USING_MLX90382
    bool "a mlx90382 package for rt-thread."
    default n

if PKG_USING_MLX90382

    config PKG_MLX90382_USING_SENSOR_V1
        bool "Enable sensor divce framework"
        select RT_USING_SENSOR
        default n

    config PKG_MLX90382_PATH
        string
        default "/packages/peripherals/sensors/mlx90382"

    choice
        prompt "Version"
        default PKG_USING_MLX90382_LATEST_VERSION
        help
            Select the package version

        config PKG_USING_MLX90382_V100
            bool "v1.0.0"

        config PKG_USING_MLX90382_LATEST_VERSION
            bool "latest"
    endchoice

    config PKG_MLX90382_VER
       string
       default "v1.0.0"    if PKG_USING_MLX90382_V100
       default "latest"    if PKG_USING_MLX90382_LATEST_VERSION

    config PKG_USING_MLX90382_SAMPLE
        bool "Enable mlx90382 sample"
        default n

endif
```

## peripherals/sensors/mlx90384/Kconfig
```kconfig
# Kconfig file for package mlx90384
menuconfig PKG_USING_MLX90384
    bool "a mlx90384 package for rt-thread."
    default n

if PKG_USING_MLX90384

    config PKG_MLX90384_USING_SENSOR_V1
        bool "Enable sensor divce framework"
        select RT_USING_SENSOR
        default n

    config PKG_MLX90384_PATH
        string
        default "/packages/peripherals/sensors/mlx90384"

    choice
        prompt "Version"
        default PKG_USING_MLX90384_LATEST_VERSION
        help
            Select the package version

        config PKG_USING_MLX90384_V100
            bool "v1.0.0"

        config PKG_USING_MLX90384_LATEST_VERSION
            bool "latest"
    endchoice

    config PKG_MLX90384_VER
       string
       default "v1.0.0"    if PKG_USING_MLX90384_V100
       default "latest"    if PKG_USING_MLX90384_LATEST_VERSION

    config PKG_USING_MLX90384_SAMPLE
        bool "Enable mlx90384 sample"
        default n

endif
```

## peripherals/sensors/mlx90392/Kconfig
```kconfig
# Kconfig file for package mlx90392
menuconfig PKG_USING_MLX90392
    bool "a mlx90392 package for rt-thread."
    default n

if PKG_USING_MLX90392

    config PKG_MLX90392_PATH
        string
        default "/packages/peripherals/sensors/mlx90392"

    config PKG_MLX90392_USING_SENSOR_V1
        bool "Enable sensor_v1 device framework"
        select RT_USING_SENSOR
        default n
    
    config PKG_USING_MLX90392_SAMPLE
        bool "Enable mlx90392 Sample"
        default n

    choice
        prompt "Version"
        default PKG_USING_MLX90392_LATEST_VERSION
        help
            Select the package version

        config PKG_USING_MLX90392_V100
            bool "v1.0.0"

        config PKG_USING_MLX90392_LATEST_VERSION
            bool "latest"
    endchoice

    config PKG_MLX90392_VER
       string
       default "v1.0.0"    if PKG_USING_MLX90392_V100
       default "latest"    if PKG_USING_MLX90392_LATEST_VERSION

endif
```

## peripherals/sensors/mlx90393/Kconfig
```kconfig
# Kconfig file for package mlx90393
menuconfig PKG_USING_MLX90393
    bool "a mlx90393 package for rt-thread."
    default n

if PKG_USING_MLX90393

    config PKG_MLX90393_PATH
        string
        default "/packages/peripherals/sensors/mlx90393"

    config PKG_MLX90393_USING_SENSOR_V1
        bool "Enable sensor_v1 device framework"
        select RT_USING_SENSOR
        default n

    choice
        prompt "Version"
        default PKG_USING_MLX90393_LATEST_VERSION
        help
            Select the package version

        config PKG_USING_MLX90393_V100
            bool "v1.0.0"

        config PKG_USING_MLX90393_LATEST_VERSION
            bool "latest"
    endchoice

    config PKG_MLX90393_VER
       string
       default "v1.0.0"    if PKG_USING_MLX90393_V100
       default "latest"    if PKG_USING_MLX90393_LATEST_VERSION

endif
```

## peripherals/sensors/mlx90394/Kconfig
```kconfig
# Kconfig file for package mlx90394
menuconfig PKG_USING_MLX90394
    bool "a mlx90394 package for rt-thread."
    default n

if PKG_USING_MLX90394

    config PKG_MLX90394_PATH
        string
        default "/packages/peripherals/sensors/mlx90394"

    choice
        prompt "Version"
        default PKG_USING_MLX90394_LATEST_VERSION
        help
            Select the package version

        config PKG_USING_MLX90394_V100
            bool "v1.0.0"

        config PKG_USING_MLX90394_LATEST_VERSION
            bool "latest"
    endchoice

    config PKG_MLX90394_VER
       string
       default "v1.0.0"    if PKG_USING_MLX90394_V100
       default "latest"    if PKG_USING_MLX90394_LATEST_VERSION

endif
```

## peripherals/sensors/mlx90397/Kconfig
```kconfig
# Kconfig file for package mlx90397
menuconfig PKG_USING_MLX90397
    bool "MLX90397: 3D magnetometer sensor"
    default n

if PKG_USING_MLX90397

    config PKG_MLX90397_PATH
        string
        default "/packages/peripherals/sensors/mlx90397"

    config PKG_MLX90397_USING_SENSOR_V1
        bool "Enable sensor_v1 device framework"
        select RT_USING_SENSOR
        default n

    config PKG_USING_MLX90397_SAMPLE
        bool "Enable MLX90397 Sample"
        default n

    choice
        prompt "Version"
        default PKG_USING_MLX90397_LATEST_VERSION
        help
            Select the package version

        config PKG_USING_MLX90397_V100
            bool "v1.0.0"

        config PKG_USING_MLX90397_LATEST_VERSION
            bool "latest"
    endchoice

    config PKG_MLX90397_VER
       string
       default "v1.0.0"    if PKG_USING_MLX90397_V100
       default "latest"    if PKG_USING_MLX90397_LATEST_VERSION

endif
```
