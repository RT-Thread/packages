## misc/games/Kconfig
```kconfig
menu "games: games run on RT-Thread console"

source "$PKGS_DIR/packages/misc/games/threes/Kconfig"
source "$PKGS_DIR/packages/misc/games/c2048/Kconfig"
source "$PKGS_DIR/packages/misc/games/snake/Kconfig"
source "$PKGS_DIR/packages/misc/games/tetris/Kconfig"

endmenu
```

## misc/games/tetris/Kconfig
```kconfig
# Kconfig file for package tetris
menuconfig PKG_USING_TETRIS
    bool "Tetris: An indie puzzle video game run on RT-Thread console"
    select PKG_USING_VT100
    default n

if PKG_USING_TETRIS

    config PKG_TETRIS_PATH
        string
        default "/packages/misc/games/tetris"

    choice
        prompt "Version"
        default PKG_USING_TETRIS_LATEST_VERSION
        help
            Select the package version

        config PKG_USING_TETRIS_V100
            bool "v1.0.0"

        config PKG_USING_TETRIS_LATEST_VERSION
            bool "latest"
    endchoice
          
    config PKG_TETRIS_VER
       string
       default "v1.0.0"    if PKG_USING_TETRIS_V100
       default "latest"    if PKG_USING_TETRIS_LATEST_VERSION

endif
```

## misc/get_irq_priority/Kconfig
```kconfig
# Kconfig file for package get_irq_priority
menuconfig PKG_USING_GET_IRQ_PRIORITY
    bool "get irq priority for Cortex®-M."
    depends on SOC_FAMILY_STM32
    default n

if PKG_USING_GET_IRQ_PRIORITY

    config PKG_GET_IRQ_PRIORITY_PATH
        string
        default "/packages/misc/get_irq_priority"

    choice
        prompt "Version"
        default PKG_USING_GET_IRQ_PRIORITY_LATEST_VERSION
        help
            Select the package version

        config PKG_USING_GET_IRQ_PRIORITY_V100
            bool "v1.0.0"

        config PKG_USING_GET_IRQ_PRIORITY_LATEST_VERSION
            bool "latest"
    endchoice

    config PKG_GET_IRQ_PRIORITY_VER
       string
       default "v1.0.0"    if PKG_USING_GET_IRQ_PRIORITY_V100
       default "latest"    if PKG_USING_GET_IRQ_PRIORITY_LATEST_VERSION

endif
```

## misc/heatshrink/Kconfig
```kconfig
# Kconfig file for package heatshrink
menuconfig PKG_USING_HEATSHRINK
    bool "heatshrink: A data compression/decompression library for embedded/real-time systems"
    default n

if PKG_USING_HEATSHRINK

    config PKG_HEATSHRINK_PATH
        string
        default "/packages/misc/heatshrink"

    config HEATSHRINK_USING_LOGS
        bool "Enable logs"
        default n

    choice
        prompt "Version"
        default PKG_USING_HEATSHRINK_V101
        help
            Select the package version

        config PKG_USING_HEATSHRINK_V101
            bool "v1.0.1"

        config PKG_USING_HEATSHRINK_LATEST_VERSION
            bool "latest"

    endchoice

    config PKG_HEATSHRINK_VER
       string
       default "v1.0.1"    if PKG_USING_HEATSHRINK_V101
       default "latest"    if PKG_USING_HEATSHRINK_LATEST_VERSION

endif
```

## misc/hello/Kconfig
```kconfig
menuconfig PKG_USING_HELLO
    bool "Hello: A example package"
    default n

if PKG_USING_HELLO

    config PKG_HELLO_PATH
        string
        default "/packages/misc/hello"

    choice
        prompt "Version"
        help
            Select this package version

        config PKG_USING_HELLO_V10000
            bool "v1.0.0"

        config PKG_USING_HELLO_LATEST_VERSION
            bool "latest"
    endchoice

    config PKG_HELLO_VER
        string
        default "v1.0.0" if PKG_USING_HELLO_V10000
        default "latest" if PKG_USING_HELLO_LATEST_VERSION

endif
```

## misc/hsm/Kconfig
```kconfig
menuconfig PKG_USING_HSM
    bool "HSM: Hierarchical state machines for embedded systems"
    default n
    help
        HSM is a minimal, event-driven hierarchical state machine framework designed for embedded systems.
        It supports nested states, entry/exit actions, state transitions, and provides a simple C API for event handling.

if PKG_USING_HSM

    config PKG_HSM_PATH
        string
        default "/packages/misc/hsm"

    config PKG_HSM_MAX_LEVEL
        int "Maximum nesting level for state hierarchy"
        range 5 20
        default 10
        help
            The maximum nesting level supported for hierarchical states.
            Increase this value for deeply nested state machines.
            
    config PKG_HSM_USING_EXAMPLE
        bool "Enable HSM examples"
        default n
        help
            Enable the HSM LED example code
            
    choice
        prompt "Version"
        default PKG_USING_HSM_LATEST_VERSION
        help
            Select the package version

        config PKG_USING_HSM_V100
            bool "v1.0.0"

        config PKG_USING_HSM_LATEST_VERSION
            bool "latest"
    endchoice
    
    config PKG_HSM_VER
       string
       default "v1.0.0"    if PKG_USING_HSM_V100
       default "latest"    if PKG_USING_HSM_LATEST_VERSION

endif 
```

## misc/kendryte-demo/Kconfig
```kconfig
# Kconfig file for package kendryte-demo

menuconfig PKG_USING_KENDRYTE_DEMO
    bool "kendryte k210 demo package"
    default n

if PKG_USING_KENDRYTE_DEMO

    config PKG_KENDRYTE_DEMO_PATH
        string
        default "/packages/misc/kendryte-demo"

    choice
        prompt "Version"
        default PKG_USING_KENDRYTE_DEMO_V001
        help
            Select the package version

        config PKG_USING_KENDRYTE_DEMO_V001
            bool "v0.0.1"

        config PKG_USING_KENDRYTE_DEMO_LATEST_VERSION
            bool "latest"
    endchoice

    config PKG_KENDRYTE_DEMO_VER
       string
       default "v0.0.1"    if PKG_USING_KENDRYTE_DEMO_V001
       default "latest"    if PKG_USING_KENDRYTE_DEMO_LATEST_VERSION

    choice
        prompt "Kendryte demo item"
        default KENDRYTE_DEMO_NONE

        config KENDRYTE_DEMO_NONE
        bool "None"

        config KENDRYTE_DEMO_AES_128_TEST
        bool "aes 128 test"

        config KENDRYTE_DEMO_AES_192_TEST
        bool "aes 192 test"

        config KENDRYTE_DEMO_AES_256_TEST
        bool "aes 256 test"

        config KENDRYTE_DEMO_AI_DEMO_SIM
        bool "ai demo sim"

        config KENDRYTE_DEMO_DVP_OV
        bool "dvp ov"

        config KENDRYTE_DEMO_FACE_DETECT
        bool "face detect"

        config KENDRYTE_DEMO_FFT_TEST
        bool "fft test"

        config KENDRYTE_DEMO_FLASH_W25QXX
        bool "flash w25qxx"

        config KENDRYTE_DEMO_FLASH_W25QXX_DMA_TEST
        bool "flash w25qxx dma test"

        config KENDRYTE_DEMO_FLASH_W25QXX_TEST
        bool "flash w25qxx test"

        config KENDRYTE_DEMO_GPIOHS_LED
        bool "gpiohs led"

        config KENDRYTE_DEMO_GPIO_LED
        bool "gpio led"

        config KENDRYTE_DEMO_HELLO_WORLD
        bool "hello world"

        config KENDRYTE_DEMO_I2C_SLAVE
        bool "i2c slave"

        config KENDRYTE_DEMO_KPU
        bool "kpu"

        config KENDRYTE_DEMO_LCD
        bool "lcd"

        config KENDRYTE_DEMO_MIC_PLAY
        bool "mic play"

        config KENDRYTE_DEMO_PLAY_PCM
        bool "play pcm"

        config KENDRYTE_DEMO_PWM
        bool "pwm"

        config KENDRYTE_DEMO_RTC
        bool "rtc"

        config KENDRYTE_DEMO_RTC_SD3068
        bool "rtc sd3068"

        config KENDRYTE_DEMO_SD_CARD
        bool "sd card"

        config KENDRYTE_DEMO_SERVO
        bool "servo"

        config KENDRYTE_DEMO_SHA256_TEST
        bool "sha256 test"

        config KENDRYTE_DEMO_TIMER
        bool "timer"

        config KENDRYTE_DEMO_UART
        bool "uart"

        config KENDRYTE_DEMO_UART_DMA
        bool "uart dma"

        config KENDRYTE_DEMO_UART_DMA_IRQ
        bool "uart dma irq"

        config KENDRYTE_DEMO_UART_INTERRUPT
        bool "uart interrupt"

        config KENDRYTE_DEMO_WATCHDOG
        bool "watchdog"

    endchoice

    config KENDRYTE_DEMO
        string
        default "aes_128_test" if KENDRYTE_DEMO_AES_128_TEST
        default "aes_192_test" if KENDRYTE_DEMO_AES_192_TEST
        default "aes_256_test" if KENDRYTE_DEMO_AES_256_TEST
        default "ai_demo_sim" if KENDRYTE_DEMO_AI_DEMO_SIM
        default "dvp_ov" if KENDRYTE_DEMO_DVP_OV
        default "face_detect" if KENDRYTE_DEMO_FACE_DETECT
        default "fft_test" if KENDRYTE_DEMO_FFT_TEST
        default "flash_w25qxx" if KENDRYTE_DEMO_FLASH_W25QXX
        default "flash_w25qxx_dma_test" if KENDRYTE_DEMO_FLASH_W25QXX_DMA_TEST
        default "flash_w25qxx_test" if KENDRYTE_DEMO_FLASH_W25QXX_TEST
        default "gpiohs_led" if KENDRYTE_DEMO_GPIOHS_LED
        default "gpio_led" if KENDRYTE_DEMO_GPIO_LED
        default "hello_world" if KENDRYTE_DEMO_HELLO_WORLD
        default "i2c_slave" if KENDRYTE_DEMO_I2C_SLAVE
        default "kpu" if KENDRYTE_DEMO_KPU
        default "lcd" if KENDRYTE_DEMO_LCD
        default "mic_play" if KENDRYTE_DEMO_MIC_PLAY
        default "play_pcm" if KENDRYTE_DEMO_PLAY_PCM
        default "pwm" if KENDRYTE_DEMO_PWM
        default "rtc" if KENDRYTE_DEMO_RTC
        default "rtc_sd3068" if KENDRYTE_DEMO_RTC_SD3068
        default "sd_card" if KENDRYTE_DEMO_SD_CARD
        default "servo" if KENDRYTE_DEMO_SERVO
        default "sha256_test" if KENDRYTE_DEMO_SHA256_TEST
        default "timer" if KENDRYTE_DEMO_TIMER
        default "uart" if KENDRYTE_DEMO_UART
        default "uart_dma" if KENDRYTE_DEMO_UART_DMA
        default "uart_dma_irq" if KENDRYTE_DEMO_UART_DMA_IRQ
        default "uart_interrupt" if KENDRYTE_DEMO_UART_INTERRUPT
        default "watchdog" if KENDRYTE_DEMO_WATCHDOG
        default "none"

endif
```

## misc/ki/Kconfig
```kconfig
# Kconfig file for package ki
menuconfig PKG_USING_KI
    bool "ki: A small text editor in less than 1K lines of code"
    select RT_USING_POSIX_FS
    select RT_USING_POSIX_TERMIOS
    select PKG_USING_MEM_SANDBOX
    default n
    depends on RT_VER_NUM > 0x40100

if PKG_USING_KI

    config PKG_KI_PATH
        string
        default "/packages/misc/ki"

    config KI_SANDBOX_SIZE_KB
        int "Space size of the ki sandbox (KB)"
        default 10

    choice
        prompt "Version"
        default PKG_USING_KI_LATEST_VERSION
        help
            Select the package version

        config PKG_USING_KI_LATEST_VERSION
            bool "latest"
    endchoice

    config PKG_KI_VER
       string
       default "latest"    if PKG_USING_KI_LATEST_VERSION

endif
```

## misc/libann/Kconfig
```kconfig
# Kconfig file for package libann
menuconfig PKG_USING_LIBANN
    bool "libann: a light-weight ANN library, capable of training, saving and loading models."
    default n

if PKG_USING_LIBANN

    config PKG_LIBANN_PATH
        string
        default "/packages/misc/libann"

    config LIBANN_USING_IRIS_TRAIN_AND_PREDICT_FLASH
        bool "Iris load model from flash and predict example"
        help
            Load Iris dataset, load model from flash, predict, and save model.
        default n

    config LIBANN_USING_IRIS_TRAIN_AND_PREDICT
        select RT_USING_DFS
        select RT_USING_LIBC
        bool "Iris train model and predict example"
        help
            Load Iris dataset, train, predict, and save model.
        default n

    config LIBANN_USING_IRIS_LOAD_AND_PREDICT
        select RT_USING_DFS
        select RT_USING_LIBC
        bool "Iris load model and predict example"
        help
            Load Iris dataset, load model, predict, and save model.
        default n

    choice
        prompt "Version"
        default PKG_USING_LIBANN_LATEST_VERSION
        help
            Select the package version

        config PKG_USING_LIBANN_LATEST_VERSION
            bool "latest"
    endchoice

    config PKG_LIBANN_VER
       string
       default "latest"    if PKG_USING_LIBANN_LATEST_VERSION

    config PKG_LIBANN_VER_NUM
        hex
        default 0x99999 if PKG_USING_LIBANN_LATEST_VERSION

endif
```

## misc/libcrc/Kconfig
```kconfig
# Kconfig file for package libcrc
menuconfig PKG_USING_LIBCRC
    bool "libcrc:Multi platform MIT licensed CRC library in C."
    default n

if PKG_USING_LIBCRC

    config PKG_LIBCRC_PATH
        string
        default "/packages/misc/libcrc"

    choice
        prompt "Version"
        help
            Select the package version

        config PKG_USING_LIBCRC_V100
            bool "v1.0.0"

        config PKG_USING_LIBCRC_LATEST_VERSION
            bool "latest"
    endchoice

    config PKG_LIBCRC_CRC8
        bool "crc8"
        default n

        if PKG_LIBCRC_CRC8
            config LIBCRC_USING_CRC8
                bool "using 8 bit crc"
                default n
        endif

    config PKG_LIBCRC_CRC16
        bool "crc16"
        default n

        if PKG_LIBCRC_CRC16
            config LIBCRC_USING_CRC16
                bool "using 16 bit crc"
                default n
        
            config LIBCRC_USING_CRC_CCITT_1D0F
                bool "using ccitt crc, 0x1D0F"
                default n

            config LIBCRC_USING_CRC_CCITT_FFFF
                bool "using ccitt crc, 0xFFFF"
                default n
            config LIBCRC_USING_CRC_DNP
                bool "using dnp crc"
                default n

            config LIBCRC_USING_CRC_KERMIT
                bool "using kermit crc"
                default n

            config LIBCRC_USING_CRC_MODBUS
                bool "using modbus crc"
                default n

            config LIBCRC_USING_CRC_SICK
                bool "using sick crc"
                default n

            config LIBCRC_USING_CRC_XMODEM
                bool "using xmodem crc"
                default n
        endif

    config PKG_LIBCRC_CRC32
        bool "crc32"
        default n

        if PKG_LIBCRC_CRC32
            config LIBCRC_USING_CRC32
                bool "using 32 bit crc"
                default n
        endif

    config PKG_LIBCRC_CRC64
        bool "crc64"
        default n

        if PKG_LIBCRC_CRC64
            config LIBCRC_USING_CRC64_ECMA
                bool "using 64 bit ecma crc"
                default n

            config LIBCRC_USING_CRC64_WE
                bool "using 64 bit we crc"
                default n
        endif

    config PKG_USING_CHECKSUM_NMEA
        bool "using nmea checksum"
        default n

    config PKG_USING_LIBCRC_SAMPLE
        bool "using sample crc"
        default n


    config PKG_LIBCRC_VER
       string
       default "v1.0.0"    if PKG_USING_LIBCRC_V100
       default "latest"    if PKG_USING_LIBCRC_LATEST_VERSION

endif
```

## misc/libcsv/Kconfig
```kconfig
# Kconfig file for package libcsv
menuconfig PKG_USING_LIBCSV
    bool "libcsv: a small, simple and fast CSV library written in pure ANSI C89 that can read and write CSV data."
    select RT_USING_LIBC     if RT_VER_NUM < 0x40100
    select RT_USING_DFS      if RT_VER_NUM < 0x40100
    select RT_USING_POSIX_FS if RT_VER_NUM >= 0x40100

if PKG_USING_LIBCSV

    config PKG_LIBCSV_PATH
        string
        default "/packages/misc/libcsv"

    choice
        prompt "libcsv version"
        help
            Select the libcsv version

        config PKG_USING_LIBCSV_V303
            bool "v3.0.3"

        config PKG_USING_LIBCSV_LATEST_VERSION
            bool "latest"
    endchoice

    config PKG_LIBCSV_VER
        string
        default "v3.0.3" if PKG_USING_LIBCSV_V303
        default "latest" if PKG_USING_LIBCSV_LATEST_VERSION

    config LIBCSV_USING_DEMO
        bool
        prompt "libcsv demo example"
        default n
        select PKG_USING_OPTPARSE

endif
```
