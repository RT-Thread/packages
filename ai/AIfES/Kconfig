## ai/AIfES/Kconfig
```kconfig
# Kconfig file for package AI4ES
menuconfig PKG_USING_AIFES
    select RT_USING_POSIX_FS
    bool "AIfES: A machine learning framework, developed and maintained by Fraunhofer Institute for Microelectronic Circuits and Systems."
    default n

if PKG_USING_AIFES

    config PKG_AIFES_PATH
        string
        default "/packages/ai/AIfES"

    config AIFES_USING_XOR_INFERENCE_F32_EXAMPLE
            bool "XOR inference example"
            help
               The sketch shows an example of how the inference of an already trained network is performed. In the concrete example, a neural network was trained to map an XOR gate. The neural network was trained in Keras and the configuration including the weights was imported into AIfES. The network structure is 2-3(Sigmoid)-1(Sigmoid) and Sigmoid is used as activation function. The calculation is done in float 32.
            default y

    config AIFES_USING_XOR_TRAINING_F32_EXAMPLE
            bool "XOR training example"
            help
                The sketch shows an example of how a neural network is trained from scratch in AIfES using training data. As in the example "0_XOR_Inference", an XOR gate is mapped here using a neural network. The 4 different states of an XOR gate are fed in as training data here. The network structure is 2-3(Sigmoid)-1(Sigmoid) and Sigmoid is used as activation function. In the example, the weights are initialized randomly in a range of values from -2 to +2. The Gotrot initialization was inserted as an alternative and commented out. For the training the ADAM Optimizer is used, the SGD Optimizer was commented out. The optimizer performs a batch training over 100 epochs. The calculation is done in float 32.
            default y

    config AIFES_USING_CNN_TRAINING_F32_EXAMPLE
            bool "CNN training example"
            help
                The sketch shows an example of how the training of a convolutional neural network (CNN) is performed. The training data consists of images with horizontal and vertical stripes. This example is just for demonstration of the training procedure with a CNN and has no deeper meaning.
            default n

    config AIFES_USING_MNIST_TRAINING_F32_EXAMPLE
            bool "MNIST training example"
            help
                The sketch shows an example of training a convolutional neural network (CNN) on the MNIST dataset.
            default n

    choice
        prompt "Version"
        default PKG_USING_AIFES_LATEST_VERSION
        help
            Select the package version
        config PKG_USING_AIFES_LATEST_VERSION
            bool "latest"
    endchoice

    config PKG_AIFES_VER
       string
       default "latest"    if PKG_USING_AIFES_LATEST_VERSION

    config PKG_LIME_TM_VER_NUM
        hex
        default 0x99999 if PKG_USING_AIFES_LATEST_VERSION

endif
```

## ai/LiME-TM/Kconfig
```kconfig
# Kconfig file for package ulapack
menuconfig PKG_USING_LIME_TM
    select RT_USING_POSIX_FS
    bool "LiME-TM: Lightning fast and Memory Efficient Machine Learning for MCU (Tsetlin Machine)"
    default n

if PKG_USING_LIME_TM

    config PKG_LIME_TM_PATH
        string
        default "/packages/ai/LiME-TM"

    choice
        prompt "Choose exmaple"

        config LIME_TM_USING_MNIST_FS_EXAMPLE
            bool "Training and testing MNIST example (File System)"
            select TSETLIN_USING_PROTOBUF
            help
               Training a compressed Tsetlin Machine model on the MNIST dataset.
            default n

        config LIME_TM_USING_MNIST_STATIC_EXAMPLE
            bool "Training and testing MNIST example (Static Model)"
            select TSETLIN_USING_STATIC_MODEL
            select TSETLIN_MODEL_TRAINABLE
            help
               Training a compressed Tsetlin Machine model on the MNIST dataset.
            default y
    endchoice

    config TSETLIN_USING_PROTOBUF
        bool "Load model from protobuf file"
        help
           Using proto-c to save the model as a protobuf file.
        depends on LIME_TM_USING_MNIST_FS_EXAMPLE
        default y

    config TSETLIN_MODEL_TRAINABLE
        bool "Enable model training"
        help
              Enabling this option allows the model to be trained on-device.
        default y

    config TSETLIN_USING_STATIC_MODEL
        bool "Load model from static headers"
        help
           Using the tsetlin compiler to save the model as a static C header file.
        depends on LIME_TM_USING_MNIST_STATIC_EXAMPLE
        default y

    choice
        prompt "Version"
        default PKG_USING_LIME_TM_LATEST_VERSION
        help
            Select the package version
        config PKG_USING_LIME_TM_LATEST_VERSION
            bool "latest"
    endchoice

    config PKG_LIME_TM_VER
       string
       default "latest"    if PKG_USING_LIME_TM_LATEST_VERSION

    config PKG_LIME_TM_VER_NUM
        hex
        default 0x99999 if PKG_USING_LIME_TM_LATEST_VERSION

endif
```

## iot/at_device/gd32vw553/Kconfig
```kconfig
# GD32VW553 AT device configuration
menuconfig AT_DEVICE_USING_GD32VW553
    bool "GigaDevice GD32VW553"
    depends on PKG_USING_AT_DEVICE_LATEST_VERSION
    select RT_USING_SERIAL
    select RT_USING_PIN
    default n

if AT_DEVICE_USING_GD32VW553

    config AT_DEVICE_GD32VW553_INIT_ASYN
        bool "Enable initialize by thread"
        default n

    config AT_DEVICE_GD32VW553_SOCKET
        bool "Enable GD32VW553 at socket"
        select AT_USING_SOCKET
        default y

    config AT_DEVICE_GD32VW553_SAMPLE
        bool "Enable sample"
        default n
        help
            Register a GD32VW553 device using the settings below. Leave this
            disabled when the BSP already registers the device.

    if AT_DEVICE_GD32VW553_SAMPLE

        config GD32VW553_SAMPLE_DEVICE_NAME
            string "Network device name"
            default "wifi0"

        config GD32VW553_SAMPLE_WIFI_SSID
            string "WIFI ssid"
            default "rtthread"

        config GD32VW553_SAMPLE_WIFI_PASSWORD
            string "WIFI password"
            default "12345678"

        config GD32VW553_SAMPLE_CLIENT_NAME
            string "AT client device name"
            default "uart4"

        config GD32VW553_SAMPLE_BAUDRATE
            int "AT UART baud rate"
            range 9600 2000000
            default 115200

        config GD32VW553_SAMPLE_RECV_LINE_NUM
            int "The maximum length of receive line buffer"
            default 1024

        config GD32VW553_SAMPLE_RESET_PIN
            int "Reset pin number"
            default -1
            help
                Set to -1 to disable hardware reset.

        config GD32VW553_SAMPLE_RESET_ACTIVE_LEVEL
            int "Reset active level (0: low, 1: high)"
            range 0 1
            default 0

    endif

endif
```
