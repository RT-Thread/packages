## multimedia/LVGL/LVGL/Kconfig
```kconfig
# Kconfig file for package LVGL
menuconfig PKG_USING_LVGL
    bool "LVGL (official): Light and Versatile Graphics Library"
    depends on RT_VER_NUM >= 0x40100
    default n

if PKG_USING_LVGL

    config PKG_LVGL_PATH
        string
        default "/packages/multimedia/LVGL/LVGL"

    config PKG_LVGL_THREAD_PRIO
        int "Priority of LVGL thread"
        default 20

    config PKG_LVGL_THREAD_STACK_SIZE
        int "Stack size of LVGL thread"
        default 4096

    config PKG_LVGL_DISP_REFR_PERIOD
        int "Display refresh period (ms)"
        default 5 # official suggestion

    config PKG_USING_LVGL_SQUARELINE
        bool "Support SquareLine Studio"
        default n

    config PKG_LVGL_USING_EXAMPLES
        bool "Enable built-in examples"
        default n

    config PKG_LVGL_USING_DEMOS
        bool "Enable built-in demos"
        default n

    choice
        prompt "Version"

        config PKG_LVGL_USING_V080311
            bool "v8.3.11"

        config PKG_LVGL_USING_V080310
            bool "v8.3.10"

        config PKG_LVGL_USING_V08039
            bool "v8.3.9"

        config PKG_LVGL_USING_V08038
            bool "v8.3.8"

        config PKG_LVGL_USING_V08037
            bool "v8.3.7"

        config PKG_LVGL_USING_V08036
            bool "v8.3.6"

        config PKG_LVGL_USING_V08035
            bool "v8.3.5"

        config PKG_LVGL_USING_V08034
            bool "v8.3.4"

        config PKG_LVGL_USING_V08033
            bool "v8.3.3"

        config PKG_LVGL_USING_V08032
            bool "v8.3.2"

        config PKG_LVGL_USING_V08031
            bool "v8.3.1"

        config PKG_LVGL_USING_V08030
            bool "v8.3.0"

        config PKG_LVGL_USING_V08020
            bool "v8.2.0"

        config PKG_LVGL_USING_V8_3_LATEST
            bool "v8.3-latest"

        config PKG_LVGL_USING_V8_4_LATEST
            bool "v8.4-latest"

        config PKG_LVGL_USING_V09000
            bool "v9.0.0"

        config PKG_LVGL_USING_V09010
            bool "v9.1.0"

        config PKG_LVGL_USING_LATEST
            bool "latest"
    endchoice

    config PKG_LVGL_VER_NUM
        hex
        default 0x080311    if PKG_LVGL_USING_V080311
        default 0x080310    if PKG_LVGL_USING_V080310
        default 0x080309    if PKG_LVGL_USING_V08039
        default 0x080308    if PKG_LVGL_USING_V08038
        default 0x080307    if PKG_LVGL_USING_V08037
        default 0x080306    if PKG_LVGL_USING_V08036
        default 0x080305    if PKG_LVGL_USING_V08035
        default 0x080304    if PKG_LVGL_USING_V08034
        default 0x080303    if PKG_LVGL_USING_V08033
        default 0x080302    if PKG_LVGL_USING_V08032
        default 0x080301    if PKG_LVGL_USING_V08031
        default 0x080300    if PKG_LVGL_USING_V08030
        default 0x080200    if PKG_LVGL_USING_V08020
        default 0x0803FF    if PKG_LVGL_USING_V8_3_LATEST
        default 0x0804FF    if PKG_LVGL_USING_V8_4_LATEST
        default 0x090000    if PKG_LVGL_USING_V09000
        default 0x090100    if PKG_LVGL_USING_V09010
        default 0x999999    if PKG_LVGL_USING_LATEST

    config PKG_LVGL_VER
       string
       default "v8.3.11"        if PKG_LVGL_VER_NUM = 0x080311
       default "v8.3.10"        if PKG_LVGL_VER_NUM = 0x080310
       default "v8.3.9"         if PKG_LVGL_VER_NUM = 0x080309
       default "v8.3.8"         if PKG_LVGL_VER_NUM = 0x080308
       default "v8.3.7"         if PKG_LVGL_VER_NUM = 0x080307
       default "v8.3.6"         if PKG_LVGL_VER_NUM = 0x080306
       default "v8.3.5"         if PKG_LVGL_VER_NUM = 0x080305
       default "v8.3.4"         if PKG_LVGL_VER_NUM = 0x080304
       default "v8.3.3"         if PKG_LVGL_VER_NUM = 0x080303
       default "v8.3.2"         if PKG_LVGL_VER_NUM = 0x080302
       default "v8.3.1"         if PKG_LVGL_VER_NUM = 0x080301
       default "v8.3.0"         if PKG_LVGL_VER_NUM = 0x080300
       default "v8.2.0"         if PKG_LVGL_VER_NUM = 0x080200
       default "v8.3-latest"    if PKG_LVGL_VER_NUM = 0x0803FF
       default "v8.4-latest"    if PKG_LVGL_VER_NUM = 0x0804FF
       default "v9.0.0"         if PKG_LVGL_VER_NUM = 0x090000
       default "v9.1.0"         if PKG_LVGL_VER_NUM = 0x090100
       default "latest"         if PKG_LVGL_VER_NUM = 0x999999

endif
```
