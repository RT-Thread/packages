## iot/NimBLE/Kconfig
```kconfig
# Kconfig file for package NimBLE
menuconfig PKG_USING_NIMBLE
    bool "NimBLE:An open-source Bluetooth 5.0 stack porting on RT-Thread"
    select RT_USING_MESSAGEQUEUE
    default n

if PKG_USING_NIMBLE

config PKG_NIMBLE_PATH
    string
    default "/packages/iot/NimBLE"

menu "Bluetooth Role support"

    config PKG_NIMBLE_ROLE_PERIPHERAL
    bool "Peripheral Role support"
    select PKG_NIMBLE_ROLE_BROADCASTER
    default y
    help
        Select this for LE Peripheral role support.

    config PKG_NIMBLE_ROLE_CENTRAL
    bool "Central Role support"
    select PKG_NIMBLE_ROLE_OBSERVER
    default y
    help
        Select this for LE Central role support.

    config PKG_NIMBLE_ROLE_BROADCASTER
    bool "Broadcaster Role support"
    default y
    help
        Select this for LE Broadcaster role support.

    config PKG_NIMBLE_ROLE_OBSERVER
    bool "Observer Role support"
    help
        Select this for LE Observer role support.
endmenu

menu "Host Stack Configuration"
    config PKG_NIMBLE_HOST
    bool "Bluetooth Host Stack support"
    default y

    if PKG_NIMBLE_HOST

    config PKG_NIMBLE_HOST_THREAD_STACK_SIZE
    int "The thread stack Size of Host Stack"
    default 1536
    help
        Set Host thread stack size.

    config PKG_NIMBLE_HOST_THREAD_PRIORITY
    int "The thread priority of Host Stack"
    default 8
    help
        Set Host Stack thread priority.

    endif
endmenu

menu "Controller Configuration"

    config PKG_NIMBLE_CTLR
    bool "Bluetooth Controller support"
    default y
    help
        Enable support for nordic controller implementations.

    if PKG_NIMBLE_CTLR

    config PKG_NIMBLE_CTLR_THREAD_STACK_SIZE
    int "The thread stack Size of Controller"
    default 1024
    help
        Set Controller thread stack size.

    config PKG_NIMBLE_CTLR_THREAD_PRIORITY
    int "The thread priority of Controller"
    default 7
    help
        Set Controller thread priority.

    choice
    prompt "Bluetooth device support"
    default PKG_NIMBLE_BSP_NRF52
    help
        Select the device controller layer support.

    config PKG_NIMBLE_BSP_NRF51
    bool "NRF51xxx"

    config PKG_NIMBLE_BSP_NRF52
    bool "NRF52xxx"

    config PKG_NIMBLE_BSP_NRF52840
    bool "NRF52840"

    endchoice

    endif

endmenu

menu "Bluetooth Mesh support"
    config PKG_NIMBLE_MESH
    bool "Bluetooth Mesh support"
    default n
    depends on PKG_NIMBLE_ROLE_BROADCASTER && PKG_NIMBLE_ROLE_OBSERVER
    help
        This option enables Bluetooth Mesh support. The specific
        features that are available may depend on other features
        that have been enabled in the stack, such as GATT support.

    if PKG_NIMBLE_MESH

    config PKG_NIMBLE_MESH_DEVICE_NAME
    string "BLE Mesh device/node name"
    default "nimble-node"
    help
        This value defines BLE Mesh device/node name.

    config PKG_NIMBLE_MESH_ADV_THREAD_STACK_SIZE
    int "The thread stack Size of Mesh advertising"
    default 1024
    help
        Set Mesh advertising thread stack size.

    config PKG_NIMBLE_MESH_ADV_THREAD_PRIORITY
    int "The thread priority of Mesh Advertising"
    default 9
    help
        Set Mesh Advertising thread priority.

    config PKG_NIMBLE_MESH_CFG_CLI
    bool "Support for Configuration Client Model"
    help
      Enable support for the configuration client model.

    endif

endmenu

menu "HCI Transport support"
    config PKG_NIMBLE_HCI_USING_RTT_UART
        bool "HCI Transport using rt-thread uart"
        default n

    if PKG_NIMBLE_HCI_USING_RTT_UART
        config PKG_NIMBLE_HCI_UART_DEVICE_NAME
            string "The uart for HCI Transport"
            default "uart1"
        config PKG_NIMBLE_HCI_UART_FLOWCONTROL_CTSRTS
            bool "Enable uart flowcontrol CTS/RTS"
            default n
    endif

endmenu

menu "Device Driver support"

endmenu

choice
    prompt "Log level"
    default NIMBLE_DEBUG_LEVEL_I
    help
        select the NIMBLE log level

    config NIMBLE_DEBUG_LEVEL_O
        bool "OFF"

    config NIMBLE_DEBUG_LEVEL_E
        bool "ERROR"

    config NIMBLE_DEBUG_LEVEL_W
        bool "WARING"

    config NIMBLE_DEBUG_LEVEL_I
        bool "INFO"

    config NIMBLE_DEBUG_LEVEL_D
        bool "DEBUG"

endchoice

config NIMBLE_DEBUG_LEVEL
    # Virtual/hidden option
    int
    default -1 if NIMBLE_DEBUG_LEVEL_O
    default 0 if NIMBLE_DEBUG_LEVEL_E
    default 1 if NIMBLE_DEBUG_LEVEL_W
    default 2 if NIMBLE_DEBUG_LEVEL_I
    default 3 if NIMBLE_DEBUG_LEVEL_D
    default 2

choice
    prompt "Bluetooth Samples"
    default PKG_NIMBLE_SAMPLE_DISABLE
    help
        select the NimBLE samples

    config PKG_NIMBLE_SAMPLE_DISABLE
        bool "Not enable sample"

    config PKG_NIMBLE_SAMPLE_PER_HR
        bool "BLE peripheral heartrate sensor"
        select NIMBT_ROLE_PERIPHERAL

    config PKG_NIMBLE_SAMPLE_BLECSC
        bool "BLE peripheral cycling speed and cadence sensor"
        select NIMBT_ROLE_PERIPHERAL

    config PKG_NIMBLE_SAMPLE_BLEUART
        bool "BLE uart sample"

    config PKG_NIMBLE_SAMPLE_BTSHELL
        bool "BLE Shell sample exposing the nimble GAP and GATT"

    config PKG_NIMBLE_SAMPLE_PERIPHERAL
        bool "BLE peripheral role sample"

    config PKG_NIMBLE_SAMPLE_CENTRAL
        bool "BLE central role sample"

    config PKG_NIMBLE_SAMPLE_BEACON
        bool "BLE beacon sample"
        select NIMBT_ROLE_BROADCASTER

    config PKG_NIMBLE_SAMPLE_ADVERTISER
        bool "BLE advertiser sample"
        select NIMBT_ROLE_BROADCASTER

    config PKG_NIMBLE_SAMPLE_EXT_ADVERTISER
        bool "BLE external advertiser sample"

    config PKG_NIMBLE_SAMPLE_BLEMESH
        bool "BLE Mesh sample"
        select PKG_NIMBLE_MESH

endchoice

config PKG_NIMBLE_MAX_CONNECTIONS
    int "Maximum number of concurrent connections"
    range 1 32
    default 1
    help
      Maximum number of concurrent Bluetooth connections supported.

config PKG_NIMBLE_WHITELIST
    bool "Device Whitelist Support"
    default y
    help
        Enables the BLE whitelist for controlling who to connect to
        oraccept a connection from.

config PKG_NIMBLE_MULTI_ADV_INSTANCES
    int "The number of multi-advertising instances"
    default 0
    depends on PKG_NIMBLE_ROLE_BROADCASTER
    help
        This is the number of multi-advertising instances. This is NOT
        the total number of advertising instances. The total number of
        advertising instances is this number plus 1.

config PKG_NIMBLE_EXT_ADV
    bool "Extended Advertising Feature Support"
    default n
    depends on PKG_NIMBLE_ROLE_BROADCASTER
    help
        This enables extended advertising feature.

config PKG_NIMBLE_EXT_ADV_MAX_SIZE
    int "The number of multi-advertising instances"
    range 31 1650
    default 31
    depends on PKG_NIMBLE_EXT_ADV
    help
        This allows to configure maximum size of advertising data and scan
        response data used in LE Advertising Extensions. Valid range 31-1650.

    choice
        prompt "Version"
        default PKG_USING_NIMBLE_V100
        help
            Select the package version

        config PKG_USING_NIMBLE_V100
            bool "v1.0.0"

        config PKG_USING_NIMBLE_LATEST_VERSION
            bool "latest"
    endchoice

    config PKG_NIMBLE_VER
       string
       default "v1.0.0"    if PKG_USING_NIMBLE_V100
       default "latest"    if PKG_USING_NIMBLE_LATEST_VERSION

endif
```

## iot/OpENer/Kconfig
```kconfig
# Kconfig file for package OpENer
menuconfig PKG_USING_OPENER
    bool "OpENer: EtherNet/IP stack for I/O adapter devices"
    default n
    select RT_USING_SAL             if RT_VER_NUM < 0x40100
    select SAL_USING_POSIX          if RT_VER_NUM < 0x40100
    select RT_USING_DFS             if RT_VER_NUM < 0x40100
    select RT_USING_POSIX_FS        if RT_VER_NUM >= 0x40100
    select RT_USING_POSIX_STDIO     if RT_VER_NUM >= 0x40100
    select RT_USING_POSIX_SOCKET    if RT_VER_NUM >= 0x40100

if PKG_USING_OPENER

    config PKG_OPENER_PATH
        string
        default "/packages/iot/OpENer"

    config PKG_OPENER_HOSTNAME
        string "Set OpENer hostname"
        default "rtthreaddev"

    config PKG_OPENER_WITH_TRACES
        bool "Enable OpENer traces"
        default y

    if PKG_OPENER_WITH_TRACES
        config PKG_OPENER_TRACE_LEVEL
            int "Set OpENer trace level"
            default 3
            help
                bit 0: ERR
                bit 1: WARN
                bit 2: STATE
                bit 3: INFO
    endif

    config PKG_OPENER_ETHERNET_BUFFER_SIZE
        int "Set OpENer Ethernet buffer size"
        default 512

    config OPENER_DEVICE_VENDOR_ID
        int "Set OpENer device vendor ID"
        default 1

    config OPENER_DEVICE_TYPE
        int "Set OpENer device type"
        default 12

    config OPENER_DEVICE_PRODUCT_CODE
        int "Set OpENer device product code"
        default 65001

    config OPENER_DEVICE_MAJOR_REVISION
        int "Set OpENer device major revision"
        default 2

    config OPENER_DEVICE_MINOR_REVISION
        int "Set OpENer device minor revision"
        default 3

    config OPENER_DEVICE_NAME
        string "Set OpENer device name"
        default "OpENer PC"

    choice
        prompt "OpENer Version"
        default PKG_USING_OPENER_LATEST_VERSION
        help
            Select the package version

        config PKG_USING_OPENER_LATEST_VERSION
            bool "latest"
    endchoice

    config PKG_OPENER_VER
       string
       default "latest"    if PKG_USING_OPENER_LATEST_VERSION

    config PKG_OPENER_VER_NUM
        hex
        default 0x99999    if PKG_USING_OPENER_LATEST_VERSION

    config PKG_USING_OPENER_PORT
        bool
        default y

    if PKG_USING_OPENER_PORT

        config PKG_OPENER_PORT_PATH
            string
            default "/packages/iot/OpENer/OpENer_port"

        choice
            prompt "OpENer Port Version"
            default PKG_USING_OPENER_PORT_LATEST_VERSION
            help
                Select the package version

            config PKG_USING_OPENER_PORT_LATEST_VERSION
                bool "latest"
        endchoice

        config PKG_OPENER_PORT_VER
            string
            default "latest"    if PKG_USING_OPENER_PORT_LATEST_VERSION

         config PKG_OPENER_PORT_VER_NUM
             hex
             default 0x99999    if PKG_USING_OPENER_PORT_LATEST_VERSION
    endif

endif
```

## iot/OpENer_port/Kconfig
```kconfig
# Kconfig file for package OpENer_port
menuconfig PKG_USING_OPENER_PORT
    bool "OpENer_port: Porting layer for OpENer"
    default n

if PKG_USING_OPENER_PORT

    config PKG_OPENER_PORT_PATH
        string
        default "/packages/iot/OpENer_port"

    choice
        prompt "Version"
        default PKG_USING_OPENER_PORT_LATEST_VERSION
        help
            Select the package version

        config PKG_USING_OPENER_PORT_LATEST_VERSION
            bool "latest"
    endchoice

    config PKG_OPENER_PORT_VER
       string
       default "latest"    if PKG_USING_OPENER_PORT_LATEST_VERSION

    config PKG_OPENER_PORT_VER_NUM
        hex
        default 0x99999    if PKG_USING_OPENER_PORT_LATEST_VERSION
endif
```

## iot/RyanMqtt/Kconfig
```kconfig
# Kconfig file for package RyanMqtt
menuconfig PKG_USING_RYANMQTT
    bool "RyanMqtt: 支持 MQTT3.1.1 协议所有特性的mqtt客户端"
    default n
    select RT_USING_SAL
    select RT_USING_ULOG        if PKG_RYANMQTT_VER_NUM < 0x110
    select ULOG_USING_COLOR     if PKG_RYANMQTT_VER_NUM < 0x110

if PKG_USING_RYANMQTT

    config PKG_USING_RYANMQTT_EXAMPLE
        bool "启用RyanMqtt msh示例"
        default y

    config PKG_RYANMQTT_PATH
        string
        default "/packages/iot/RyanMqtt"

    choice
        prompt "版本选择: 推荐首选latest, 其次选择最后一个版本, 其余版本不推荐"
        default PKG_USING_RYANMQTT_LATEST_VERSION
        help
            Select the package version

        config PKG_USING_RYANMQTT_V001
            bool "v0.0.1"

        config PKG_USING_RYANMQTT_V100
            bool "v1.0.0"

        config PKG_USING_RYANMQTT_V110
            bool "v1.1.0"

        config PKG_USING_RYANMQTT_V120
            bool "v1.2.0"

        config PKG_USING_RYANMQTT_LATEST_VERSION
            bool "latest"
    endchoice

    config PKG_RYANMQTT_VER
       string
       default "v0.0.1"    if PKG_USING_RYANMQTT_V001
       default "v1.0.0"    if PKG_USING_RYANMQTT_V100
       default "v1.1.0"    if PKG_USING_RYANMQTT_V110
       default "v1.2.0"    if PKG_USING_RYANMQTT_V120
       default "latest"    if PKG_USING_RYANMQTT_LATEST_VERSION

    config PKG_RYANMQTT_VER_NUM
       hex
       default 0x001    if PKG_USING_RYANMQTT_V001
       default 0x100    if PKG_USING_RYANMQTT_V100
       default 0x110    if PKG_USING_RYANMQTT_V110
       default 0x120    if PKG_USING_RYANMQTT_V120
       default 0xfff    if PKG_USING_RYANMQTT_LATEST_VERSION

endif
```

## iot/RyanW5500/Kconfig
```kconfig
# Kconfig file for package RyanW5500
menuconfig PKG_USING_RYANW5500
    bool "RyanW5500"
    default n
    select RT_USING_PIN
    select RT_USING_SPI
    select RT_USING_POSIX
    select RT_USING_SAL
    select RT_USING_ULOG
    select ULOG_USING_COLOR

if PKG_USING_RYANW5500

    config PKG_RYANW5500_PATH
        string
        default "/packages/iot/RyanW5500"

    config PKG_USING_RYANW5500_EXAMPLE
        bool "Enable RyanW5500 example"
        default y


    config RYANW5500_SPI_DEVICE
        string "SPI device name"
        default "spi26"

    config RYANW5500_RST_PIN
        int "Reset PIN number"
        default 32

    config RYANW5500_IRQ_PIN
        int "IRQ PIN number"
        default 33


    choice
        prompt "Version"
        default PKG_USING_RYANW5500_LATEST_VERSION
        help
            Select the package version

        config PKG_USING_RYANW5500_V001
            bool "v0.0.1"

        config PKG_USING_RYANW5500_LATEST_VERSION
            bool "latest"
    endchoice

    config PKG_RYANW5500_VER
       string
       default "v0.0.1"    if PKG_USING_RYANW5500_V001
       default "latest"    if PKG_USING_RYANW5500_LATEST_VERSION

endif
```

## iot/WebTerminal/Kconfig
```kconfig
menuconfig PKG_USING_WEBTERMINAL
    bool "WebTerminal: Terminal runs in a Web browser"
    default n

if PKG_USING_WEBTERMINAL

    config PKG_WEBTERMINAL_PATH
        string
        default "/packages/iot/WebTerminal"

    config PKG_WEBTERMINAL_PORT
        string
        prompt "The port number for Web terminal"
        default "8090"

    choice
        prompt "Version"
        help
            Select the this package version

        config PKG_USING_WEBTERMINAL_V00102
            bool "v0.1.2"

        config PKG_USING_WEBTERMINAL_LATEST_VERSION
            bool "latest"
    endchoice

    config PKG_WEBTERMINAL_VER
        string
        default "v0.1.2" if PKG_USING_WEBTERMINAL_V00102
        default "latest" if PKG_USING_WEBTERMINAL_LATEST_VERSION

endif
```

## iot/WiFi/Kconfig
```kconfig
    menu "Wi-Fi"

    source "$PKGS_DIR/packages/iot/WiFi/wlanmarvell/Kconfig"
    source "$PKGS_DIR/packages/iot/WiFi/wlan_wiced/Kconfig"
    source "$PKGS_DIR/packages/iot/WiFi/rw007/Kconfig"
    source "$PKGS_DIR/packages/iot/WiFi/wlan_cyw43012/Kconfig"
    source "$PKGS_DIR/packages/iot/WiFi/wlan_bl808/Kconfig"
    source "$PKGS_DIR/packages/iot/WiFi/wlan_cyw43439/Kconfig"

    endmenu
```
