## peripherals/hal-sdk/bluetrum_sdk/Kconfig
```kconfig
# Kconfig file for package bluetrum_sdk
menuconfig PKG_USING_BLUETRUM_SDK
    bool "bluetrum sdk"
    default n

if PKG_USING_BLUETRUM_SDK

    config PKG_BLUETRUM_SDK_PATH
        string
        default "/packages/peripherals/hal-sdk/bluetrum_sdk"

    choice
        prompt "Version"
        default PKG_USING_BLUETRUM_SDK_V002
        help
            Select the package version

        config PKG_USING_BLUETRUM_SDK_V003_FIX
            bool "v0.0.3-fix"

        config PKG_USING_BLUETRUM_SDK_V002
            bool "v0.0.2"

        config PKG_USING_BLUETRUM_SDK_V001
            bool "v0.0.1"

        config PKG_USING_BLUETRUM_SDK_LATEST_VERSION
            bool "latest"
    endchoice

    config PKG_BLUETRUM_SDK_VER
       string
       default "v0.0.3"    if PKG_USING_BLUETRUM_SDK_V003
       default "v0.0.2"    if PKG_USING_BLUETRUM_SDK_V002
       default "v0.0.1"    if PKG_USING_BLUETRUM_SDK_V001
       default "latest"    if PKG_USING_BLUETRUM_SDK_LATEST_VERSION

endif
```

## peripherals/hal-sdk/ft32/Kconfig
```kconfig
menu "FT32 HAL & SDK Drivers"

# FT32F0
source "$PKGS_DIR/packages/peripherals/hal-sdk/ft32/ft32f0_std_driver/Kconfig"
source "$PKGS_DIR/packages/peripherals/hal-sdk/ft32/ft32f0_cmsis_driver/Kconfig"

# FT32F4
source "$PKGS_DIR/packages/peripherals/hal-sdk/ft32/ft32f4_std_driver/Kconfig"
source "$PKGS_DIR/packages/peripherals/hal-sdk/ft32/ft32f4_cmsis_driver/Kconfig"

endmenu
```

## peripherals/hal-sdk/ft32/ft32f0_cmsis_driver/Kconfig
```kconfig
# Kconfig file for package ft32f0_cmsis_driver
menuconfig PKG_USING_FT32F0_CMSIS_DRIVER
    bool "FT32 F0 CMSIS driver package"
    select PKG_USING_CMSIS_CORE
    default n

if PKG_USING_FT32F0_CMSIS_DRIVER

    config PKG_FT32F0_CMSIS_DRIVER_PATH
        string
        default "/packages/peripherals/hal-sdk/ft32/ft32f0_cmsis_driver"

    choice
        prompt "Version"
        help
            Select the package version

        config PKG_USING_FT32F0_CMSIS_DRIVER_LATEST_VERSION
            bool "latest"
    endchoice

    config PKG_FT32F0_CMSIS_DRIVER_VER
       string
       default "latest"    if PKG_USING_FT32F0_CMSIS_DRIVER_LATEST_VERSION

endif
```

## peripherals/hal-sdk/ft32/ft32f0_std_driver/Kconfig
```kconfig
# Kconfig file for package ft32f0_std_driver
menuconfig PKG_USING_FT32F0_STD_DRIVER
    bool "FT32 F0 STD driver package"
    select PKG_USING_FT32F0_CMSIS_DRIVER
    default n

if PKG_USING_FT32F0_STD_DRIVER

    config PKG_FT32F0_STD_DRIVER_PATH
        string
        default "/packages/peripherals/hal-sdk/ft32/ft32f0_std_driver"

    choice
        prompt "Version"
        help
            Select the package version

        config PKG_USING_FT32F0_STD_DRIVER_LATEST_VERSION
            bool "latest"
    endchoice

    config PKG_FT32F0_STD_DRIVER_VER
       string
       default "latest"    if PKG_USING_FT32F0_STD_DRIVER_LATEST_VERSION

endif
```

## peripherals/hal-sdk/gd32/Kconfig
```kconfig
menu "GD32 Drivers"

#GD32_ARM
source "$PKGS_DIR/packages/peripherals/hal-sdk/gd32/gd32-arm-cmsis/Kconfig"
source "$PKGS_DIR/packages/peripherals/hal-sdk/gd32/gd32-arm-series/Kconfig"

endmenu
```

## peripherals/hal-sdk/gd32/gd32-arm-cmsis/Kconfig
```kconfig
# Kconfig file for package gd32_arm_cmsis_driver
menuconfig PKG_USING_GD32_ARM_CMSIS_DRIVER
    bool "GD32 ARM CMSIS DRIVER PACKAGE"
    default n

if PKG_USING_GD32_ARM_CMSIS_DRIVER

    config PKG_GD32_ARM_CMSIS_DRIVER_PATH
        string
        default "/packages/peripherals/hal-sdk/gd32/gd32-arm-cmsis"

    choice
        prompt "Version"
        help
            Select the package version

        config PKG_USING_GD32_ARM_CMSIS_DRIVER_LATEST_VERSION
            bool "latest"
    endchoice

    config PKG_GD32_ARM_CMSIS_DRIVER_VER
       string
       default "latest"    if PKG_USING_GD32_ARM_CMSIS_DRIVER_LATEST_VERSION

endif
```
