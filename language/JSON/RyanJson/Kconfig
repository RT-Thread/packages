## misc/MFBD/Kconfig
```kconfig
# Kconfig file for package MFBD
menuconfig PKG_USING_MFBD
    bool "Multi-Function Button Detection for MCU"
    default n

if PKG_USING_MFBD

    config PKG_MFBD_PATH
        string
        default "/packages/misc/MFBD"

    config PKG_USING_MFBD_DEMO_RTT
        bool "Enable Multi-Function Button Detection demo"
        default n

    if PKG_MFBD_VER_NUM >= 0x010003
        choice
            prompt "the type of mfbd_btn_code_t"
            default PKG_MFBD_BTN_CODE_SIZE_2BYTE
            config PKG_MFBD_BTN_CODE_SIZE_1BYTE
                bool "uint8_t"

            config PKG_MFBD_BTN_CODE_SIZE_2BYTE
                bool "uint16_t"

            config PKG_MFBD_BTN_CODE_SIZE_4BYTE
                bool "uint32_t"

            config PKG_MFBD_BTN_CODE_SIZE_8BYTE
                bool "uint64_t"
        endchoice

        config PKG_MFBD_BTN_CODE_SIZE
            int
            default 1 if PKG_MFBD_BTN_CODE_SIZE_1BYTE
            default 2 if PKG_MFBD_BTN_CODE_SIZE_2BYTE
            default 4 if PKG_MFBD_BTN_CODE_SIZE_4BYTE
            default 8 if PKG_MFBD_BTN_CODE_SIZE_8BYTE

        choice
            prompt "the type of mfbd_btn_count_t"
            default PKG_MFBD_BTN_COUNT_SIZE_2BYTE
            config PKG_MFBD_BTN_COUNT_SIZE_1BYTE
                bool "uint8_t"

            config PKG_MFBD_BTN_COUNT_SIZE_2BYTE
                bool "uint16_t"

            config PKG_MFBD_BTN_COUNT_SIZE_4BYTE
                bool "uint32_t"

            config PKG_MFBD_BTN_COUNT_SIZE_8BYTE
                bool "uint64_t"
        endchoice

        config PKG_MFBD_BTN_COUNT_SIZE
            int
            default 1 if PKG_MFBD_BTN_COUNT_SIZE_1BYTE
            default 2 if PKG_MFBD_BTN_COUNT_SIZE_2BYTE
            default 4 if PKG_MFBD_BTN_COUNT_SIZE_4BYTE
            default 8 if PKG_MFBD_BTN_COUNT_SIZE_8BYTE

        choice
            prompt "the type of mfbd_btn_index_t"
            default PKG_MFBD_BTN_INDEX_SIZE_4BYTE
            config PKG_MFBD_BTN_INDEX_SIZE_1BYTE
                bool "uint8_t"

            config PKG_MFBD_BTN_INDEX_SIZE_2BYTE
                bool "uint16_t"

            config PKG_MFBD_BTN_INDEX_SIZE_4BYTE
                bool "uint32_t"

            config PKG_MFBD_BTN_INDEX_SIZE_8BYTE
                bool "uint64_t"

            config PKG_MFBD_BTN_INDEX_SIZE_PVOID
                bool "void *"
        endchoice

        config PKG_MFBD_BTN_INDEX_SIZE
            int
            default 1 if PKG_MFBD_BTN_INDEX_SIZE_1BYTE
            default 2 if PKG_MFBD_BTN_INDEX_SIZE_2BYTE
            default 4 if PKG_MFBD_BTN_INDEX_SIZE_4BYTE
            default 8 if PKG_MFBD_BTN_INDEX_SIZE_8BYTE
            default 0 if PKG_MFBD_BTN_INDEX_SIZE_PVOID

        config PKG_MFBD_USE_TINY_BUTTON
            bool
            prompt "enable tiny button functions."
            default y

        config PKG_MFBD_USE_NORMAL_BUTTON
            bool
            prompt "enable normal button functions."
            default y

        config PKG_MFBD_USE_MULTIFUCNTION_BUTTON
            bool
            prompt "enable multifunction button functions."
            default y

        config PKG_MFBD_USE_BTN_SCAN_PRE_FUNC
            bool
            prompt "enable run prepare_function before run button detection function."
            default n

        config PKG_MFBD_USE_BTN_SCAN_AFTER_FUNC
            bool
            prompt "enable run after_function after run button detection function."
            default n

        config PKG_MFBD_PARAMS_SAME_IN_GROUP
            bool
            prompt "enable all key's params are same."
            default n
    endif

    if PKG_MFBD_VER_NUM >= 0x010004
        config PKG_MFBD_USE_SECTION_DEFINITION
            bool "enable use section definitions."
            default n

        config PKG_MFBD_MULTICLICK_STATE_AUTO_RESET
            bool "reset multiclick state to 0 when reach to max multicick state."
            default y
    endif

    if PKG_MFBD_VER_NUM >= 0x010005
        config PKG_MFBD_MBTN_CONTINUE_LONG_COUNT
            bool "continue count to change state to long after when multiclick state is not 0."
            default n

        if PKG_MFBD_MBTN_CONTINUE_LONG_COUNT
            config PKG_MFBD_MBTN_MULTICLICK_LONG_EVT
                bool "report long code and repeat downcodes after multiclick, valid when enable PKG_MFBD_MBTN_CONTINUE_LONG_COUNT."
                default y
        endif
    endif

    choice
        prompt "Version"
        default PKG_USING_MFBD_LATEST_VERSION
        help
            Select the package version

        config PKG_USING_MFBD_V105
            bool "v1.0.5"

        config PKG_USING_MFBD_V104
            bool "v1.0.4"

        config PKG_USING_MFBD_V103
            bool "v1.0.3"

        config PKG_USING_MFBD_V102
            bool "v1.0.2"

        config PKG_USING_MFBD_V101
            bool "v1.0.1"

        config PKG_USING_MFBD_V100
            bool "v1.0.0"

        config PKG_USING_MFBD_LATEST_VERSION
            bool "latest"
    endchoice

    config PKG_MFBD_VER
       string
       default "v1.0.5"    if PKG_USING_MFBD_V105
       default "v1.0.4"    if PKG_USING_MFBD_V104
       default "v1.0.3"    if PKG_USING_MFBD_V103
       default "v1.0.2"    if PKG_USING_MFBD_V102
       default "v1.0.1"    if PKG_USING_MFBD_V101
       default "v1.0.0"    if PKG_USING_MFBD_V100
       default "latest"    if PKG_USING_MFBD_LATEST_VERSION

    config PKG_MFBD_VER_NUM
        hex
        default 0x010005 if PKG_USING_MFBD_V105
        default 0x010004 if PKG_USING_MFBD_V104
        default 0x010003 if PKG_USING_MFBD_V103
        default 0x010002 if PKG_USING_MFBD_V102
        default 0x010001 if PKG_USING_MFBD_V101
        default 0x010000 if PKG_USING_MFBD_V100
        default 0x999999 if PKG_USING_MFBD_LATEST_VERSION

endif
```

## misc/MultiButton/Kconfig
```kconfig
menuconfig PKG_USING_MULTIBUTTON
    bool "MultiButton: A compact and easy to use event-driven button driver"
    default n

if PKG_USING_MULTIBUTTON
    config PKG_MULTIBUTTON_PATH
        string
        default "/packages/misc/MultiButton"

    config MULTIBUTTON_USING_EXAMPLE_ASYNC
        bool
        prompt "MultiButton async example"
        default n

    config MULTIBUTTON_USING_EXAMPLE_INQUIRE
        bool
        prompt "MultiButton inquire example"
        default n

    choice
        prompt "Version"
        help
            Select the this package version

        config PKG_USING_MULTIBUTTON_V121
            bool "v1.2.1"

        config PKG_USING_MULTIBUTTON_V120
            bool "v1.2.0"

        config PKG_USING_MULTIBUTTON_LATEST_VERSION
            bool "latest"
    endchoice

    config PKG_MULTIBUTTON_VER
        string
        default "v1.2.1" if PKG_USING_MULTIBUTTON_V121
        default "v1.2.0" if PKG_USING_MULTIBUTTON_V120
        default "latest" if PKG_USING_MULTIBUTTON_LATEST_VERSION

endif
```

## misc/PLL/Kconfig
```kconfig
# Kconfig file for package PLL
menuconfig PKG_USING_PLL
    bool "SOGI-based PLL and FLL library"
    default n
    help
        PLL package is an implementation of SOGI based PLL and FLL.

if PKG_USING_PLL

    config PKG_PLL_PATH
        string
        default "/packages/misc/PLL"

    choice
        prompt "Version"
        default PKG_USING_PLL_LATEST_VERSION
        help
            Select the PLL version

        config PKG_USING_PLL_LATEST_VERSION
            bool "latest"

        config PKG_USING_PLL_V1_0_0
            bool "v1.0.0"
    endchoice

    config PKG_PLL_VER
        string
        default "latest" if PKG_USING_PLL_LATEST_VERSION
        default "v1.0.0" if PKG_USING_PLL_V1_0_0
endif
```
