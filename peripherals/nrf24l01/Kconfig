## peripherals/quick_led/Kconfig
```kconfig
# Kconfig file for package quick_led

menuconfig PKG_USING_QLED
    bool "quick_led : A quick and easy-to-use led driver package."
    default n

if PKG_USING_QLED

    config PKG_QLED_PATH
        string
        default "/packages/peripherals/quick_led"

    config QLED_TOTAL
        int "Led maximum total"
        default 5

    config QLED_TIME_UNIT_MS
        int "Led blink time unit, unit : ms"
        default 10

    config QLED_THREAD_NAME
        string "Led driver thread name"
        default "qled"

    config QLED_THREAD_STACK_SIZE
        int "Led driver thread stack size"
        default 512

    config QLED_THREAD_PRIO
        int "Led driver thread priority"
        default 3

    config QLED_USING_SAMPLE
        bool "using sample"
        default n

    if QLED_USING_SAMPLE

        config QLED_RUN_PIN
            int "Sample running led pin"
            default -1

        config QLED_SOS_PIN
            int "Sample sos signal led pin"
            default -1

    endif

    choice
        prompt "Version"
        default PKG_USING_QLED_LATEST_VERSION
        help
            Select the package version

        config PKG_USING_QLED_LATEST_VERSION
            bool "latest"

        config PKG_USING_QLED_V102
            bool "v1.02"

        config PKG_USING_QLED_V101
            bool "v1.01"

        config PKG_USING_QLED_V100
            bool "v1.00"
    endchoice

    config PKG_QLED_VER
       string
       default "latest" if PKG_USING_QLED_LATEST_VERSION
       default "v1.02"  if PKG_USING_QLED_V102
       default "v1.01"  if PKG_USING_QLED_V101
       default "v1.00"  if PKG_USING_QLED_V100

endif
```

## peripherals/rc522/Kconfig
```kconfig
# Kconfig file for package rc522
menuconfig PKG_USING_RC522
    bool "rc522: rfid module driver"
    default n

if PKG_USING_RC522

    config MFRC522_SPI_BUS_NAME
        string "spi bus name"
        default "spi1"

    config MFRC522_SPI_DEVICE_NAME
        string "spi device name"
        default "spi10"

    comment "Notice: PH3 --> 115" 
    config MFRC522_SS_PIN
        int "RC522 CS pin num"
        range 1 176
        default 115

    comment "Notice: PH8 --> 120" 
    config MFRC522_RST_PIN
        int "RC522 RST pin num"
        range 1 176
        default 120

    config PKG_USING_RC522_SAMPLE
        bool "Enable RC522 SAMPLE"
        default n

    config PKG_RC522_PATH
        string
        default "/packages/peripherals/rc522"

    choice
        prompt "Version"
        default PKG_USING_RC522_LATEST_VERSION
        help
            Select the package version

        config PKG_USING_RC522_V145
            bool "v1.4.5"

        config PKG_USING_RC522_LATEST_VERSION
            bool "latest"
    endchoice

    config PKG_RC522_VER
       string
       default "v1.4.5"    if PKG_USING_RC522_V145
       default "latest"    if PKG_USING_RC522_LATEST_VERSION

endif
```

## peripherals/rda58xx/Kconfig
```kconfig
# Kconfig file for package rda58xx
menuconfig PKG_USING_RDA58XX
    bool "RDA58xx single-chip broadcase FM transceiver driver."
    default n

if PKG_USING_RDA58XX

    config PKG_RDA58XX_PATH
        string
        default "/packages/peripherals/rda58xx"

    choice
        prompt "Version"
        default PKG_USING_RDA58XX_LATEST_VERSION
        help
            Select the package version

        config PKG_USING_RDA58XX_V100
            bool "v1.0.0"

        config PKG_USING_RDA58XX_LATEST_VERSION
            bool "latest"
    endchoice

    config PKG_RDA58XX_VER
       string
       default "v1.0.0"    if PKG_USING_RDA58XX_V100
       default "latest"    if PKG_USING_RDA58XX_LATEST_VERSION

endif
```

## peripherals/realtek_ameba/Kconfig
```kconfig
# Kconfig file for package realtek_ameba
config PKG_USING_REALTEK_AMEBA
    bool "realtek_ameba: ameba sdk package for rt-thread"
    default n

if PKG_USING_REALTEK_AMEBA

    config PKG_REALTEK_AMEBA_PATH
        string
        default "/packages/peripherals/realtek_ameba"

    choice
        prompt "realtek_ameba version"
        help
            Select the realtek_ameba version

        config PKG_USING_REALTEK_AMEBA_LATEST_VERSION
            bool "latest"

        config PKG_USING_REALTEK_AMEBA_V100
            bool "v1.0.0"
    endchoice

    config PKG_REALTEK_AMEBA_VER
       string
       default "v1.0.0"    if PKG_USING_REALTEK_AMEBA_V100
       default "latest"    if PKG_USING_REALTEK_AMEBA_LATEST_VERSION

endif
```

## peripherals/rfm300/Kconfig
```kconfig
# Kconfig file for package rfm300
menuconfig PKG_USING_RFM300
    bool "RFM300: ISM Transceiver Module With +20dBm(100mW) Output Power."
    default n

if PKG_USING_RFM300

    config PKG_RFM300_SPI_BUS_NAME
        string "The spi bus of rfm300"
        default "spi0"

    config PKG_RFM300_SPI_DEV_NAME
        string "The spi device name for rfm300"
        default "rfm300"

    config PKG_RFM300_FIFO_SPI_DEV_NAME
        string "The spi device name for rfm300 fifo"
        default "rfm300_fifo"

    config PKG_RFM300_CSB_PIN
        int "The CSB pin of rfm300"
        default -1

    config PKG_RFM300_FCSB_PIN
        int "The FCSB pin of rfm300"
        default -1

    config PKG_RFM300_GPIO1_PIN
        int "The GPIO1 pin of rfm300"
        default -1

    config PKG_RFM300_GPIO2_PIN
        int "The GPIO2 pin of rfm300"
        default -1

    config PKG_RFM300_GPIO3_PIN
        int "The GPIO3 pin of rfm300"
        default -1

    config PKG_USING_RFM300_DEMO
        bool "Use demo"
        default n

    config PKG_RFM300_PATH
        string
        default "/packages/peripherals/rfm300"

    choice
        prompt "Version"
        default PKG_USING_RFM300_LATEST_VERSION
        help
            Select the package version

        config PKG_USING_RFM300_LATEST_VERSION
            bool "latest"
    endchoice

    config PKG_RFM300_VER
       string
       default "latest"    if PKG_USING_RFM300_LATEST_VERSION

endif
```

## peripherals/rosserial/Kconfig
```kconfig
# Kconfig file for package ROSSERIAL
menuconfig PKG_USING_ROSSERIAL
    bool "rosserial: a protocol for Robots Operating System (ROS)"
    default n

if PKG_USING_ROSSERIAL

    config PKG_ROSSERIAL_PATH
        string
        default "/packages/peripherals/rosserial"

    choice
        prompt "Device type"
        default ROSSERIAL_USE_SERIAL

        config ROSSERIAL_USE_SERIAL
            bool "UART"
        config ROSSERIAL_USE_TCP
            bool "TCP"
    endchoice

    if ROSSERIAL_USE_SERIAL
        config ROSSERIAL_UART_NAME
        string "serial device name"
        default "uart2"
    endif

    if ROSSERIAL_USE_TCP
        config ROSSERIAL_TCP_RECV_TIMEOUT
        int "Socket receive timeout in microseconds"
        default "200000"

        config ROSSERIAL_TCP_SEND_TIMEOUT
        int "Socket send timeout in microseconds"
        default "200000"

    endif

    menu "roserial examples"

        if ROSSERIAL_USE_SERIAL
            config ROSSERIAL_USING_HELLO_WORLD_UART
                bool "Hello World : hello world example using UART"
                select RT_USING_SERIAL
                help
                    Hello World example using UART
                default n

            if PKG_ROSSERIAL_VER_NUM > 0x20000
                config ROSSERIAL_USING_BLINK_UART
                    bool "Blink       : blink example using UART"
                    help
                        Blink : blink example using UART
                    default n

                config ROSSERIAL_USING_BLINK_CLASS_UART
                    bool "Blink Class : blink class example using UART"
                    help
                        Blink Class : blink class example using UART
                    default n

                config ROSSERIAL_USING_BUTTON_UART
                    bool "Button      : button example using UART"
                    help
                        Button : button example using UART
                    default n

                config ROSSERIAL_USING_PUB_SUB_UART
                    bool "PubSub      : publish and subscribe example using UART"
                    help
                        PubSub : publish and subscribe example using UART
                    default n

                config ROSSERIAL_USING_LOGGING_UART
                    bool "Logging     : logging example using UART"
                    help
                        Logging : logging example using UART
                    default n

                config ROSSERIAL_USING_TF_UART
                    bool "TF         : tf example using UART"
                    help
                        TF : tf example using UART
                    default n

                config ROSSERIAL_USING_SERVICE_SERVER_UART
                    bool "Service server : service example using UART"
                    help
                        Service server : service example using UART
                    default n

            config ROSSERIAL_USING_SERVICE_CLIENT_UART
                bool "Service client : service example using UART"
                help
                    Service client : service example using UART
                default n
            endif
        endif

        if ROSSERIAL_USE_TCP
            config ROSSERIAL_USING_HELLO_WORLD_TCP
                bool "Hello World  : hello world example using TCP"
                select RT_USING_SAL
                help
                    Hello World example using TCP
                default n
        endif

        comment "You may only choose one example at a time"

    endmenu

    choice
        prompt "Version"
        default PKG_USING_ROSSERIAL_MLATEST_VERSION
        help
            Select the package version
        config PKG_USING_ROSSERIAL_KV100
            bool "kinetic-v1.0.0"
        config PKG_USING_ROSSERIAL_MV100
            bool "melodic-v1.0.0"
        config PKG_USING_ROSSERIAL_KLATEST_VERSION
            bool "kinetic-latest"
        config PKG_USING_ROSSERIAL_MLATEST_VERSION
            bool "melodic-latest"
    endchoice

    config PKG_ROSSERIAL_VER
       string
       default "kinetic-v1.0.0"    if PKG_USING_ROSSERIAL_KV100
       default "melodic-v1.0.0"    if PKG_USING_ROSSERIAL_MV100
       default "kinetic-latest"    if PKG_USING_ROSSERIAL_KLATEST_VERSION
       default "melodic-latest"    if PKG_USING_ROSSERIAL_MLATEST_VERSION

    config PKG_ROSSERIAL_VER_NUM
        hex
        default 0x10000 if PKG_USING_ROSSERIAL_KV100
        default 0x19999 if PKG_USING_ROSSERIAL_KLATEST_VERSION
        default 0x20000 if PKG_USING_ROSSERIAL_MV100
        default 0x29999 if PKG_USING_ROSSERIAL_MLATEST_VERSION

endif
```

## peripherals/rplidar/Kconfig
```kconfig
# Kconfig file for package rplidar
menuconfig PKG_USING_RPLIDAR
    select RT_USING_LIBC
    bool "RPLIDAR: a low cost LIDAR sensor suitable for indoor robotic SLAM application."
    default n

if PKG_USING_RPLIDAR

    config PKG_RPLIDAR_PATH
        string
        default "/packages/peripherals/rplidar"

    config RPLIDAR_UART_NAME
        string "uart device name"
        default "uart3"

    config RPLIDAR_USING_STOP_EXAMPLE
        bool "RPLIDAR stop example: stop lidar scanning"
        help
            RPLIDAR stop example: stop lidar scanning
        default n

    config RPLIDAR_USING_RESET_EXAMPLE
        bool "RPLIDAR reset example: reset lidar"
        help
            RPLIDAR reset example: reset lidar
        default n

    config RPLIDAR_USING_HEALTH_EXAMPLE
        bool "RPLIDAR health example: get device health info"
        help
            RPLIDAR health example: get device health info
        default n

    config RPLIDAR_USING_DEVICE_INFO_EXAMPLE
        bool "RPLIDAR device info example: get device info"
        help
            RPLIDAR device info example: get device info
        default n

    config RPLIDAR_USING_SCAN_EXAMPLE
        bool "RPLIDAR scan example: start lidar scanning"
        help
           RPLIDAR scan example: start lidar scanning
        default n

    config RPLIDAR_USING_SCAN_RECV_EXAMPLE
        bool "RPLIDAR scan and receive example: start scanning and then receive data"
        help
          RPLIDAR scan and receive example: start scanning and then receive data
        default n

    choice
        prompt "Version"
        default PKG_USING_RPLIDAR_LATEST_VERSION
        help
            Select the package version

        config PKG_USING_RPLIDAR_LATEST_VERSION
            bool "latest"
    endchoice

    config PKG_RPLIDAR_VER
       string
       default "latest"    if PKG_USING_RPLIDAR_LATEST_VERSION

    config PKG_RPLIDAR_VER_NUM
        hex
        default 0x99999 if PKG_USING_RPLIDAR_LATEST_VERSION

endif
```

## peripherals/rs232/Kconfig
```kconfig
# Kconfig file for package rs232

menuconfig PKG_USING_RS232
    bool "rs232 driver package."
    select RT_USING_SERIAL
    default n

if PKG_USING_RS232

    config PKG_RS232_PATH
        string
        default "/packages/peripherals/rs232"

    config RS232_USING_SAMPLE
        bool "using sample master"
        default n

    if RS232_USING_SAMPLE

        config RS232_SAMPLE_SERIAL
            string "serial device name"
            default "uart2"

        config RS232_SAMPLE_BAUDRATE
            int "baudrate"
            default 9600

        config RS232_SAMPLE_MASTER_PARITY
            int "parity"
            range 0 2
            default 0

    endif

    choice
        prompt "Version"
        default PKG_USING_RS232_LATEST_VERSION
        help
            Select the package version

        config PKG_USING_RS232_V100
            bool "v1.0.0"

        config PKG_USING_RS232_LATEST_VERSION
            bool "latest"
    endchoice

    config PKG_RS232_VER
       string
       default "v1.0.0"    if PKG_USING_RS232_V100
       default "latest"    if PKG_USING_RS232_LATEST_VERSION

endif
```
