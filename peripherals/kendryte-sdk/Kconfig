## peripherals/mcp23008/Kconfig
```kconfig
# Kconfig file for package mcp23008
menuconfig PKG_USING_MCP23008
    bool "mcp23008: Remote 8-bit I/O expander for I2C-bus"
    default n

if PKG_USING_MCP23008

    config PKG_MCP23008_PATH
        string
        default "/packages/peripherals/mcp23008"

    config PKG_USING_MCP23008_SAMPLE
        bool "Enable mcp23008 sample"
        default n

    choice
        prompt "Version"
        default PKG_USING_MCP23008_LATEST_VERSION
        help
            Select the package version

        config PKG_USING_MCP23008_V100
            bool "v1.0.0"

        config PKG_USING_MCP23008_LATEST_VERSION
            bool "latest"
    endchoice

    config PKG_MCP23008_VER
       string
       default "v1.0.0"    if PKG_USING_MCP23008_V100
       default "latest"    if PKG_USING_MCP23008_LATEST_VERSION

endif
```

## peripherals/mfoc/Kconfig
```kconfig
# Kconfig file for package mfoc
menuconfig PKG_USING_MFOC
    select RT_USING_DFS      if RT_VER_NUM < 0x40100
    select RT_USING_POSIX_FS if RT_VER_NUM >= 0x40100
    select PKG_USING_LIBNFC
    bool "mfoc: Mifare Classic Offline Cracker."
    default n

if PKG_USING_MFOC

    config PKG_MFOC_PATH
        string
        default "/packages/peripherals/mfoc"

    choice
        prompt "Version"
        default PKG_USING_MFOC_LATEST_VERSION
        help
            Select the package version

        config PKG_USING_MFOC_LATEST_VERSION
            bool "latest"
    endchoice

    config PKG_MFOC_VER
       string
       default "latest"    if PKG_USING_MFOC_LATEST_VERSION

endif
```

## peripherals/micro_ros/Kconfig
```kconfig
# Kconfig file for package micro_ros
menuconfig PKG_USING_MICRO_ROS
    select RT_USING_LIBC if RT_VER_NUM < 0x40100
    bool "micro_ros: ROS 2 on microcontrollers."
    default n

if PKG_USING_MICRO_ROS

    config PKG_MICRO_ROS_PATH
        string
        default "/packages/peripherals/micro_ros"

    choice
        prompt "Device type"
        default MICRO_ROS_USE_SERIAL

        config MICRO_ROS_USE_SERIAL
            bool "UART"

        config MICRO_ROS_USE_UDP
            bool "UDP"
    endchoice

    choice
        prompt "ARCH CPU"
        default MICRO_ROS_USING_ARCH_CORTEX_M3

        config MICRO_ROS_USING_ARCH_CORTEX_M0_plus
            bool "Cortex M0"
        config MICRO_ROS_USING_ARCH_CORTEX_M3
            bool "Cortex M3"
        config MICRO_ROS_USING_ARCH_CORTEX_M4_FPV4_SP_D16_SOFT
            bool "Cortex M4 (fpv4-sp-d16-soft)"
        config MICRO_ROS_USING_ARCH_CORTEX_M4_FPV4_SP_D16_HARD
            bool "Cortex M4 (fpv4-sp-d16-hard)"
        config MICRO_ROS_USING_ARCH_CORTEX_M7_FPV5_D16_SOFT
            bool "Cortex M7 (fpv5-d16-soft)"
        config MICRO_ROS_USING_ARCH_CORTEX_M7_FPV5_D16_HARD
            bool "Cortex M7 (fpv5-d16-hard)"
        config MICRO_ROS_USING_ARCH_CORTEX_M7_FPV5_SP_D16_SOFT
            bool "Cortex M7 (fpv5-sp-d16-soft)"
        config MICRO_ROS_USING_ARCH_CORTEX_M7_FPV5_SP_D16_HARD
            bool "Cortex M7 (fpv5-sp-d16-hard)"
    endchoice

    choice
        prompt "GCC Version"
        default MICRO_ROS_USING_GCC_10

        config MICRO_ROS_USING_GCC_5
            bool "ARM GCC 5.x.x"
        config MICRO_ROS_USING_GCC_10
            bool "ARM GCC 10.x.x"
    endchoice

    if MICRO_ROS_USE_SERIAL
        config MICRO_ROS_SERIAL_NAME
        string "serial device name"
        default "uart2"

    endif

    config MICRO_ROS_USING_PUB_INT32
        bool "microros_pub_int32: microros publish int32 example"
        help
            microros publish int32 example
        default n

    config MICRO_ROS_USING_SUB_INT32
        bool "microros_sub_int32: micro ros subscribe int32 example"
        help
            microros_sub_int32: micro ros subscribe int32 example
        default n

    config MICRO_ROS_USING_PUB_SUB
        bool "microros_pub_sub, micro ros pub sub example"
        help
            microros_pub_sub, micro ros pub sub example
        default n

    config MICRO_ROS_USING_PING_PONG
        bool "microros_ping_pong, micro ros ping pong example"
        help
            microros_ping_pong, micro ros ping pong example
        default n

    if MICRO_ROS_USING_PING_PONG
        comment "The Ping Pong example requires two pub and sub topics, please check the settings of rmw_microxrcedds in colcon.meta."
    endif

    config MICRO_ROS_USING_SUB_TWIST
        bool "microros_sub_twist: micro ros subscribe to twist example"
        help
            microros_sub_twist, micro ros subscribe to twist example
        default n

    config MICRO_ROS_USING_ADD_INTS_SERVICE
        bool "microros_add_ints_service: micro ros add ints service example"
        help
            microros_add_ints_service, micro ros add ints service example
        default n

    config MICRO_ROS_USING_DEINITIALIZATION
        bool "microros_deinitialization: micro ros deinitialization example"
        help
            microros_deinitialization, micro ros deinitialization example
        default n

    config MICRO_ROS_USING_KOBUKI_CONTROL
        select PKG_USING_KOBUKI
        bool "microros_kobuki_control, micro ros control kobuki robot example"
        help
            microros_kobuki_control, micro ros control kobuki robot example
        default n

    if MICRO_ROS_USING_KOBUKI_CONTROL
        config KOBUKI_SERIAL_NAME
        string "kobuki serial port"
        default "uart2"
    endif

    choice
        prompt "Version"
        default PKG_USING_MICRO_ROS_HUMBLE_GCC_10   if MICRO_ROS_USING_GCC_10
        default PKG_USING_MICRO_ROS_HUMBLE_GCC_5    if MICRO_ROS_USING_GCC_5
        help
            Select the package version

        config PKG_USING_MICRO_ROS_HUMBLE_GCC_5
            bool "humble-gcc-5"
            depends on MICRO_ROS_USING_GCC_5

        config PKG_USING_MICRO_ROS_GALACTIC_GCC_5
            bool "galactic-gcc-5"
            depends on MICRO_ROS_USING_GCC_5

        config PKG_USING_MICRO_ROS_FOXY_LEGACY
            bool "foxy (legacy)"
            depends on MICRO_ROS_USING_GCC_5

        config PKG_USING_MICRO_ROS_GALACTIC_LEGACY
            bool "galactic (legacy)"
            depends on MICRO_ROS_USING_GCC_5

        config PKG_USING_MICRO_ROS_HUMBLE_GCC_10
            bool "humble-gcc-10"
            depends on MICRO_ROS_USING_GCC_10

        config PKG_USING_MICRO_ROS_GALACTIC_GCC_10
            bool "galactic-gcc-10"
            depends on MICRO_ROS_USING_GCC_10

        config PKG_USING_MICRO_ROS_HUMBLE_GCC_10_STANDALONE
            bool "humble-gcc-10 (standalone)"
            depends on MICRO_ROS_USING_GCC_10

        config PKG_USING_MICRO_ROS_GALACTIC_GCC_10_STANDALONE
            bool "galactic-gcc-10 (standalone)"
            depends on MICRO_ROS_USING_GCC_10

    endchoice

    config PKG_MICRO_ROS_VER
       string
       default "humble-gcc-10"              if PKG_USING_MICRO_ROS_HUMBLE_GCC_10
       default "humble-gcc-5"               if PKG_USING_MICRO_ROS_HUMBLE_GCC_5
       default "galactic-gcc-10"            if PKG_USING_MICRO_ROS_GALACTIC_GCC_10
       default "galactic-gcc-5"             if PKG_USING_MICRO_ROS_GALACTIC_GCC_5
       default "humble-gcc-10-standalone"          if PKG_USING_MICRO_ROS_HUMBLE_GCC_10_STANDALONE
       default "galactic-gcc-10-standalone"        if PKG_USING_MICRO_ROS_GALACTIC_GCC_10_STANDALONE
       default "galactic-legacy"            if PKG_USING_MICRO_ROS_GALACTIC_LEGACY
       default "foxy-legacy"                if PKG_USING_MICRO_ROS_FOXY_LEGACY

endif
```

## peripherals/mm32/Kconfig
```kconfig
# Kconfig file for package mm32
menuconfig PKG_USING_MM32
    bool "mm32 official independent peripheral driver library for rt-thread."
    default n

if PKG_USING_MM32

    config PKG_MM32_PATH
        string
        default "/packages/peripherals/mm32"

    choice
        prompt "Version"
        help
            Select the package version

        config PKG_USING_MM32_V100
            bool "v1.0.0"

        config PKG_USING_MM32_LATEST_VERSION
            bool "latest"
    endchoice

    config PKG_MM32_VER
       string
       default "v1.0.0"    if PKG_USING_MM32_V100
       default "latest"    if PKG_USING_MM32_LATEST_VERSION

endif
```

## peripherals/mpu6xxx/Kconfig
```kconfig
# Kconfig file for package mpu6xxx
menuconfig PKG_USING_MPU6XXX
    bool "mpu6xxx: Universal 6-axis sensor driver library"
    default n

if PKG_USING_MPU6XXX

    config PKG_MPU6XXX_PATH
        string
        default "/packages/peripherals/mpu6xxx"

    config PKG_USING_MPU6XXX_SAMPLE
		bool "Enable mpu6xxx sample"
		default n

    choice
        prompt "Version"
        default PKG_USING_MPU6XXX_LATEST_VERSION
        help
            Select the package version

        config PKG_USING_MPU6XXX_V001
            bool "v0.0.1"

        config PKG_USING_MPU6XXX_LATEST_VERSION
            bool "latest"
    endchoice
          
    config PKG_MPU6XXX_VER
       string
       default "v0.0.1"    if PKG_USING_MPU6XXX_V001
       default "latest"    if PKG_USING_MPU6XXX_LATEST_VERSION

endif
```

## peripherals/multi_infrared/Kconfig
```kconfig
# Kconfig file for package infrared
menuconfig PKG_USING_MULTI_INFRARED
    bool "multi_infrared : multi_infrared is base on rt-thread pin"
    default n

if PKG_USING_MULTI_INFRARED

    config PKG_MULTI_INFRARED_PATH
        string
        default "/packages/peripherals/multi_infrared"

    menu "Select multi infrared decoder"
        config MULTI_INFRARED_NEC_DECODER
            bool "enable nec decoder"
            default n
    endmenu

config PKG_USING_DRV_MULTI_INFRARED
        bool "Use the multi infrared driver provided by the software package"
        default y
        if PKG_USING_DRV_MULTI_INFRARED
        config MULTI_INFRARED_RECEIVE
            bool "Enable multi infrared receive"
            default y
            if MULTI_INFRARED_RECEIVE
                config MULTI_INFRARED_RECEIVE_HWTIMER
                    string "multi infrared receive hwtimer dev name"
                    default "timer5"

                config MULTI_INFRARED_RECEIVE_CHANNEL_NUM
                    int "multi infrared receive channel nums"
                    default 4
            endif
        endif

    choice
        prompt "Version"
        default PKG_USING_MULTI_INFRARED_LATEST_VERSION
        help
            Select the package version

        config PKG_USING_MULTI_INFRARED_V010
            bool "v0.1.0"

        config PKG_USING_MULTI_INFRARED_LATEST_VERSION
            bool "latest"
    endchoice

    config PKG_MULTI_INFRARED_VER
       string
       default "v0.1.0"    if PKG_USING_MULTI_INFRARED_V010
       default "latest"    if PKG_USING_MULTI_INFRARED_LATEST_VERSION

endif
```

## peripherals/multi_rtimer/Kconfig
```kconfig
# Kconfig file for package multi_rtimer
menuconfig PKG_USING_MULTI_RTIMER
    bool "multi_rtimer : a real-time and low power software timer module."
    default n

if PKG_USING_MULTI_RTIMER

    config PKG_MULTI_RTIMER_PATH
        string
        default "/packages/peripherals/multi_rtimer"

    menu "Select Target MCU and Peripheral"
        config MULTI_RTIMER_USING_TRAGET_MCU_STM32_RTC
            bool"STM32 with Hardware RTC"
            select BSP_USING_ONCHIP_RTC
            default n

            if MULTI_RTIMER_USING_TRAGET_MCU_STM32_RTC
                config MULTI_RTIMER_USING_RTC_SYSTIME_SERVICE
                    bool "Enable System Time Service Based on RTC"
                    default n
                config MULTI_RTIMER_USING_RTC_TEMPERTURE_COMPENSATION
                    bool "Enable RTC Temperture Compensation"
                    default n
            endif
    endmenu

    config MULTI_RTIMER_USING_TEST_SAMPLE
        bool
        prompt "Enable multi_rtimer test sample"
        default n

    choice
        prompt "Version"
        default PKG_USING_MULTI_RTIMER_LATEST_VERSION
        help
            Select the package version

        config PKG_USING_MULTI_RTIMER_V100
            bool "v1.0.0"
        config PKG_USING_MULTI_RTIMER_V110
            bool "v1.1.0"
        config PKG_USING_MULTI_RTIMER_LATEST_VERSION
            bool "latest"
    endchoice

    config PKG_MULTI_RTIMER_VER
       string
       default "v1.0.0"    if PKG_USING_MULTI_RTIMER_V100
       default "v1.1.0"    if PKG_USING_MULTI_RTIMER_V110
       default "latest"    if PKG_USING_MULTI_RTIMER_LATEST_VERSION
endif
```

## peripherals/nes/Kconfig
```kconfig
# Kconfig file for package nes
menuconfig PKG_USING_NES
    bool "nes: nes simulator c Library."
    default n

if PKG_USING_NES

    config PKG_NES_PATH
        string
        default "/packages/peripherals/nes"

    config PKG_NES_DFS
        bool "enable nes file system"
        default false

    config PKG_NES_FRAME_SKIP
        int "config frame skip"
        default 2

    config PKG_NES_DOUBLE_FRAMEBUFFER
        bool "enable double frame buffer"
        default true

    choice
        prompt "Version"
        default PKG_USING_NES_LATEST_VERSION
        help
            Select the package version

        config PKG_USING_NES_V100
            bool "v1.0.0"

        config PKG_USING_NES_LATEST_VERSION
            bool "latest"
    endchoice

    config PKG_NES_VER
       string
       default "v1.0.0"    if PKG_USING_NES_V100
       default "latest"    if PKG_USING_NES_LATEST_VERSION

endif
```
