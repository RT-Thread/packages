## tools/kdb/Kconfig
```kconfig
# Kconfig file for package kdb
menuconfig PKG_USING_KDB
    bool "kdb : Kernel debug tools."
    default n

if PKG_USING_KDB

    config PKG_KDB_PATH
        string
        default "/packages/tools/kdb"

    config KDB_MAX_DATA_LEN
        int "the maximum of data package length"
        default 64

    config KDB_TYPE_NUM
        int "the maximun number of types in KDB"
        default 32

    config KDB_SYS_AUTO_INIT
        bool "Enable KDB system automatic initialization"
        default n

    config KDB_SYS_BUFF_SIZE
        int "the maximun system buffer size"
        default 4096

    config KDB_SYS_NAME_LEN
        int "the maximun system name length"
        default 8

    config KDB_SYS_MEM_CUSTOM
        bool "Enable KDB system memory custom"
        default n

    config KDB_SCHEDULER_DUMP
        bool "Enable KDB scheduler dump"
        default y

    config KDB_THREAD_DUMP
        bool "Enable KDB thread dump"
        default n

    if KDB_THREAD_DUMP
        config KDB_THREAD_SUSPEND_DUMP
            bool "Enable KDB thread suspend dump"
            default n

        config KDB_THREAD_RESUME_DUMP
            bool "Enable KDB thread resume dump"
            default n

        config KDB_THREAD_INITED_DUMP
            bool "Enable KDB thread inited dump"
            default n
    endif

    config KDB_HEAP_DUMP
        bool "Enable KDB heap dump"
        default n

    if KDB_HEAP_DUMP
        config KDB_HEAP_MALLOC_DUMP
            bool "Enable KDB heap malloc dump"
            default n

        config KDB_HEAP_FREE_DUMP
            bool "Enable KDB heap free dump"
            default n
    endif

    config KDB_MP_DUMP
        bool "Enable KDB memory pool dump"
        default n

    if KDB_MP_DUMP
        config KDB_MP_ALLOC_DUMP
            bool "Enable KDB memory pool alloc dump"
            default n

        config KDB_MP_FREE_DUMP
            bool "Enable KDB memory pool free dump"
            default n
    endif

    config KDB_OBJECT_DUMP
        bool "Enable KDB object dump"
        default n

    if KDB_OBJECT_DUMP
        config KDB_THREAD_OBJECT_DUMP
            bool "Enable KDB thread object dump"
            default n

        config KDB_SEMAPHORE_OBJECT_DUMP
            bool "Enable KDB semaphore object dump"
            default n

        config KDB_MUTEX_OBJECT_DUMP
            bool "Enable KDB mutext object dump"
            default n

        config KDB_EVENT_OBJECT_DUMP
            bool "Enable KDB event object dump"
            default n

        config KDB_MAILBOX_OBJECT_DUMP
            bool "Enable KDB mailbox object dump"
            default n

        config KDB_MESSAGEQUEUE_OBJECT_DUMP
            bool "Enable KDB message queue object dump"
            default n

        config KDB_MEMHEAP_OBJECT_DUMP
            bool "Enable KDB memheap object dump"
            default n

        config KDB_MEMPOOL_OBJECT_DUMP
            bool "Enable KDB mempool object dump"
            default n

        config KDB_DEVICE_OBJECT_DUMP
            bool "Enable KDB device object dump"
            default n

        config KDB_TIMER_OBJECT_DUMP
            bool "Enable KDB timer object dump"
            default n

        config KDB_MODULE_OBJECT_DUMP
            bool "Enable KDB module object dump"
            default n

        config KDB_UNKNOWN_OBJECT_DUMP
            bool "Enable KDB unknown object dump"
            default n

        config KDB_STATIC_OBJECT_DUMP
            bool "Enable KDB static object dump"
            default n

        config KDB_DEFAULT_OBJECT_DUMP
            bool "Enable KDB default object dump"
            default n
    endif

    config KDB_TIMER_DUMP
        bool "Enable KDB timer dump"
        default n

    if KDB_TIMER_DUMP
        config KDB_TIMER_ENTER_DUMP
            bool "Enable KDB timer enter dump"
            default n

        config KDB_TIMER_EXIT_DUMP
            bool "Enable KDB timer exit dump"
            default n
    endif

    config KDB_INTERRUPT_DUMP
        bool "Enable KDB interrupt dump"
        default n

    if KDB_INTERRUPT_DUMP
        config KDB_INTERRUPT_ENTER_DUMP
            bool "Enable KDB interrupt enter dump"
            default n

        config KDB_INTERRUPT_LEAVE_DUMP
            bool "Enable KDB interrupt leave dump"
            default n
    endif

    config KDB_ENABLE_CUSTOMIZE_OUTPUT
        bool "Enable KDB customize output"
        default n

    config KDB_TEST_ENABLE
        bool "Enable KDB test"
        default n

    choice
        prompt "Version"
        default PKG_USING_KDB_LATEST_VERSION
        help
            Select the package version

        config PKG_USING_KDB_V100
            bool "v1.0.0"

        config PKG_USING_KDB_LATEST_VERSION
            bool "latest"
    endchoice

    config PKG_KDB_VER
       string
       default "v1.0.0"    if PKG_USING_KDB_V100
       default "latest"    if PKG_USING_KDB_LATEST_VERSION

endif
```

## tools/logmgr/Kconfig
```kconfig
# Kconfig file for package logmgr
menuconfig PKG_USING_LOGMGR
    bool "logmgr: A log management system for rt-thread."
    select RT_USING_ULOG
    default n

if PKG_USING_LOGMGR

    config PKG_LOGMGR_PATH
        string
        default "/packages/tools/logmgr"

    config LOGMGR_AUTO_INIT
        bool "Enable automatic initialization"
        default n

    config LOGMGR_USING_ULOG_FILE
        bool "Enable log file backend feature"
        default n
        select PKG_USING_ULOG_FILE

    config LOGMGR_USING_ABORT
        bool "Enable log abort feature"
        default n

    if LOGMGR_USING_ABORT

        config LOGMGR_ABORT_STORG
            bool "Enable abort log storg feature"
            default n
            select RT_UGING_DFS
            select PKG_USING_FLASHDB
            select FDB_USING_TSDB
            select FDB_USING_FAL_MODE

        if LOGMGR_ABORT_STORG

            config LOGMGR_ABORT_FILE_PATH
                string "abort file path"
                default "/abort.log"

            config LOGMGR_FLASHDB_PART_NAME
                string "flashdb fal part name"
                default "logmgr"

            config LOGMGR_FLASHDB_MAX_SIZE
                int "falshdb data max size"
                default 65536
                range 16384 131072

        endif

        config LOGMGR_USING_CMBACKTRACE
            bool "cmbacktrace log support"
            default y
            select PKG_USING_CMBACKTRACE

         config LOGMGR_USING_IPC_LOG
            bool "system ipc log support"
            default y

        config LOGMGR_USING_KDB
            bool "kernel running log support"
            default y
            select PKG_USING_KDB
            select KDB_ENABLE_PORT

        config LOGMGR_USING_SYS_LOAD_MONITOR
            bool "system load monitor log support"
            default y
            select PKG_USING_SYS_LOAD_MONITOR

        config LOGMGR_USING_MEMORY_LOG
            bool "system memory log support"
            default y
    endif

    config LOGMGR_USING_SAMPLES
        bool "Enable samples"
        default n

    choice
        prompt "Version"
        default PKG_USING_LOGMGR_V100
        help
            Select the package version

        config PKG_USING_LOGMGR_V100
            bool "v1.0.0"

        config PKG_USING_LOGMGR_LATEST_VERSION
            bool "latest"
    endchoice

    config PKG_LOGMGR_VER
       string
       default "v1.0.0"    if PKG_USING_LOGMGR_V100
       default "latest"    if PKG_USING_LOGMGR_LATEST_VERSION

endif
```

## tools/lunar_calendar/Kconfig
```kconfig
# Kconfig file for package lunar_calendar
menuconfig PKG_USING_LUNAR_CALENDAR
    bool "lunar_calendar: A tool to convert a Gregorian calendar date into a lunar calendar."
    default n

if PKG_USING_LUNAR_CALENDAR

    config PKG_LUNAR_CALENDAR_PATH
        string
        default "/packages/tools/lunar_calendar"

    choice
        prompt "Version"
        default PKG_USING_LUNAR_CALENDAR_LATEST_VERSION
        help
            Select the package version

        config PKG_USING_LUNAR_CALENDAR_V010
            bool "v0.1.0"

        config PKG_USING_LUNAR_CALENDAR_LATEST_VERSION
            bool "latest"
    endchoice
          
    config PKG_LUNAR_CALENDAR_VER
       string
       default "v0.1.0"    if PKG_USING_LUNAR_CALENDAR_V010
       default "latest"    if PKG_USING_LUNAR_CALENDAR_LATEST_VERSION

endif
```

## tools/lwlog/Kconfig
```kconfig
# Kconfig file for package lwlog
menuconfig PKG_USING_LWLOG
    bool "lwlog: single header logging library."
    default n

if PKG_USING_LWLOG

    config PKG_LWLOG_PATH
        string
        default "/packages/tools/lwlog"

    config LWLOG_USE_USAGE_DEMO
        bool "lwlog: usage demo"
        help
            lwlog: usage demo
        default n
    choice
        prompt "Version"
        default PKG_USING_LWLOG_LATEST_VERSION
        help
            Select the package version

        config PKG_USING_LWLOG_LATEST_VERSION
            bool "latest"
    endchoice

    config PKG_LWLOG_VER
       string
       default "latest"    if PKG_USING_LWLOG_LATEST_VERSION

endif
```

## tools/lwrb2rtt/Kconfig
```kconfig
# Kconfig file for package lwrb2rtt
menuconfig PKG_USING_LWRB2RTT
    bool "lwrb2rtt: Lightweight ring buffer manager."
    default n

if PKG_USING_LWRB2RTT

    config LWRB2RTT_USING_SAMPLES
        bool "Enable lwrb2rtt samples"
        default n

    config PKG_LWRB2RTT_PATH
        string
        default "/packages/tools/lwrb2rtt"

    choice
        prompt "Version"
        default PKG_USING_LWRB2RTT_LATEST_VERSION
        help
            Select the package version

        config PKG_USING_LWRB2RTT_V100
            bool "v1.0.0"

        config PKG_USING_LWRB2RTT_LATEST_VERSION
            bool "latest"
    endchoice

    config PKG_LWRB2RTT_VER
       string
       default "v1.0.0"    if PKG_USING_LWRB2RTT_V100
       default "latest"    if PKG_USING_LWRB2RTT_LATEST_VERSION

endif
```

## tools/mbedtls_bench/Kconfig
```kconfig
menuconfig PKG_USING_MBEDTLS_BENCH
    depends on FINSH_USING_MSH
    depends on PKG_USING_MBEDTLS
    bool "mbedtls_bench: Enable Performance Testing for mbedtls."
    default n

if PKG_USING_MBEDTLS_BENCH
    config PKG_MBEDTLS_BENCH_PATH
        string
        default "/packages/tools/mbedtls_bench"

    choice
        prompt "Version"
        default PKG_USING_MBEDTLS_BENCH_LATEST_VERSION
        help
            Select the package version

        config PKG_USING_MBEDTLS_BENCH_V100
            bool "v1.0.0"

        config PKG_USING_MBEDTLS_BENCH_LATEST_VERSION
            bool "latest"

    endchoice

    config PKG_MBEDTLS_BENCH_VER
       string
       default "v1.0.0"     if PKG_USING_MBEDTLS_BENCH_V100
       default "latest"     if PKG_USING_MBEDTLS_BENCH_LATEST_VERSION

    config MBEDTLS_BENCH_CHECK_SHELL_STACK
        bool "check shell stack size at build time"
        default y

    config MBEDTLS_BENCH_TEST_8K
        bool "test 8K block (using more memory)"
        default y

    config MBEDTLS_BENCH_SIMPLE
        bool "enable test simple algorithm"
        default n

    config MBEDTLS_BENCH_CIPHER
        bool "enable test cipher algorithm"
        default y

    config MBEDTLS_BENCH_TEST_SECOND
        int "single test duration (in second)"
        range 1 100
        default 1

endif
```

## tools/mem_sandbox/Kconfig
```kconfig
# Kconfig file for package mem_sandbox
menuconfig PKG_USING_MEM_SANDBOX
    bool "mem_sandbox: memory sandbox for RT-Thread"
    default n

if PKG_USING_MEM_SANDBOX

    config PKG_MEM_SANDBOX_PATH
        string
        default "/packages/tools/mem_sandbox"

    choice
        prompt "Version"
        default PKG_USING_MEM_SANDBOX_LATEST_VERSION
        help
            Select the package version

        config PKG_USING_MEM_SANDBOX_LATEST_VERSION
            bool "latest"
    endchoice

    config PKG_MEM_SANDBOX_VER
       string
       default "latest"    if PKG_USING_MEM_SANDBOX_LATEST_VERSION

endif
```

## tools/nr_micro_shell/Kconfig
```kconfig
# Kconfig file for package nr_micro_shell
menuconfig PKG_USING_NR_MICRO_SHELL
    bool "nr_micro_shell:Lightweight command line interaction tool."
    default n

if PKG_USING_NR_MICRO_SHELL
    config PKG_NR_MICRO_SHELL_PATH
        string
        default "/packages/tools/nr_micro_shell"
    
    config RT_NR_SHELL_LINE_SIZE
        int "The command line size."
        default 100
    
    config RT_NR_SHELL_USER_NAME
        string "The user name."
        default "root@nr_shell:"
    
    config RT_NR_SHELL_USER_NAME_MAX_LENGTH
        int "The maxial size of user name."
        default 15
    
    config RT_NR_SHELL_CMD_NAME_MAX_LENGTH
        int "The maxial size of command name."
        default 10
    
    config RT_NR_SHELL_CMD_PARAS_MAX_NUM
        int "The max command arg number."
        default 10

    config RT_NR_SHELL_CMD_HISTORY_BUF_LENGTH
        int "The command history buffer size."
        default 253
    
    config RT_NR_SHELL_MAX_CMD_HISTORY_NUM
        int "The max command history line number."
        default 3
    
    config RT_NR_SHELL_STACKSIZE
        int "The stacksize of nr_micro_shell thread."
        default 512

    config RT_NR_SHELL_THREAD_PRIORITY
        int "The priopity of nr_micro_shell thread."
        default 10

    choice
        prompt "End of line"
        default NR_SHELL_END_CR
        help
            Select the end of line

        config NR_SHELL_END_LF
            bool "LF \\n"

        config NR_SHELL_END_CR
            bool "CR \\r"

        config NR_SHELL_END_CRLF
            bool "CRLF \\r\\n"
    endchoice

    config RT_NR_SHELL_END_OF_LINE
        int
        default 0    if NR_SHELL_END_LF
        default 1    if NR_SHELL_END_CR
        default 2    if NR_SHELL_END_CRLF

    config RT_NR_SHELL_SHOW_LOG
        bool "Show logo or not."
        default y

    choice
        prompt "Version"
        default PKG_USING_NR_MICRO_SHELL_LATEST_VERSION
        help
            Select the package version

        config PKG_USING_NR_MICRO_SHELL_V100
            bool "v1.0.0"

        config PKG_USING_NR_MICRO_SHELL_LATEST_VERSION
            bool "latest"
    endchoice
          
    config PKG_NR_MICRO_SHELL_VER
        string
        default "v1.0.0"    if PKG_USING_NR_MICRO_SHELL_V100
        default "latest"    if PKG_USING_NR_MICRO_SHELL_LATEST_VERSION

endif
```

## tools/qrcode/Kconfig
```kconfig
# Kconfig file for package qrcode
menuconfig PKG_USING_QRCODE
    bool "qrcode: A simple library for generating QR codes in C"
    default n

if PKG_USING_QRCODE

    config PKG_QRCODE_PATH
        string
        default "/packages/tools/qrcode"

    config PKG_QRCODE_SAMPLE
        bool "Enable qrcode sample"
        default n
        
    choice
        prompt "Version"
        default PKG_USING_QRCODE_LATEST_VERSION
        help
            Select the package version

        config PKG_USING_QRCODE_V010
            bool "v0.1.0"

        config PKG_USING_QRCODE_LATEST_VERSION
            bool "latest"
    endchoice
          
    config PKG_QRCODE_VER
       string
       default "v0.1.0"    if PKG_USING_QRCODE_V010
       default "latest"    if PKG_USING_QRCODE_LATEST_VERSION

endif
```
