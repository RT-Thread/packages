## system/rmp/Kconfig
```kconfig
# Kconfig file for package rmp
menuconfig PKG_USING_RMP
    bool "rmp: Efficient and secure memory pool"
    default n

if PKG_USING_RMP

    config PKG_RMP_PATH
        string
        default "/packages/system/rmp"

    config RMP_USING_DYNAMIC
        bool "rmp using dynamic interface"
        default n

    config RMP_USING_RTOS
        bool "rmp enable rtos"
        default y

    choice
        prompt "Version"
        default PKG_USING_RMP_LATEST_VERSION
        help
            Select the package version

        config PKG_USING_RMP_LATEST_VERSION
            bool "latest"
    endchoice

    config PKG_RMP_VER
       string
       default "latest"    if PKG_USING_RMP_LATEST_VERSION

endif
```

## system/rpmsg-lite/Kconfig
```kconfig
# Kconfig file for package rpmsg-lite
menuconfig PKG_USING_RPMSG_LITE
    bool "rpmsg-lite: rpmsg-lite for RT-Thread"
    default n

if PKG_USING_RPMSG_LITE
    config PKG_RPMSG_LITE_PATH
        string
        default "/packages/system/rpmsg-lite"

    config PKG_RPMSG_LITE_CUSTOM_CONFIG
        bool "rpmsg-lite use custom config"
        default n

    choice
        prompt "Version"
        default PKG_USING_RPMSG_LITE_LATEST_VERSION
        help
            Select this package version

        config PKG_USING_RPMSG_LITE_V510
            bool "v5.1.0"

        config PKG_USING_RPMSG_LITE_LATEST_VERSION
            bool "latest"
    endchoice

    config PKG_RPMSG_LITE_VER
        string
        default "v5.1.0" if PKG_USING_RPMSG_LITE_V510
        default "latest" if PKG_USING_RPMSG_LITE_LATEST_VERSION

endif
```

## system/rt_kprintf/Kconfig
```kconfig
menu "rt_kprintf: enhanced rt_kprintf packages"

source "$PKGS_DIR/packages/system/rt_kprintf/rt_kprintf_threadsafe/Kconfig"
source "$PKGS_DIR/packages/system/rt_kprintf/rt_vsnprintf_full/Kconfig"

endmenu
```

## system/rt_kprintf/rt_vsnprintf_full/Kconfig
```kconfig
# Kconfig file for package rt_vsnprintf_full
menuconfig PKG_USING_RT_VSNPRINTF_FULL
    bool "rt_vsnprintf_full: fully functional version of rt_vsnprintf"
    default n

if PKG_USING_RT_VSNPRINTF_FULL

    config PKG_RT_VSNPRINTF_FULL_PATH
        string
        default "/packages/system/rt_kprintf/rt_vsnprintf_full"

    if RT_VER_NUM >= 0x40100
        config RT_VSNPRINTF_FULL_REPLACING_SPRINTF
            bool "Enable to take over 'sprintf'"
            default n

        config RT_VSNPRINTF_FULL_REPLACING_SNPRINTF
            bool "Enable to take over 'snprintf'"
            default n

        config RT_VSNPRINTF_FULL_REPLACING_PRINTF
            bool "Enable to take over 'printf'"
            default n

        config RT_VSNPRINTF_FULL_REPLACING_VSPRINTF
            bool "Enable to take over 'vsprintf'"
            default n

        config RT_VSNPRINTF_FULL_REPLACING_VSNPRINTF
            bool "Enable to take over 'vsnprintf'"
            default n
    endif

    choice
        prompt "Version"
        default PKG_USING_RT_VSNPRINTF_FULL_LATEST_VERSION
        help
            Select the package version

        config PKG_USING_RT_VSNPRINTF_FULL_LATEST_VERSION
            bool "latest"
    endchoice
          
    config PKG_RT_VSNPRINTF_FULL_VER
       string
       default "latest"    if PKG_USING_RT_VSNPRINTF_FULL_LATEST_VERSION

endif
```

## system/rt_kprintf_threadsafe/Kconfig
```kconfig
# Kconfig file for package rt_printf
menuconfig PKG_USING_RT_KPRINTF_THREADSAFE
    bool "rt_kprintf_threadsafe: thread-safe version of rt_kprintf"
    default n

if PKG_USING_RT_KPRINTF_THREADSAFE

    config PKG_USING_RT_KPRINTF_THREADSAFEF_PATH
        string
        default "/packages/system/rt_kprintf_threadsafe"

    choice
        prompt "Version"
        default PKG_USING_RT_KPRINTF_THREADSAFE_LATEST_VERSION
        help
            Select the package version

        config PKG_USING_RT_KPRINTF_THREADSAFE_LATEST_VERSION
            bool "latest"
    endchoice
          
    config PKG_USING_RT_KPRINTF_THREADSAFE_VER
       string
       default "latest"    if PKG_USING_RT_KPRINTF_THREADSAFE_LATEST_VERSION

endif
```

## system/rt_openamp/Kconfig
```kconfig
# Kconfig file for package rt_openamp
menuconfig PKG_USING_RT_OPENAMP
    bool "RT-OpenAMP"
    default n

if PKG_USING_RT_OPENAMP

    config AMP_MASTRT_CPU_NO
        int "AMP master role cpu no"
        default 0

    config AMP_SLAVE_CPU_NO
        int "AMP slave role cpu no"
        default 1

    config AMP_SHARE_MEMORY_ADDRESS
        hex "AMP share memory address"
        default 0x70000000

    config AMP_VDEV_STATUS_ADDRESS
        hex "AMP vdev status address"
        default 0x70000000

    config AMP_SHARE_MEMORY_SIZE
        hex "AMP share memory size"
        default 0x40000

    config AMP_CPU_SGI_INTERRUPT_NO
        int "amp cpu sgi intterrupt no(0 - 15)"
        range 0 15
        default 7

    config AMP_DEMO_ENABLE
        bool "AMP demo enable"
        default y

        if AMP_DEMO_ENABLE
            config AMP_DEMO_ECHO
                bool "amp echo demo"
                default y

            config AMP_DEMO_MATRIX
                bool "amp matrix demo"
                default y

            config AMP_DEMO_PTY
                select PKG_USING_VCONSOLE
                bool "amp pty demo"
                default y

            config AMP_DEMO_VRING_TX_ADDR
                hex "amp vring tx addr"
                default 0x7002C000

            config AMP_DEMO_VRING_TX_DES_NUM
                int "amp vring tx descriptor num"
                default 16

            config AMP_DEMO_VRING_RX_ADDR
                hex "amp vring rx addr"
                default 0x70028000

            config AMP_DEMO_VRING_RX_DES_NUM
                int "amp vring rx descriptor num"
                default 16

            config AMP_DEMO_VRING_BUF_ADDR
                hex "amp vring buf addr"
                default 0x70004000

            config AMP_DEMO_VRING_SIZE
                hex "amp vring size"
                default 0x8000
        endif

    config PKG_RT_OPENAMP_PATH
        string
        default "/packages/system/rt_openamp"

    choice
        prompt "Version"
        default PKG_USING_RT_OPENAMP_LATEST_VERSION
        help
            Select the package version

        config PKG_USING_RT_OPENAMP_V100
            bool "v1.0.0"

        config PKG_USING_RT_OPENAMP_LATEST_VERSION
            bool "latest"
    endchoice

    config PKG_RT_OPENAMP_VER
       string
       default "v1.0.0"    if PKG_USING_RT_OPENAMP_V100
       default "latest"    if PKG_USING_RT_OPENAMP_LATEST_VERSION

endif
```

## system/rt_printf/Kconfig
```kconfig
# Kconfig file for package rt_printf
menuconfig PKG_USING_RT_PRINTF
    bool "rt_printf: thread-safe version of rt_kprintf"
    default n

if PKG_USING_RT_PRINTF

    config PKG_RT_PRINTF_PATH
        string
        default "/packages/system/rt_printf"

    choice
        prompt "Version"
        default PKG_USING_RT_PRINTF_LATEST_VERSION
        help
            Select the package version

        config PKG_USING_RT_PRINTF_LATEST_VERSION
            bool "latest"
    endchoice
          
    config PKG_RT_PRINTF_VER
       string
       default "latest"    if PKG_USING_RT_PRINTF_LATEST_VERSION

endif
```

## system/rt_robot/Kconfig
```kconfig
# Kconfig file for package rt-robot

menuconfig PKG_USING_ROBOTS
    bool "RT-Robot: RT-Thread robots development platform"
    default n

if PKG_USING_ROBOTS

    config PKG_ROBOTS_PATH
        string
        default "/packages/system/rt_robot"

    choice
        prompt "Version"
        default PKG_USING_ROBOTS_LATEST_VERSION
        help
            Select the package version

        config PKG_USING_ROBOTS_LATEST_VERSION
            bool "latest"
    endchoice

    config PKG_ROBOTS_VER
       string
       default "latest"    if PKG_USING_ROBOTS_LATEST_VERSION

    config PKG_ROBOT_VER_NUM
        hex
        default 0x99999 if PKG_USING_ROBOTS_LATEST_VERSION

endif
```

## system/rt_vsnprintf_full/Kconfig
```kconfig
# Kconfig file for package rt_vsnprintf_full
menuconfig PKG_USING_RT_VSNPRINTF_FULL
    bool "rt_vsnprintf full functional version"
    default n

if PKG_USING_RT_VSNPRINTF_FULL

    config PKG_RT_VSNPRINTF_FULL_PATH
        string
        default "/packages/system/rt_vsnprintf_full"

    choice
        prompt "Version"
        default PKG_USING_RT_VSNPRINTF_FULL_LATEST_VERSION
        help
            Select the package version

        config PKG_USING_RT_VSNPRINTF_FULL_LATEST_VERSION
            bool "latest"
    endchoice
          
    config PKG_RT_VSNPRINTF_FULL_VER
       string
       default "latest"    if PKG_USING_RT_VSNPRINTF_FULL_LATEST_VERSION

endif
```

## system/rti/Kconfig
```kconfig
menuconfig PKG_USING_RTI
    bool "RT-Thread Insight: probe tool for RT-Thread"
    select RT_USING_HOOK
    select RT_USING_CPUTIME
    default n

if PKG_USING_RTI

    config PKG_RTI_PATH
        string
        default "/packages/system/rti"

    # 版本选择
    choice
        prompt "Version"
        help
            Select the rti version

        config PKG_USING_RTI_V100
            bool "v1.0.0"

        config PKG_USING_RTI_V200
            bool "v2.0.0"

        config PKG_USING_RTI_LATEST_VERSION
            bool "latest"
    endchoice

    config PKG_RTI_VER
       string
       default "v1.0.0"    if PKG_USING_RTI_V100
       default "v2.0.0"    if PKG_USING_RTI_V200
       default "latest"    if PKG_USING_RTI_LATEST_VERSION

    # ----------------------------
    # v2版本仅显示CPU频率配置
    # ----------------------------
    config BOARD_SYSTICK_FREQ_IN_HZ
        int "CPU frequency (Hz)"
        default 168000000
        depends on PKG_USING_RTI_V200 || PKG_USING_RTI_LATEST_VERSION  # 仅v2和latest版本可见
        help
            Required for v2.0.0+ version: CPU clock frequency, used for timestamp calculation.

    # ----------------------------
    # v1版本显示原有其他配置
    # ----------------------------
    if PKG_USING_RTI_V100  # 仅v1.0.0版本可见

        config PKG_RTI_APP_NAME
            string "App name"
            default "RT-Thread RTI"

        config PKG_RTI_BUFFER_SIZE
            int "RTI buffer size"
            default 4096

        config PKG_RTI_RAM_BASE
            hex "RAM base"
            default 0x20000000
            ---help---
                The lowest RAM address used for IDs (pointers)

        config PKG_RTI_ID_SHIFT
            int "Event ID offset"
            default 2

        config PKG_RTI_SYS_DESC0
            string "System description 0"
            default "I#15=systick"
            ---help---
                format is "I#%num%=%name%, ..." number is IRQ number, name is IRQ name

        config PKG_RTI_SYS_DESC1
            string "System description 1"
            default ""
            ---help---
                format is "I#%num%=%name%, ..." number is IRQ number, name is IRQ name

        config PKG_USING_RTI_UART_SAMPLE
            bool "Using UART Sample"
            default n
            ---help---
                Use serial port to transmit data to SystemView.

    endif

endif
```

## system/rtp/Kconfig
```kconfig
# Kconfig file for package rtp
menuconfig PKG_USING_RTP
    bool "rtp: Cross platform thread pool."
    default n

if PKG_USING_RTP

    config PKG_RTP_PATH
        string
        default "/packages/system/rtp"

    choice
        prompt "Version"
        default PKG_USING_RTP_LATEST_VERSION
        help
            Select the package version

        config PKG_USING_RTP_LATEST_VERSION
            bool "latest"
    endchoice

    config PKG_RTP_VER
       string
       default "latest"    if PKG_USING_RTP_LATEST_VERSION

endif
```

## system/sfdb/Kconfig
```kconfig
# Kconfig file for package SFDB
menuconfig PKG_USING_SFDB
    bool "SFDB: Simple file database"
    default n

if PKG_USING_SFDB

    config PKG_SFDB_PATH
        string
        default "/packages/system/sfdb"

    choice
        prompt "Version"
        default PKG_USING_SFDB_V002
        help
            Select the package version

        config PKG_USING_SFDB_V002
            bool "v0.0.2"

        config PKG_USING_SFDB_LATEST_VERSION
            bool "latest"
    endchoice

    config SFDB_USING_EXAMPLE
        bool "Use sfdb example"
        default n

    config PKG_SFDB_VER
       string
       default "v0.0.2"    if PKG_USING_SFDB_V002
       default "latest"    if PKG_USING_SFDB_LATEST_VERSION

endif
```

## system/sqlite/Kconfig
```kconfig
menuconfig PKG_USING_SQLITE
    bool "SQLite: a self-contained, high-reliability, embedded, full-featured, public-domain, SQL database engine."
    default n
    select RT_USING_DFS      if RT_VER_NUM < 0x40100
    select RT_USING_POSIX_FS if RT_VER_NUM >= 0x40100

if PKG_USING_SQLITE

    config PKG_SQLITE_PATH
        string
        default "/packages/system/sqlite"

    config PKG_SQLITE_VER
        string
        default "v3.19.3"

    config PKG_SQLITE_SQL_MAX_LEN
        int "SQL statements max length"
        default 1024

    config PKG_SQLITE_DB_NAME_MAX_LEN
        int "Database filename(fullpath) length"
        range 8 256
        default 64

    config PKG_SQLITE_DAO_EXAMPLE
        bool "Enable example"
            default y

    choice
        prompt "version"
        help
            Select the Sqlite version

        config PKG_USING_SQLITE_V3193
            bool "v3.19.3"
    endchoice

endif
```

## system/sys_load_monitor/Kconfig
```kconfig
# Kconfig file for package sys_load_monitor
menuconfig PKG_USING_SYS_LOAD_MONITOR
    bool "sys_load_monitor: system load monitor"
    default n

if PKG_USING_SYS_LOAD_MONITOR

    config SYS_LOAD_MONITOR_FREQ
        int "monitor frequency (Hz)"
        default 1

    config SYS_LOAD_MONITOR_TIME
        int "monitor recording time (seconds)"
        default 20

    config SYS_LOAD_MONITOR_MAX_THREAD
        int "monitor recording threads number"
        default 5

    config SYS_LOAD_MONITOR_USING_TEST
        bool "Enable system load test"
        default y

    config PKG_SYS_LOAD_MONITOR_PATH
        string
        default "/packages/system/sys_load_monitor"

    choice
        prompt "Version"
        default PKG_USING_SYS_LOAD_MONITOR_V100
        help
            Select the package version

        config PKG_USING_SYS_LOAD_MONITOR_V100
            bool "v1.0.0"

        config PKG_USING_SYS_LOAD_MONITOR_LATEST_VERSION
            bool "latest"
    endchoice
          
    config PKG_SYS_LOAD_MONITOR_VER
       string
       default "v1.0.0"    if PKG_USING_SYS_LOAD_MONITOR_V100
       default "latest"    if PKG_USING_SYS_LOAD_MONITOR_LATEST_VERSION

endif
```
