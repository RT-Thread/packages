## arduino/Kconfig
```kconfig
menu "Arduino libraries"

source "$PKGS_DIR/packages/arduino/RTduino/Kconfig"
source "$PKGS_DIR/packages/arduino/projects/Kconfig"
source "$PKGS_DIR/packages/arduino/sensors/Kconfig"
source "$PKGS_DIR/packages/arduino/display/Kconfig"
source "$PKGS_DIR/packages/arduino/timing/Kconfig"
source "$PKGS_DIR/packages/arduino/dataprocessing/Kconfig"
source "$PKGS_DIR/packages/arduino/datastorage/Kconfig"
source "$PKGS_DIR/packages/arduino/communication/Kconfig"
source "$PKGS_DIR/packages/arduino/devicecontrol/Kconfig"
source "$PKGS_DIR/packages/arduino/other/Kconfig"
source "$PKGS_DIR/packages/arduino/signalio/Kconfig"
source "$PKGS_DIR/packages/arduino/uncategorized/Kconfig"

endmenu
```

## arduino/RTduino/Kconfig
```kconfig
# Kconfig file for package RTduino
menuconfig PKG_USING_RTDUINO
    bool "RTduino: Arduino Ecological Compatibility Layer"
    select RT_USING_CPLUSPLUS
    select RT_USING_TIMER_SOFT
    default n

if PKG_USING_RTDUINO

    config PKG_RTDUINO_PATH
        string
        default "/packages/arduino/RTduino"

    config RTDUINO_NO_SETUP_LOOP
        bool "Don't use setup-loop structure"
        default n

    if !RTDUINO_NO_SETUP_LOOP
        config RTDUINO_THREAD_SIZE
            int "Arduino thread's size"
            default 2048

        config RTDUINO_THREAD_PRIO
            int "Arduino thread's priority"
            default 30
    endif

    config RTDUINO_TINY_MODE
        bool "Enable tiny mode"
        select RTDUINO_NO_SETUP_LOOP
        default n

    config RTDUINO_SUPPORT_HIGH_PRECISION_MICROS
        bool "micros() function with high precision"
        depends on ARCH_ARM_CORTEX_M
        select PKG_USING_PERF_COUNTER if ARCH_ARM_CORTEX_M
        default y

    config RTDUINO_USING_WIRE
        bool "Enable wire library <Wire.h>"
        select RT_USING_I2C
        default n

    config RTDUINO_DEFAULT_IIC_BUS_NAME
        string "RTduino default IIC bus device name"
        depends on RTDUINO_TINY_MODE && RTDUINO_USING_WIRE
        default "i2c1"

    config RTDUINO_WIRE_BUFFER_LENGTH
        int "Wire buffer"
        depends on RTDUINO_USING_WIRE
        default 32
        range 0 512

    config RTDUINO_USING_SPI
        bool "Enable SPI library <SPI.h>"
        select RT_USING_SPI
        default n

    config RTDUINO_DEFAULT_SPI_BUS_NAME
        string "RTduino default SPI bus device name"
        depends on RTDUINO_TINY_MODE && RTDUINO_USING_SPI
        default "spi1"

    config RTDUINO_USING_SERVO
        bool "Enable servo library <Servo.h>"
        default n
        depends on !RTDUINO_TINY_MODE

    config RTDUINO_USING_USBSERIAL
        bool "Enable USB Serial"
        select PKG_USING_TINYUSB
        select PKG_TINYUSB_DEVICE_ENABLE
        select PKG_TINYUSB_DEVICE_CDC
        default n

    config RTDUINO_USING_SHELL_CMD
        bool "Enable shell commands"
        default n

    if RTDUINO_USING_SHELL_CMD
        config RTDUINO_CMD_USING_SERIAL
            bool "Enable Serial commands"
            default n

        config RTDUINO_CMD_SERIAL_USING_FOCUSON
            bool "Enable Serial focus on mode"
            depends on RTDUINO_CMD_USING_SERIAL
            default n
    endif

    config RTDUINO_USING_UTEST
        bool "Enable RTduino test cases"
        select RT_USING_UTEST
        default n

    config RTDUINO_UTEST_USING_HIL
        bool "Enable RTduino hardware in loop test cases"
        depends on RTDUINO_USING_UTEST
        default n

    choice
        prompt "Version"
        default PKG_USING_RTDUINO_LATEST_VERSION
        help
            Select the package version

        config PKG_USING_RTDUINO_LATEST_VERSION
            bool "latest"
    endchoice

    config PKG_RTDUINO_VER
       string
       default "latest"    if PKG_USING_RTDUINO_LATEST_VERSION

endif
```

## arduino/communication/Adafruit-PN532/Kconfig
```kconfig
# Kconfig file for package Adafruit-PN532
menuconfig PKG_USING_ARDUINO_ADAFRUIT_PN532
    bool "Adafruit PN532: NFC/RFID driver"
    select PKG_USING_RTDUINO
    select RTDUINO_USING_WIRE
    select RTDUINO_USING_SPI
    select PKG_USING_ARDUINO_ADAFRUIT_BUSIO
    default n

if PKG_USING_ARDUINO_ADAFRUIT_PN532

    config PKG_ARDUINO_ADAFRUIT_PN532_PATH
        string
        default "/packages/arduino/communication/Adafruit-PN532"

    choice
        prompt "Version"
        default PKG_USING_ARDUINO_ADAFRUIT_PN532_LATEST_VERSION
        help
            Select the package version

        config PKG_USING_ARDUINO_ADAFRUIT_PN532_LATEST_VERSION
            bool "latest"
    endchoice

    config PKG_ARDUINO_ADAFRUIT_PN532_VER
       string
       default "latest"    if PKG_USING_ARDUINO_ADAFRUIT_PN532_LATEST_VERSION

endif
```

## arduino/communication/Adafruit-Si4713/Kconfig
```kconfig
# Kconfig file for package Adafruit-Si4713
menuconfig PKG_USING_ARDUINO_ADAFRUIT_SI4713
    bool "Adafruit Si4714: FM+RDS/RBDS Transmitter driver"
    select PKG_USING_RTDUINO
    select RTDUINO_USING_WIRE
    select PKG_USING_ARDUINO_ADAFRUIT_BUSIO
    default n

if PKG_USING_ARDUINO_ADAFRUIT_SI4713

    config PKG_ARDUINO_ADAFRUIT_SI4713_PATH
        string
        default "/packages/arduino/communication/Adafruit-Si4713"

    choice
        prompt "Version"
        default PKG_USING_ARDUINO_ADAFRUIT_SI4713_LATEST_VERSION
        help
            Select the package version

        config PKG_USING_ARDUINO_ADAFRUIT_SI4713_LATEST_VERSION
            bool "latest"
    endchoice

    config PKG_ARDUINO_ADAFRUIT_SI4713_VER
       string
       default "latest"    if PKG_USING_ARDUINO_ADAFRUIT_SI4713_LATEST_VERSION

endif
```

## arduino/communication/Kconfig
```kconfig
menu "Communication"

rsource "Adafruit-PN532/Kconfig"
rsource "Adafruit-Si4713/Kconfig"

endmenu
```

## arduino/dataprocessing/ArduinoJson/Kconfig
```kconfig
# Kconfig file for package ArduinoJson
menuconfig PKG_USING_ARDUINO_ARDUINOJSON
    bool "ArduinoJson: A simple and efficient JSON library for embedded C++"
    default n

if PKG_USING_ARDUINO_ARDUINOJSON

    config PKG_ARDUINO_ARDUINOJSON_PATH
        string
        default "/packages/arduino/dataprocessing/ArduinoJson"

    choice
        prompt "Version"
        default PKG_USING_ARDUINO_ARDUINOJSON_LATEST_VERSION
        help
            Select the package version

        config PKG_USING_ARDUINO_ARDUINOJSON_LATEST_VERSION
            bool "latest"
    endchoice

    config PKG_ARDUINO_ARDUINOJSON_VER
       string
       default "latest"    if PKG_USING_ARDUINO_ARDUINOJSON_LATEST_VERSION

endif
```

## arduino/dataprocessing/KalmanFilter/Kconfig
```kconfig
# Kconfig file for package KalmanFilter
menuconfig PKG_USING_ARDUINO_KALMANFILTER
    bool "Kalman Filter Library"
    select PKG_USING_RTDUINO
    default n

if PKG_USING_ARDUINO_KALMANFILTER

    config PKG_ARDUINO_KALMANFILTER_PATH
        string
        default "/packages/arduino/dataprocessing/KalmanFilter"

    choice
        prompt "Version"
        default PKG_USING_ARDUINO_KALMANFILTER_LATEST_VERSION
        help
            Select the package version

        config PKG_USING_ARDUINO_KALMANFILTER_LATEST_VERSION
            bool "latest"
    endchoice

    config PKG_ARDUINO_KALMANFILTER_VER
       string
       default "latest"    if PKG_USING_ARDUINO_KALMANFILTER_LATEST_VERSION

endif
```

## arduino/dataprocessing/Kconfig
```kconfig
menu "Data Processing"

rsource "KalmanFilter/Kconfig"
rsource "ArduinoJson/Kconfig"
rsource "TensorFlow-Lite-Micro/Kconfig"
rsource "RunningMedian/Kconfig"

endmenu
```

## arduino/dataprocessing/RunningMedian/Kconfig
```kconfig
# Kconfig file for package RunningMedian
menuconfig PKG_USING_ARDUINO_RUNNINGMEDIAN
    bool "RunningMedian: determine the running median by means of a circular buffer"
    default n

if PKG_USING_ARDUINO_RUNNINGMEDIAN

    config PKG_ARDUINO_RUNNINGMEDIAN_PATH
        string
        default "/packages/arduino/dataprocessing/RunningMedian"

    choice
        prompt "Version"
        default PKG_USING_ARDUINO_RUNNINGMEDIAN_LATEST_VERSION
        help
            Select the package version

        config PKG_USING_ARDUINO_RUNNINGMEDIAN_LATEST_VERSION
            bool "latest"
    endchoice

    config PKG_ARDUINO_RUNNINGMEDIAN_VER
       string
       default "latest"    if PKG_USING_ARDUINO_RUNNINGMEDIAN_LATEST_VERSION

endif
```

## arduino/dataprocessing/TensorFlow-Lite-Micro/Kconfig
```kconfig
# Kconfig file for package TensorFlow-Lite-Micro
menuconfig PKG_USING_ARDUINO_TENSORFLOW_LITE_MICRO
    bool "TensorFlow Lite Micro: TensorFlow Lite for Microcontrollers (TLFM) Library for RTduino"
    default n

if PKG_USING_ARDUINO_TENSORFLOW_LITE_MICRO

    config PKG_ARDUINO_TENSORFLOW_LITE_MICRO_PATH
        string
        default "/packages/arduino/dataprocessing/TensorFlow-Lite-Micro"

    menu "Examples"
        config PKG_USING_ARDUINO_TENSORFLOW_LITE_MICRO_EXAMPLE_HELLO_WORLD
            bool "hello world: replicate a sine function and blink the built-in LED in a fade in/out pattern"
            default n
    endmenu

    choice
        prompt "Version"
        help
            Select the package version

        config PKG_USING_ARDUINO_TENSORFLOW_LITE_MICRO_LATEST_VERSION
            bool "latest"
    endchoice

    config PKG_ARDUINO_TENSORFLOW_LITE_MICRO_VER
       string
       default "latest"    if PKG_USING_ARDUINO_TENSORFLOW_LITE_MICRO_LATEST_VERSION

endif
```

## arduino/devicecontrol/Adafruit-DRV2605/Kconfig
```kconfig
# Kconfig file for package Adafruit-DRV2605
menuconfig PKG_USING_ARDUINO_ADAFRUIT_DRV2605
    bool "Adafruit DRV2605: Haptic Motor Controller"
    select PKG_USING_RTDUINO
    select RTDUINO_USING_WIRE
    select PKG_USING_ARDUINO_ADAFRUIT_BUSIO
    default n

if PKG_USING_ARDUINO_ADAFRUIT_DRV2605

    config PKG_ARDUINO_ADAFRUIT_DRV2605_PATH
        string
        default "/packages/arduino/devicecontrol/Adafruit-DRV2605"

    choice
        prompt "Version"
        default PKG_USING_ARDUINO_ADAFRUIT_DRV2605_LATEST_VERSION
        help
            Select the package version

        config PKG_USING_ARDUINO_ADAFRUIT_DRV2605_LATEST_VERSION
            bool "latest"
    endchoice

    config PKG_ARDUINO_ADAFRUIT_DRV2605_VER
       string
       default "latest"    if PKG_USING_ARDUINO_ADAFRUIT_DRV2605_LATEST_VERSION

endif
```

## arduino/devicecontrol/Adafruit-DS1841/Kconfig
```kconfig
# Kconfig file for package Adafruit-DS1841
menuconfig PKG_USING_ARDUINO_ADAFRUIT_DS1841
    bool "Adafruit DS1841: Digital Potentiometer Breakout"
    select PKG_USING_RTDUINO
    select RTDUINO_USING_WIRE
    select PKG_USING_ARDUINO_ADAFRUIT_BUSIO
    default n

if PKG_USING_ARDUINO_ADAFRUIT_DS1841

    config PKG_ARDUINO_ADAFRUIT_DS1841_PATH
        string
        default "/packages/arduino/devicecontrol/Adafruit-DS1841"

    choice
        prompt "Version"
        default PKG_USING_ARDUINO_ADAFRUIT_DS1841_LATEST_VERSION
        help
            Select the package version

        config PKG_USING_ARDUINO_ADAFRUIT_DS1841_LATEST_VERSION
            bool "latest"
    endchoice

    config PKG_ARDUINO_ADAFRUIT_DS1841_VER
       string
       default "latest"    if PKG_USING_ARDUINO_ADAFRUIT_DS1841_LATEST_VERSION

endif
```

## arduino/devicecontrol/Adafruit-DS3502/Kconfig
```kconfig
# Kconfig file for package Adafruit-DS3502
menuconfig PKG_USING_ARDUINO_ADAFRUIT_DS3502
    bool   "Adafruit DS3502: Digital Potentiometer"
    select PKG_USING_RTDUINO
    select RTDUINO_USING_WIRE
    select PKG_USING_ARDUINO_ADAFRUIT_BUSIO
    default n

if PKG_USING_ARDUINO_ADAFRUIT_DS3502

    config PKG_ARDUINO_ADAFRUIT_DS3502_PATH
        string
        default "/packages/arduino/devicecontrol/Adafruit-DS3502"

    choice
        prompt "Version"
        default PKG_USING_ARDUINO_ADAFRUIT_DS3502_LATEST_VERSION
        help
            Select the package version

        config PKG_USING_ARDUINO_ADAFRUIT_DS3502_LATEST_VERSION
            bool "latest"
    endchoice

    config PKG_ARDUINO_ADAFRUIT_DS3502_VER
       string
       default "latest"    if PKG_USING_ARDUINO_ADAFRUIT_DS3502_LATEST_VERSION

endif
```

## arduino/devicecontrol/Adafruit-PCA9685/Kconfig
```kconfig
# Kconfig file for package Adafruit-PCA9685
menuconfig PKG_USING_ARDUINO_ADAFRUIT_PCA9685
    bool "Adafruit PCA9685: 16-Channel 12-bit PWM/Servo Driver"
    select PKG_USING_RTDUINO
    select RTDUINO_USING_WIRE
    default n

if PKG_USING_ARDUINO_ADAFRUIT_PCA9685

    config PKG_ARDUINO_ADAFRUIT_PCA9685_PATH
        string
        default "/packages/arduino/devicecontrol/Adafruit-PCA9685"

    choice
        prompt "Version"
        default PKG_USING_ARDUINO_ADAFRUIT_PCA9685_LATEST_VERSION
        help
            Select the package version

        config PKG_USING_ARDUINO_ADAFRUIT_PCA9685_LATEST_VERSION
            bool "latest"
    endchoice

    config PKG_ARDUINO_ADAFRUIT_PCA9685_VER
       string
       default "latest"    if PKG_USING_ARDUINO_ADAFRUIT_PCA9685_LATEST_VERSION

endif
```

## arduino/devicecontrol/Adafruit-TPA2016/Kconfig
```kconfig
# Kconfig file for package Adafruit-TPA2016
menuconfig PKG_USING_ARDUINO_ADAFRUIT_TPA2016
    bool "Adafruit TPA2016: Class D Amplifier Breakout"
    select PKG_USING_RTDUINO
    select RTDUINO_USING_WIRE
    select PKG_USING_ARDUINO_ADAFRUIT_BUSIO
    default n

if PKG_USING_ARDUINO_ADAFRUIT_TPA2016

    config PKG_ARDUINO_ADAFRUIT_TPA2016_PATH
        string
        default "/packages/arduino/devicecontrol/Adafruit-TPA2016"

    choice
        prompt "Version"
        default PKG_USING_ARDUINO_ADAFRUIT_TPA2016_LATEST_VERSION
        help
            Select the package version

        config PKG_USING_ARDUINO_ADAFRUIT_TPA2016_LATEST_VERSION
            bool "latest"
    endchoice

    config PKG_ARDUINO_ADAFRUIT_TPA2016_VER
       string
       default "latest"    if PKG_USING_ARDUINO_ADAFRUIT_TPA2016_LATEST_VERSION

endif
```
