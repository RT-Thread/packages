## peripherals/hal-sdk/Infineon/Infineon_mtb-hal-cat1/Kconfig
```kconfig
# Kconfig file for package Infineon_mtb-hal-cat1
menuconfig PKG_USING_INFINEON_MTB_HAL_CAT1
    bool "Infineon_mtb-hal-cat1."
    default n

if PKG_USING_INFINEON_MTB_HAL_CAT1

    config PKG_INFINEON_MTB_HAL_CAT1_PATH
        string
        default "/packages/peripherals/hal-sdk/Infineon/Infineon_mtb-hal-cat1"

    choice
        prompt "Version"
        help
            Select the package version

        config PKG_USING_INFINEON_MTB_HAL_CAT1_LATEST_VERSION
            bool "latest"
    endchoice

    config PKG_INFINEON_MTB_HAL_CAT1_VER
       string
       default "latest"    if PKG_USING_INFINEON_MTB_HAL_CAT1_LATEST_VERSION

endif
```

## peripherals/hal-sdk/Infineon/Infineon_mtb-pdl-cat1/Kconfig
```kconfig
# Kconfig file for package Infineon_mtb-pdl-cat1
menuconfig PKG_USING_INFINEON_MTB_PDL_CAT1
    bool "Infineon_mtb-pdl-cat1."
    default n

if PKG_USING_INFINEON_MTB_PDL_CAT1

    config PKG_INFINEON_MTB_PDL_CAT1_PATH
        string
        default "/packages/peripherals/hal-sdk/Infineon/Infineon_mtb-pdl-cat1"

    choice
        prompt "Version"
        help
            Select the package version

        config PKG_USING_INFINEON_MTB_PDL_CAT1_LATEST_VERSION
            bool "latest"
    endchoice

    config PKG_INFINEON_MTB_PDL_CAT1_VER
       string
       default "latest"    if PKG_USING_INFINEON_MTB_PDL_CAT1_LATEST_VERSION

endif
```

## peripherals/hal-sdk/Infineon/Infineon_retarget-io/Kconfig
```kconfig
# Kconfig file for package Infineon_retarget-io
menuconfig PKG_USING_INFINEON_RETARGET_IO
    bool "Infineon_retarget-io."
    default n

if PKG_USING_INFINEON_RETARGET_IO

    config PKG_INFINEON_RETARGET_IO_PATH
        string
        default "/packages/peripherals/hal-sdk/Infineon/Infineon_retarget-io"

    choice
        prompt "Version"
        help
            Select the package version

        config PKG_USING_INFINEON_RETARGET_IO_LATEST_VERSION
            bool "latest"
    endchoice

    config PKG_INFINEON_RETARGET_IO_VER
       string
       default "latest"    if PKG_USING_INFINEON_RETARGET_IO_LATEST_VERSION

endif
```

## peripherals/hal-sdk/Infineon/Infineon_serial-flash/Kconfig
```kconfig
# Kconfig file for package Infineon_serial-flash
menuconfig PKG_USING_INFINEON_SERIAL_FLASH
    bool "Infineon_serial-flash."
    default n

if PKG_USING_INFINEON_SERIAL_FLASH

    config PKG_INFINEON_SERIAL_FLASH_PATH
        string
        default "/packages/peripherals/hal-sdk/Infineon/Infineon_serial-flash"

    choice
        prompt "Version"
        help
            Select the package version

        config PKG_USING_INFINEON_SERIAL_FLASH_LATEST_VERSION
            bool "latest"
    endchoice

    config PKG_INFINEON_SERIAL_FLASH_VER
       string
       default "latest"    if PKG_USING_INFINEON_SERIAL_FLASH_LATEST_VERSION

endif
```

## peripherals/hal-sdk/Infineon/Infineon_usbdev/Kconfig
```kconfig
# Kconfig file for package Infineon_usbdev
menuconfig PKG_USING_INFINEON_USBDEV
    bool "Infineon_usbdev."
    default n

if PKG_USING_INFINEON_USBDEV

    config PKG_INFINEON_USBDEV_PATH
        string
        default "/packages/peripherals/hal-sdk/Infineon/Infineon_usbdev"

    choice
        prompt "Version"
        help
            Select the package version

        config PKG_USING_INFINEON_USBDEV_LATEST_VERSION
            bool "latest"
    endchoice

    config PKG_INFINEON_USBDEV_VER
       string
       default "latest"    if PKG_USING_INFINEON_USBDEV_LATEST_VERSION

endif
```

## peripherals/hal-sdk/Infineon/Kconfig
```kconfig
menu "Infineon HAL Packages"

rsource "Infineon_cat1cm0p/Kconfig"
rsource "Infineon_cmsis/Kconfig"
rsource "Infineon_core-lib/Kconfig"
rsource "Infineon_mtb-hal-cat1/Kconfig"
rsource "Infineon_mtb-pdl-cat1/Kconfig"
rsource "Infineon_retarget-io/Kconfig"
rsource "Infineon_capsense/Kconfig"
rsource "Infineon_csdidac/Kconfig"
rsource "Infineon_serial-flash/Kconfig"
rsource "Infineon_usbdev/Kconfig"

endmenu
```

## peripherals/hal-sdk/Kconfig
```kconfig
menu "HAL & SDK Drivers"

source "$PKGS_DIR/packages/peripherals/hal-sdk/stm32/Kconfig"
source "$PKGS_DIR/packages/peripherals/hal-sdk/Infineon/Kconfig"
source "$PKGS_DIR/packages/peripherals/hal-sdk/bluetrum_sdk/Kconfig"
source "$PKGS_DIR/packages/peripherals/hal-sdk/embARC_bsp/Kconfig"
source "$PKGS_DIR/packages/peripherals/hal-sdk/ESP-IDF/Kconfig"
source "$PKGS_DIR/packages/peripherals/hal-sdk/kendryte-sdk/Kconfig"
source "$PKGS_DIR/packages/peripherals/hal-sdk/nrf5x_sdk/Kconfig"
source "$PKGS_DIR/packages/peripherals/hal-sdk/nrfx/Kconfig"
source "$PKGS_DIR/packages/peripherals/hal-sdk/nuclei_sdk/Kconfig"
source "$PKGS_DIR/packages/peripherals/hal-sdk/raspberrypi-pico-sdk/Kconfig"
source "$PKGS_DIR/packages/peripherals/mm32/Kconfig"
source "$PKGS_DIR/packages/peripherals/hal-sdk/wch/Kconfig"
source "$PKGS_DIR/packages/peripherals/hal-sdk/at32/Kconfig"
source "$PKGS_DIR/packages/peripherals/hal-sdk/hc32/Kconfig"
source "$PKGS_DIR/packages/peripherals/hal-sdk/nxp/Kconfig"
endmenu
```

## peripherals/hal-sdk/at32/Kconfig
```kconfig
menu "AT32 HAL & SDK Drivers"

source "$PKGS_DIR/packages/peripherals/hal-sdk/at32/at32a403a_hal_driver/Kconfig"
source "$PKGS_DIR/packages/peripherals/hal-sdk/at32/at32a403a_cmsis_driver/Kconfig"
source "$PKGS_DIR/packages/peripherals/hal-sdk/at32/at32a423_hal_driver/Kconfig"
source "$PKGS_DIR/packages/peripherals/hal-sdk/at32/at32a423_cmsis_driver/Kconfig"
source "$PKGS_DIR/packages/peripherals/hal-sdk/at32/at32f45x_hal_driver/Kconfig"
source "$PKGS_DIR/packages/peripherals/hal-sdk/at32/at32f45x_cmsis_driver/Kconfig"
source "$PKGS_DIR/packages/peripherals/hal-sdk/at32/at32f402_405_hal_driver/Kconfig"
source "$PKGS_DIR/packages/peripherals/hal-sdk/at32/at32f402_405_cmsis_driver/Kconfig"
source "$PKGS_DIR/packages/peripherals/hal-sdk/at32/at32f403a_407_hal_driver/Kconfig"
source "$PKGS_DIR/packages/peripherals/hal-sdk/at32/at32f403a_407_cmsis_driver/Kconfig"
source "$PKGS_DIR/packages/peripherals/hal-sdk/at32/at32f413_hal_driver/Kconfig"
source "$PKGS_DIR/packages/peripherals/hal-sdk/at32/at32f413_cmsis_driver/Kconfig"
source "$PKGS_DIR/packages/peripherals/hal-sdk/at32/at32f415_hal_driver/Kconfig"
source "$PKGS_DIR/packages/peripherals/hal-sdk/at32/at32f415_cmsis_driver/Kconfig"
source "$PKGS_DIR/packages/peripherals/hal-sdk/at32/at32f421_hal_driver/Kconfig"
source "$PKGS_DIR/packages/peripherals/hal-sdk/at32/at32f421_cmsis_driver/Kconfig"
source "$PKGS_DIR/packages/peripherals/hal-sdk/at32/at32f423_hal_driver/Kconfig"
source "$PKGS_DIR/packages/peripherals/hal-sdk/at32/at32f423_cmsis_driver/Kconfig"
source "$PKGS_DIR/packages/peripherals/hal-sdk/at32/at32f425_hal_driver/Kconfig"
source "$PKGS_DIR/packages/peripherals/hal-sdk/at32/at32f425_cmsis_driver/Kconfig"
source "$PKGS_DIR/packages/peripherals/hal-sdk/at32/at32f435_437_hal_driver/Kconfig"
source "$PKGS_DIR/packages/peripherals/hal-sdk/at32/at32f435_437_cmsis_driver/Kconfig"
source "$PKGS_DIR/packages/peripherals/hal-sdk/at32/at32m412_416_hal_driver/Kconfig"
source "$PKGS_DIR/packages/peripherals/hal-sdk/at32/at32m412_416_cmsis_driver/Kconfig"

endmenu
```

## peripherals/hal-sdk/at32/at32a403a_hal_driver/Kconfig
```kconfig
# Kconfig file for package at32a403a_hal_driver
menuconfig PKG_USING_AT32A403A_HAL_DRIVER
    bool "AT32A403A HAL driver package"
    select PKG_USING_AT32A403A_CMSIS_DRIVER
    default n

if PKG_USING_AT32A403A_HAL_DRIVER

    config PKG_AT32A403A_HAL_DRIVER_PATH
        string
        default "/packages/peripherals/hal-sdk/at32/at32a403a_hal_driver"

    choice
        prompt "Version"
        help
            Select the package version

        config PKG_USING_AT32A403A_HAL_DRIVER_LATEST_VERSION
            bool "latest"
    endchoice

    config PKG_AT32A403A_HAL_DRIVER_VER
       string
       default "latest"    if PKG_USING_AT32A403A_HAL_DRIVER_LATEST_VERSION

endif
```

## peripherals/hal-sdk/at32/at32a423_hal_driver/Kconfig
```kconfig
# Kconfig file for package at32a423_hal_driver
menuconfig PKG_USING_AT32A423_HAL_DRIVER
    bool "AT32A423 HAL driver package"
    select PKG_USING_AT32A423_CMSIS_DRIVER
    default n

if PKG_USING_AT32A423_HAL_DRIVER

    config PKG_AT32A423_HAL_DRIVER_PATH
        string
        default "/packages/peripherals/hal-sdk/at32/at32a423_hal_driver"

    choice
        prompt "Version"
        help
            Select the package version

        config PKG_USING_AT32A423_HAL_DRIVER_LATEST_VERSION
            bool "latest"
    endchoice

    config PKG_AT32A423_HAL_DRIVER_VER
       string
       default "latest"    if PKG_USING_AT32A423_HAL_DRIVER_LATEST_VERSION

endif
```

## peripherals/hal-sdk/at32/at32f402_405_cmsis_driver/Kconfig
```kconfig
# Kconfig file for package at32f402_405_cmsis_driver
menuconfig PKG_USING_AT32F402_405_CMSIS_DRIVER
    bool "AT32F402_405 CMSIS driver package"
    select PKG_USING_CMSIS_CORE
    default n

if PKG_USING_AT32F402_405_CMSIS_DRIVER

    config PKG_AT32F402_405_CMSIS_DRIVER_PATH
        string
        default "/packages/peripherals/hal-sdk/at32/at32f402_405_cmsis_driver"

    choice
        prompt "Version"
        help
            Select the package version

        config PKG_USING_AT32F402_405_CMSIS_DRIVER_LATEST_VERSION
            bool "latest"
    endchoice

    config PKG_AT32F402_405_CMSIS_DRIVER_VER
       string
       default "latest"    if PKG_USING_AT32F402_405_CMSIS_DRIVER_LATEST_VERSION

endif
```

## peripherals/hal-sdk/at32/at32f403a_407_cmsis_driver/Kconfig
```kconfig
# Kconfig file for package at32f403a_407_cmsis_driver
menuconfig PKG_USING_AT32F403A_407_CMSIS_DRIVER
    bool "AT32F403A_407 CMSIS driver package"
    select PKG_USING_CMSIS_CORE
    default n

if PKG_USING_AT32F403A_407_CMSIS_DRIVER

    config PKG_AT32F403A_407_CMSIS_DRIVER_PATH
        string
        default "/packages/peripherals/hal-sdk/at32/at32f403a_407_cmsis_driver"

    choice
        prompt "Version"
        help
            Select the package version

        config PKG_USING_AT32F403A_407_CMSIS_DRIVER_LATEST_VERSION
            bool "latest"
    endchoice

    config PKG_AT32F403A_407_CMSIS_DRIVER_VER
       string
       default "latest"    if PKG_USING_AT32F403A_407_CMSIS_DRIVER_LATEST_VERSION

endif
```

## peripherals/hal-sdk/at32/at32f403a_407_hal_driver/Kconfig
```kconfig
# Kconfig file for package at32f403a_407_hal_driver
menuconfig PKG_USING_AT32F403A_407_HAL_DRIVER
    bool "AT32F403A_407 HAL driver package"
    select PKG_USING_AT32F403A_407_CMSIS_DRIVER
    default n

if PKG_USING_AT32F403A_407_HAL_DRIVER

    config PKG_AT32F403A_407_HAL_DRIVER_PATH
        string
        default "/packages/peripherals/hal-sdk/at32/at32f403a_407_hal_driver"

    choice
        prompt "Version"
        help
            Select the package version

        config PKG_USING_AT32F403A_407_HAL_DRIVER_LATEST_VERSION
            bool "latest"
    endchoice

    config PKG_AT32F403A_407_HAL_DRIVER_VER
       string
       default "latest"    if PKG_USING_AT32F403A_407_HAL_DRIVER_LATEST_VERSION

endif
```

## peripherals/hal-sdk/at32/at32f415_hal_driver/Kconfig
```kconfig
# Kconfig file for package at32f415_hal_driver
menuconfig PKG_USING_AT32F415_HAL_DRIVER
    bool "AT32F415 HAL driver package"
    select PKG_USING_AT32F415_CMSIS_DRIVER
    default n

if PKG_USING_AT32F415_HAL_DRIVER

    config PKG_AT32F415_HAL_DRIVER_PATH
        string
        default "/packages/peripherals/hal-sdk/at32/at32f415_hal_driver"

    choice
        prompt "Version"
        help
            Select the package version

        config PKG_USING_AT32F415_HAL_DRIVER_LATEST_VERSION
            bool "latest"
    endchoice

    config PKG_AT32F415_HAL_DRIVER_VER
       string
       default "latest"    if PKG_USING_AT32F415_HAL_DRIVER_LATEST_VERSION

endif
```

## peripherals/hal-sdk/at32/at32f423_hal_driver/Kconfig
```kconfig
# Kconfig file for package at32f423_hal_driver
menuconfig PKG_USING_AT32F423_HAL_DRIVER
    bool "AT32F423 HAL driver package"
    select PKG_USING_AT32F423_CMSIS_DRIVER
    default n

if PKG_USING_AT32F423_HAL_DRIVER

    config PKG_AT32F423_HAL_DRIVER_PATH
        string
        default "/packages/peripherals/hal-sdk/at32/at32f423_hal_driver"

    choice
        prompt "Version"
        help
            Select the package version

        config PKG_USING_AT32F423_HAL_DRIVER_LATEST_VERSION
            bool "latest"
    endchoice

    config PKG_AT32F423_HAL_DRIVER_VER
       string
       default "latest"    if PKG_USING_AT32F423_HAL_DRIVER_LATEST_VERSION

endif
```

## peripherals/hal-sdk/at32/at32f425_hal_driver/Kconfig
```kconfig
# Kconfig file for package at32f425_hal_driver
menuconfig PKG_USING_AT32F425_HAL_DRIVER
    bool "AT32F425 HAL driver package"
    select PKG_USING_AT32F425_CMSIS_DRIVER
    default n

if PKG_USING_AT32F425_HAL_DRIVER

    config PKG_AT32F425_HAL_DRIVER_PATH
        string
        default "/packages/peripherals/hal-sdk/at32/at32f425_hal_driver"

    choice
        prompt "Version"
        help
            Select the package version

        config PKG_USING_AT32F425_HAL_DRIVER_LATEST_VERSION
            bool "latest"
    endchoice

    config PKG_AT32F425_HAL_DRIVER_VER
       string
       default "latest"    if PKG_USING_AT32F425_HAL_DRIVER_LATEST_VERSION

endif
```

## peripherals/hal-sdk/at32/at32f45x_hal_driver/Kconfig
```kconfig
# Kconfig file for package at32f45x_hal_driver
menuconfig PKG_USING_AT32F45x_HAL_DRIVER
    bool "AT32F455_456_457 HAL driver package"
    select PKG_USING_AT32F45x_CMSIS_DRIVER
    default n

if PKG_USING_AT32F45x_HAL_DRIVER

    config PKG_AT32F45x_HAL_DRIVER_PATH
        string
        default "/packages/peripherals/hal-sdk/at32/at32f45x_hal_driver"

    choice
        prompt "Version"
        help
            Select the package version

        config PKG_USING_AT32F45x_HAL_DRIVER_LATEST_VERSION
            bool "latest"
    endchoice

    config PKG_AT32F45x_HAL_DRIVER_VER
       string
       default "latest"    if PKG_USING_AT32F45x_HAL_DRIVER_LATEST_VERSION

endif
```

## peripherals/hal-sdk/at32/at32m412_416_cmsis_driver/Kconfig
```kconfig
# Kconfig file for package at32m412_416_cmsis_driver
menuconfig PKG_USING_AT32M412_416_CMSIS_DRIVER
    bool "AT32M412_416 CMSIS driver package"
    select PKG_USING_CMSIS_CORE
    default n

if PKG_USING_AT32M412_416_CMSIS_DRIVER

    config PKG_AT32M412_416_CMSIS_DRIVER_PATH
        string
        default "/packages/peripherals/hal-sdk/at32/at32m412_416_cmsis_driver"

    choice
        prompt "Version"
        help
            Select the package version

        config PKG_USING_AT32M412_416_CMSIS_DRIVER_LATEST_VERSION
            bool "latest"
    endchoice

    config PKG_AT32M412_416_CMSIS_DRIVER_VER
       string
       default "latest"    if PKG_USING_AT32M412_416_CMSIS_DRIVER_LATEST_VERSION

endif
```

## peripherals/hal-sdk/at32/at32m412_416_hal_driver/Kconfig
```kconfig
# Kconfig file for package at32m412_416_hal_driver
menuconfig PKG_USING_AT32M412_416_HAL_DRIVER
    bool "AT32M412_416 HAL driver package"
    select PKG_USING_AT32M412_416_CMSIS_DRIVER
    default n

if PKG_USING_AT32M412_416_HAL_DRIVER

    config PKG_AT32M412_416_HAL_DRIVER_PATH
        string
        default "/packages/peripherals/hal-sdk/at32/at32m412_416_hal_driver"

    choice
        prompt "Version"
        help
            Select the package version

        config PKG_USING_AT32M412_416_HAL_DRIVER_LATEST_VERSION
            bool "latest"
    endchoice

    config PKG_AT32M412_416_HAL_DRIVER_VER
       string
       default "latest"    if PKG_USING_AT32M412_416_HAL_DRIVER_LATEST_VERSION

endif
```
