## peripherals/sensors/sgp30/Kconfig
```kconfig
# Kconfig file for package sgp30
menuconfig PKG_USING_SGP30
    bool "SGP30: air sensor by Sensirion for detect TVOC and CO2."
    default n

if PKG_USING_SGP30

    config PKG_SGP30_PATH
        string
        default "/packages/peripherals/sensors/sgp30"

    config PKG_SGP30_USING_SENSOR_V1
        bool "Enable sensor_v1 divce framework"
        select RT_USING_SENSOR
        default y
        
        if  PKG_SGP30_USING_SENSOR_V1
            config PKG_SGP30_USING_SENSOR_V1_SAMPLE
                bool "Enable sgp30 sensor_v1 sample"
                default y
        endif
        
    choice
        prompt "Select I2C address"
        default PKG_USING_SGP30_I2C_ADDR
        help
            SGP30 has only one I2C address

        config PKG_USING_SGP30_I2C_ADDR
            bool "0x58"
    endchoice

    config PKG_USING_SGP30_I2C_ADDRESS
       hex
       default 0x58      if PKG_USING_SGP30_I2C_ADDR

    config PKG_USING_SGP30_INIT_BASELINE
        bool "Enable set baseline on boot"
        default n

    if PKG_USING_SGP30_INIT_BASELINE

        config PKG_USING_SGP30_INIT_BASELINE_ECO2
            int "eCO2 baseline value"
            range 0 65535
            default 0

        config PKG_USING_SGP30_INIT_BASELINE_TVOC
            int "TVOC baseline value"
            range 0 65535
            default 0
    endif

    config PKG_USING_SGP30_DEBUG
        bool "Enable debug log output"
        default n

    config PKG_USING_SGP30_SAMPLE
        bool "Enable sgp30 sample"
        default n

    config PKG_USING_SGP30_SAMPLE_I2C_BUS_NAME
        string "i2c bus name"
        depends on PKG_USING_SGP30_SAMPLE
        default "i2c1"

    choice
        prompt "Version"
        default PKG_USING_SGP30_LATEST_VERSION
        help
            Select the package version

        config PKG_USING_SGP30_V100
            bool "v1.0.0"

        config PKG_USING_SGP30_LATEST_VERSION
            bool "latest"
    endchoice

    config PKG_SGP30_VER
       string
       default "v1.0.0"    if PKG_USING_SGP30_V100
       default "latest"    if PKG_USING_SGP30_LATEST_VERSION

endif
```

## peripherals/sensors/sht2x/Kconfig
```kconfig
# Kconfig file for package sht2x
menuconfig PKG_USING_SHT2X
    bool "sht2x: digital humidity and temperature sensor sht2x driver library"
    default n

if PKG_USING_SHT2X

    config PKG_SHT2X_PATH
        string
        default "/packages/peripherals/sensors/sht2x"

    config SHT20_USING_SOFT_FILTER
        bool "Enable average filter by software"
        default n
        help
            "It will automatic sample sensor's data by average filter thread."

    if SHT20_USING_SOFT_FILTER

        config SHT20_AVERAGE_TIMES
            int "The number of averaging"
            default 10
            help
                "When selected filter function, it will be the number you will add and divide amount."

        config SHT20_SAMPLE_PERIOD
            int "Peroid of sampling data(unit ms)"
            default 1000
            help
                "When selected filter function, it will be the period you will sample. The unit of the period is millisecond."
    endif


    choice
        prompt "Version"
        default PKG_USING_SHT2X_LATEST_VERSION
        help
            Select the package version

        config PKG_USING_SHT2X_V100
            bool "v1.0.0"

        config PKG_USING_SHT2X_LATEST_VERSION
            bool "latest"
    endchoice

    config PKG_SHT2X_VER
       string
       default "v1.0.0"    if PKG_USING_SHT2X_V100
       default "latest"    if PKG_USING_SHT2X_LATEST_VERSION

endif
```

## peripherals/sensors/sht4x/Kconfig
```kconfig
# Kconfig file for package sht4x
menuconfig PKG_USING_SHT4X
    bool "sht4x: digital humidity and temperature sensor sht4x driver library"
    default n

if PKG_USING_SHT4X

    config PKG_SHT4X_PATH
        string
        default "/packages/peripherals/sensors/sht4x"

    choice
        prompt "Version"
        default PKG_USING_SHT4X_LATEST_VERSION
        help
            Select the package version

        config PKG_USING_SHT4X_V100
            bool "v1.0.0"

        config PKG_USING_SHT4X_LATEST_VERSION
            bool "latest"
    endchoice

    config PKG_SHT4X_VER
       string
       default "v1.0.0"    if PKG_USING_SHT4X_V100
       default "latest"    if PKG_USING_SHT4X_LATEST_VERSION

endif
```

## peripherals/sensors/shtc1/Kconfig
```kconfig
# Kconfig file for package shtc1
menuconfig PKG_USING_SHTC1
    bool "SHTC1 sensor driver package, support: temperature, humidity."
    default n

if PKG_USING_SHTC1

    config PKG_SHTC1_PATH
        string
        default "/packages/peripherals/sensors/shtc1"

    choice
        prompt "Version"
        default PKG_USING_SHTC1_LATEST_VERSION
        help
            Select the package version

        config PKG_USING_SHTC1_V100
            bool "v1.0.0"

        config PKG_USING_SHTC1_LATEST_VERSION
            bool "latest"
    endchoice
          
    config PKG_SHTC1_VER
       string
       default "v1.0.0"    if PKG_USING_SHTC1_V100
       default "latest"    if PKG_USING_SHTC1_LATEST_VERSION

endif
```

## peripherals/sensors/spl0601/Kconfig
```kconfig
# Kconfig file for package spl0601
menuconfig PKG_USING_SPL0601
    bool "SPL0601: Digital pressure sensor"
    default n

if PKG_USING_SPL0601
    config PKG_SPL0601_PATH
        string
        default "/packages/peripherals/sensors/spl0601"

    config PKG_SPL0601_USING_SENSOR_V1
        bool "Enable sensor_v1 divce framework"
        select RT_USING_SENSOR
        default n

    config SPL0601_USING_TEMP
        bool "Enable SPL0601 temperature"
        default n

    config SPL0601_USING_BARO
        bool "Enable SPL0601 pressure"
        default n

    choice
        prompt "Version"
        default PKG_USING_SPL0601_LATEST_VERSION
        help
            Select the package version

        config PKG_USING_SPL0601_V001
            bool "v0.0.1"

        config PKG_USING_SPL0601_LATEST_VERSION
            bool "latest"
    endchoice

    config PKG_SPL0601_VER
        string
        default "latest"    if PKG_USING_SPL0601_LATEST_VERSION
endif
```

## peripherals/sensors/sr04/Kconfig
```kconfig
# Kconfig file for package sr04
menuconfig PKG_USING_SR04
    bool "HC-SR04 sensor driver package."
    select RT_USING_HWTIMER
    select RT_USING_SENSOR
    default n

if PKG_USING_SR04

    config PKG_SR04_PATH
        string
        default "/packages/peripherals/sensors/sr04"

    choice
        prompt "Version"
        default PKG_USING_SR04_LATEST_VERSION
        help
            Select the package version

        config PKG_USING_SR04_V100
            bool "v1.0.0"

        config PKG_USING_SR04_LATEST_VERSION
            bool "latest"
    endchoice

    config PKG_USING_SR04_SAMPLE
        bool "Enable sr04 sample"
        default y

    config PKG_SR04_VER
       string
       default "v1.0.0"    if PKG_USING_SR04_V100
       default "latest"    if PKG_USING_SR04_LATEST_VERSION

endif
```

## peripherals/sensors/sths34pf80/Kconfig
```kconfig
# Kconfig file for package sths34pf80
menuconfig PKG_USING_STHS34PF80
    bool "STHS34PF80 sensor driver package, support: presence,temperature,motion."
    default n

if PKG_USING_STHS34PF80

    config PKG_STHS34PF80_PATH
        string
        default "/packages/peripherals/sensors/sths34pf80"

    config PKG_STHS34PF80_USING_SENSOR_V1
        bool "Enable sensor_v1 divce framework"
        select RT_USING_SENSOR
        default n

    choice
        prompt "Version"
        default PKG_USING_STHS34PF80_LATEST_VERSION
        help
            Select the package version

        config PKG_USING_STHS34PF80_LATEST_VERSION
            bool "latest"
    endchoice

    config PKG_STHS34PF80_VER
       string
       default "latest"    if PKG_USING_STHS34PF80_LATEST_VERSION

endif
```

## peripherals/sensors/tmp1075/Kconfig
```kconfig
# Kconfig file for package tmp1075
menuconfig PKG_USING_TMP1075
    bool "TMP1075 digital temperature sensor for i2c interface."
    select RT_USING_SENSOR
    default n

if PKG_USING_TMP1075

    config PKG_TMP1075_PATH
        string
        default "/packages/peripherals/sensors/tmp1075"

     config PKG_USING_TMP1075_SAMPLE
        bool "Enable tmp1075 sample"
        default n

    choice
        prompt "Version"
        default PKG_USING_TMP1075_LATEST_VERSION
        help
            Select the package version

        config PKG_USING_TMP1075_V100
            bool "v1.0.0"

        config PKG_USING_TMP1075_LATEST_VERSION
            bool "latest"
    endchoice

    config PKG_TMP1075_VER
       string
       default "v1.0.0"    if PKG_USING_TMP1075_V100
       default "latest"    if PKG_USING_TMP1075_LATEST_VERSION

endif
```

## peripherals/sensors/tsl4531/Kconfig
```kconfig
# Kconfig file for package tsl4531
menuconfig PKG_USING_TSL4531
    bool "TSL4531: a digital ambient light and a proximity senseor tsl4531 driver library."
    default n

if PKG_USING_TSL4531

    config PKG_TSL4531_PATH
        string
        default "/packages/peripherals/sensors/tsl4531"

    choice
        prompt "Version"
        default PKG_USING_TSL4531_LATEST_VERSION
        help
            Select the package version

        config PKG_USING_TSL4531_V011
            bool "v0.1.1"

        config PKG_USING_TSL4531_LATEST_VERSION
            bool "latest"
    endchoice
          
    config PKG_TSL4531_VER
       string
       default "v0.1.1"    if PKG_USING_TSL4531_V011
       default "latest"    if PKG_USING_TSL4531_LATEST_VERSION

endif
```

## peripherals/sensors/vl53l0x/Kconfig
```kconfig
# Kconfig file for package vl53l0x
menuconfig PKG_USING_VL53L0X
    bool "VL53L0X Time of flight(TOF) sensor."
    default n

if PKG_USING_VL53L0X

    config PKG_VL53L0X_PATH
        string
        default "/packages/peripherals/sensors/vl53l0x"

    config PKG_VL53L0X_USING_SENSOR_V1
        bool "Enable sensor_v1 divce framework"
        select RT_USING_SENSOR
        default n
        if PKG_VL53L0X_USING_SENSOR_V1
            config PKG_VL53L0X_USING_SENSOR_V1_SAMPLE
                bool "Enable vl53l0x sensor_v1 divce framework sample"
                default n
        endif

    choice
        prompt "Version"
        default PKG_USING_VL53L0X_LATEST_VERSION
        help
            Select the package version

        config PKG_USING_VL53L0X_V100
            bool "v1.0.0"

        config PKG_USING_VL53L0X_LATEST_VERSION
            bool "latest"
    endchoice

    config PKG_VL53L0X_VER
       string
       default "v1.0.0"    if PKG_USING_VL53L0X_V100
       default "latest"    if PKG_USING_VL53L0X_LATEST_VERSION

endif
```

## peripherals/sensors/xproject/Kconfig
```kconfig
# Kconfig file for package xproject
menuconfig PKG_USING_XPROJECT
    bool "This is a game"
    default n

if PKG_USING_XPROJECT

    config PKG_XPROJECT_PATH
        string
        default "/packages/peripherals/sensors/xproject"

    choice
        prompt "Version"
        default PKG_USING_XPROJECT_LATEST_VERSION
        help
            Select the package version

        config PKG_USING_XPROJECT_LATEST_VERSION
            bool "latest"
    endchoice
          
    config PKG_XPROJECT_VER
       string
       default "latest"    if PKG_USING_XPROJECT_LATEST_VERSION

endif
```

## peripherals/sensors/zmod4410/Kconfig
```kconfig
# Kconfig file for package ZMOD4410
menuconfig PKG_USING_ZMOD4410
    bool "ZMOD4410: Gas Sensor Module ZMOD4410 driver library"
    default n

if PKG_USING_ZMOD4410

    config PKG_ZMOD4410_PATH
        string
        default "/packages/peripherals/sensors/ZMOD4410"

    config PKG_ZMOD4410_USING_SENSOR_V1
        bool "Enable sensor_v1 divce framework"
        select RT_USING_SENSOR
        default n

    choice
        prompt "Version"
        default PKG_USING_ZMOD4410_LATEST_VERSION
        help
            Select the package version

        config PKG_USING_ZMOD4410_LATEST_VERSION
            bool "latest"
    endchoice

    config PKG_ZMOD4410_VER
        string
        default "latest"    if PKG_USING_ZMOD4410_LATEST_VERSION

endif
```

## peripherals/sgm706/Kconfig
```kconfig
# Kconfig file for package sgm706
menuconfig PKG_USING_SGM706
    bool "SGM706 Independent watchdog."
    default n

if PKG_USING_SGM706

    config PKG_SGM706_PATH
        string
        default "/packages/peripherals/sgm706"

     config PKG_USING_SGM706_SAMPLE
        bool "Enable sgm706 sample"
        default n

    choice
        prompt "Version"
        default PKG_USING_SGM706_LATEST_VERSION
        help
            Select the package version

        config PKG_USING_SGM706_V100
            bool "v1.0.0"

        config PKG_USING_SGM706_LATEST_VERSION
            bool "latest"
    endchoice

    config PKG_SGM706_VER
       string
       default "v1.0.0"    if PKG_USING_SGM706_V100
       default "latest"    if PKG_USING_SGM706_LATEST_VERSION

endif
```

## peripherals/sht2x/Kconfig
```kconfig
# Kconfig file for package sht2x
menuconfig PKG_USING_SHT2X
    bool "sht2x: digital humidity and temperature sensor sht2x driver library"
    default n

if PKG_USING_SHT2X

    config PKG_SHT2X_PATH
        string
        default "/packages/peripherals/sht2x"

    config SHT20_USING_SOFT_FILTER
        bool "Enable average filter by software"
        default n
        help
            "It will automatic sample sensor's data by average filter thread."

    choice
        prompt "Version"
        default PKG_USING_SHT2X_LATEST_VERSION
        help
            Select the package version

        config PKG_USING_SHT2X_V100
            bool "v1.0.0"

        config PKG_USING_SHT2X_LATEST_VERSION
            bool "latest"
    endchoice

    config PKG_SHT2X_VER
       string
       default "v1.0.0"    if PKG_USING_SHT2X_V100
       default "latest"    if PKG_USING_SHT2X_LATEST_VERSION

endif
```
