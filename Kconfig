## Kconfig
```kconfig
menu "RT-Thread online packages"

source "$PKGS_DIR/packages/iot/Kconfig"
source "$PKGS_DIR/packages/security/Kconfig"
source "$PKGS_DIR/packages/language/Kconfig"
source "$PKGS_DIR/packages/multimedia/Kconfig"
source "$PKGS_DIR/packages/tools/Kconfig"
source "$PKGS_DIR/packages/system/Kconfig"
source "$PKGS_DIR/packages/peripherals/Kconfig"
source "$PKGS_DIR/packages/ai/Kconfig"
source "$PKGS_DIR/packages/signalprocess/Kconfig"
source "$PKGS_DIR/packages/misc/Kconfig"
source "$PKGS_DIR/packages/arduino/Kconfig"

endmenu
```

## ai/Kconfig
```kconfig
menu "AI packages"

source "$PKGS_DIR/packages/ai/libann/Kconfig"
source "$PKGS_DIR/packages/ai/nnom/Kconfig"
source "$PKGS_DIR/packages/ai/onnx-backend/Kconfig"
source "$PKGS_DIR/packages/ai/onnx-parser/Kconfig"
source "$PKGS_DIR/packages/ai/TensorflowLiteMicro/Kconfig"
source "$PKGS_DIR/packages/ai/elapack/Kconfig"
source "$PKGS_DIR/packages/ai/ulapack/Kconfig"
source "$PKGS_DIR/packages/ai/quest/Kconfig"
source "$PKGS_DIR/packages/ai/naxos/Kconfig"
source "$PKGS_DIR/packages/ai/ncnn/Kconfig"
source "$PKGS_DIR/packages/ai/r-tinymaix/Kconfig"
source "$PKGS_DIR/packages/ai/llmchat/Kconfig"

endmenu
```

## ai/TensorflowLiteMicro/Kconfig
```kconfig
# Kconfig file for package TensorflowLiteMicro
menuconfig PKG_USING_TENSORFLOWLITEMICRO
    bool "Tensorflow Lite Micro: a lightweight deep learning end-test inference framework for RT-Thread operating system."
    select RT_USING_CPLUSPLUS
    default n

if PKG_USING_TENSORFLOWLITEMICRO

    config PKG_TENSORFLOWLITEMICRO_PATH
        string
        default "/packages/ai/TensorflowLiteMicro"

    choice
        prompt "Version"
        default PKG_USING_TENSORFLOWLITEMICRO_LATEST_VERSION
        help
            Select the package version

        config PKG_USING_TENSORFLOWLITEMICRO_V101
            bool "v1.0.1"

        config PKG_USING_TENSORFLOWLITEMICRO_V100
            bool "v1.0.0"

        config PKG_USING_TENSORFLOWLITEMICRO_LATEST_VERSION
            bool "latest"
    endchoice

    choice
        prompt "Select Offical Example"
        default PKG_USING_TENSORFLOWLITEMICRO_NO_EXAMPLE

        config PKG_USING_TENSORFLOWLITEMICRO_AUDIO_EXAMPLE
            bool "Enable Tensorflow Lite Micro Person Detection example"

        config PKG_USING_TENSORFLOWLITEMICRO_NO_EXAMPLE
            bool "No Tensorflow Lite Micro Example"
    endchoice

    choice
        prompt "Select Tensorflow Lite Operations Type"
        default PKG_USING_TENSORFLOWLITEMICRO_CMSISNN

        config PKG_USING_TENSORFLOWLITEMICRO_REFERENCE
            bool "Using Tensorflow Lite reference operations"

        config PKG_USING_TENSORFLOWLITEMICRO_CMSISNN
            bool "Using Tensorflow Lite CMSIS NN operations"
    endchoice

    config PKG_TENSORFLOWLITEMICRO_VER
       string
       default "v1.0.1"    if PKG_USING_TENSORFLOWLITEMICRO_V101
       default "v1.0.0"    if PKG_USING_TENSORFLOWLITEMICRO_V100
       default "latest"    if PKG_USING_TENSORFLOWLITEMICRO_LATEST_VERSION

endif
```

## ai/llmchat/Kconfig
```kconfig
# Kconfig file for package llmchat
menuconfig PKG_USING_LLMCHAT
    bool "Large Language Models(LLM) for RT-Thread"
    select PKG_USING_CJSON
    select PKG_USING_WEBCLIENT
    select PKG_USING_MBEDTLS
    select PKG_USING_MBEDTLS_DIGICERT_ROOT_CA
    select PKG_USING_MBEDTLS_CLOBALSIGN_ROOT_CA
    default n

if PKG_USING_LLMCHAT

    config PKG_LLMCHAT_PATH
        string
        default "/packages/ai/llmchat"

    choice
        prompt "select llm model"
        default PKG_LLM_USING_QWEN_CLOUD
        config PKG_LLM_USING_DOUBAO_CLOUD
            bool "doubao llm port"
        config PKG_LLM_USING_QWEN_CLOUD
            bool "qwen llm port"
        config PKG_LLM_USING_DEEPSEEK_CLOUD
            bool "deepseek llm port"
    endchoice

    if PKG_LLM_USING_QWEN_CLOUD
        config PKG_LLM_API_KEY
            string "llm qwen user api key"
            default "sk-**-**"
            help
                qwen llm api key

        config PKG_LLM_MODEL_NAME
            string "llm qwen model name"
            default "qwen-plus"
            help
                qwen llm model name

        config PKG_LLM_QWEN_API_URL
            string "llm qwen model api url"
            default "https://dashscope.aliyuncs.com/compatible-mode/v1/chat/completions"
            help
                Qwen model API URL. Please set this to:
                "https://dashscope.aliyuncs.com/compatible-mode/v1/chat/completions"
    endif

    if PKG_LLM_USING_DOUBAO_CLOUD
        config PKG_LLM_API_KEY
            string "llm doubao user api key"
            default "f4de4d**-**"
            help
                doubao llm api key

        config PKG_LLM_MODEL_NAME
            string "llm doubao user model id"
            default "ep-2024**-**"
            help
                reasoning about the access point ID

        config PKG_LLM_DOUBAO_API_URL
            string "llm doubao model api url"
            default "https://ark.cn-beijing.volces.com/api/v3/chat/completions"
            help
                Doubao model API URL. Please set this to:
                "https://ark.cn-beijing.volces.com/api/v3/chat/completions"
    endif

    if PKG_LLM_USING_DEEPSEEK_CLOUD
        config PKG_LLM_API_KEY
            string "llm deepseek user api key"
            default "f4de4d**-**"
            help
                deepseek llm api key

        config PKG_LLM_MODEL_NAME
            string "llm deepseek user model id"
            default "deepseek-chat"
            help
                deepseek llm model name

        config PKG_LLM_DEEPSEEK_API_URL
            string "llm deepseek model api url"
            default "https://api.deepseek.com/chat/completions"
            help
                DeepSeek model API URL. Please set this to:
                "https://api.deepseek.com/chat/completions"
    endif

    config PKG_LLM_THREAD_STACK_SIZE
        int "llm thread size"
        default 10240
        help
            llm thread size

    config PKG_LLM_CMD_BUFFER_SIZE
        int "llm cmd input buffer size"
        default 256
        help
            llm cmd input buffer size

    config PKG_WEB_SORKET_BUFSZ
        int "webclient session buffer size"
        default 2048
        help
            webclient session buffer size

    config PKG_LLMCHAT_STREAM
        bool "Enable llmchat http stream"
        default y

    config PKG_LLMCHAT_HISTORY_PAYLOAD
        bool "Enable llmchat history payload"
        default n

    config PKG_LLMCHAT_DBG
        bool "Enable llmchat debug"
        default n
    
    menu "Enable llmchat example"
        config PKG_USING_LLMCHAT_DEMO
            bool "select llm_contory demo"
            default n
    endmenu

    choice
        prompt "Version"
        default PKG_USING_LLMCHAT_LATEST_VERSION
        help
            Select the llm version

        config PKG_USING_LLMCHAT_V130
            bool "v1.3.0"

        config PKG_USING_LLMCHAT_V120
            bool "v1.2.0"

        config PKG_USING_LLMCHAT_V110
            bool "v1.1.0"

        config PKG_USING_LLMCHAT_V100
            bool "v1.0.0"

        config PKG_USING_LLMCHAT_LATEST_VERSION
            bool "latest"
    endchoice

    config PKG_LLMCHAT_VER
       string
       default "v1.3.0"    if PKG_USING_LLMCHAT_V130
       default "v1.2.0"    if PKG_USING_LLMCHAT_V120
       default "v1.1.0"    if PKG_USING_LLMCHAT_V110
       default "v1.0.0"    if PKG_USING_LLMCHAT_V100
       default "latest"    if PKG_USING_LLMCHAT_LATEST_VERSION

endif
```

## ai/naxos/Kconfig
```kconfig
# Kconfig file for package naxos
menuconfig PKG_USING_NAXOS
    select RT_USING_CPLUSPLUS
    select RT_USING_LIBC if RT_VER_NUM < 0x40100
    bool "A C++ Constraint Programming Library"
    default n

if PKG_USING_NAXOS

    config PKG_NAXOS_PATH
        string
        default "/packages/ai/naxos"

    config NAXOS_USING_SEND_MORE_MONEY_EXAMPLE
        bool "naxos: send more money example."
        help
            naxos: send more money example.
        default n

    config NAXOS_USING_N_QUEENS_EXAMPLE
        bool "naxos: nqueens example."
        help
            naxos: nqueens example.
        default n

    choice
        prompt "Version"
        default PKG_USING_NAXOS_LATEST_VERSION
        help
            Select the package version

        config PKG_USING_NAXOS_LATEST_VERSION
            bool "latest"
    endchoice

    config PKG_NAXOS_VER
       string
       default "latest"    if PKG_USING_NAXOS_LATEST_VERSION

endif
```

## ai/ncnn/Kconfig
```kconfig
# Kconfig file for package ncnn
menuconfig PKG_USING_NCNN
    bool "ncnn package for RT-Thread."
    depends on ARCH_ARMV8
    default n

if PKG_USING_NCNN

    config PKG_NCNN_PATH
        string
        default "/packages/ai/ncnn"

    choice
        prompt "Version"
        default PKG_USING_NCNN_LATEST_VERSION
        help
            Select the package version

        config PKG_USING_NCNN_V100
            bool "v1.0.0"

        config PKG_USING_NCNN_LATEST_VERSION
            bool "latest"
    endchoice

    config PKG_NCNN_VER
       string
       default "v1.0.0"    if PKG_USING_NCNN_V100
       default "latest"    if PKG_USING_NCNN_LATEST_VERSION

endif
```

## ai/nnom/Kconfig
```kconfig
# Kconfig file for package nnom
menuconfig PKG_USING_NNOM
    bool "NNoM: A higher-level Neural Network framework on Microcontroller"
    default n

if PKG_USING_NNOM

    config PKG_NNOM_PATH
        string
        default "/packages/ai/nnom"

    choice
        prompt "Version"
        default PKG_USING_NNOM_V043
        help
            Select the package version

        config PKG_USING_NNOM_V010
            bool "v0.1.0"

        config PKG_USING_NNOM_V020
            bool "v0.2.0"

        config PKG_USING_NNOM_V021
            bool "v0.2.1"

    config PKG_USING_NNOM_V030
            bool "v0.3.0"

    config PKG_USING_NNOM_V040
            bool "v0.4.0"

    config PKG_USING_NNOM_V041
            bool "v0.4.1"

    config PKG_USING_NNOM_V042
            bool "v0.4.2"

    config PKG_USING_NNOM_V043
            bool "v0.4.3"

        config PKG_USING_NNOM_LATEST_VERSION
            bool "latest"
    endchoice

    config PKG_NNOM_VER
       string
       default "v0.1.0"    if PKG_USING_NNOM_V010
       default "v0.2.0"    if PKG_USING_NNOM_V020
       default "v0.2.1"    if PKG_USING_NNOM_V021
       default "v0.3.0"    if PKG_USING_NNOM_V030
       default "v0.4.0"    if PKG_USING_NNOM_V040
       default "v0.4.1"    if PKG_USING_NNOM_V041
       default "v0.4.2"    if PKG_USING_NNOM_V042
       default "v0.4.3"    if PKG_USING_NNOM_V043
       default "latest"    if PKG_USING_NNOM_LATEST_VERSION

endif
```

## ai/quest/Kconfig
```kconfig
# Kconfig file for package quest
menuconfig PKG_USING_QUEST
    select RT_USING_RTC
    bool "quest: A simulator of quantum computers on MCU. (RTC required)"
    default n

if PKG_USING_QUEST

    config PKG_QUEST_PATH
        string
        default "/packages/ai/quest"

    config QUEST_USING_TUTORIAL_EXAMPLE
        bool "quest: basic tutorial example."
        help
            quest: basic tutorial example.
        default n

    config QUEST_USING_DAMPING_EXAMPLE
        bool "quest: damping example."
        help
            quest: damping example.
        default n

    config QUEST_USING_BERNSTEIN_VAZIRANI_CIRCUIT_EXAMPLE
        bool "quest: bernstein vazirani circuit example."
        help
            quest: bernstein vazirani circuit example.
        default n

    choice
        prompt "Version"
        default PKG_USING_QUEST_LATEST_VERSION
        help
            Select the package version

        config PKG_USING_QUEST_LATEST_VERSION
            bool "latest"
    endchoice

    config PKG_QUEST_VER
       string
       default "latest"    if PKG_USING_QUEST_LATEST_VERSION

endif
```

## ai/r-tinymaix/Kconfig
```kconfig
# Kconfig file for package r-tinymaix
menuconfig PKG_USING_R_TINYMAIX
    bool "r-tinymaix: A tiny inference Neural Network library specifically."
    select PKG_USING_RT_VSNPRINTF_FULL if RT_VER_NUM < 0x50200
    select RT_KLIBC_USING_VSNPRINTF_STANDARD if RT_VER_NUM >= 0x50200
    default n

if PKG_USING_R_TINYMAIX

    config PKG_R_TINYMAIX_PATH
        string
        default "/packages/ai/r-tinymaix"

    config R_TINYMAIX_USING_CIFAR10_SAMPLE
        bool "Enable using tinymaix cifar10 sample"
        default n

    config R_TINYMAIX_USING_MNIST_SAMPLE
        bool "Enable using tinymaix mnist sample"
        default n

    config R_TINYMAIX_USING_VWW_SAMPLE
        bool "Enable using tinymaix vww sample"
        default n

    choice
        prompt "Arch Type"
            default R_TINYMAIX_USING_ARCH_CPU
        help
            Select the arch type

        config R_TINYMAIX_USING_ARCH_CPU
            bool "Default, pure cpu compute"

        config R_TINYMAIX_USING_ARCH_ARM_SIMD
            bool "ARM Cortex M4/M7, etc"

        config R_TINYMAIX_USING_ARCH_ARM_NEON
            bool "ARM Cortex A7, etc"

        config R_TINYMAIX_USING_ARCH_ARM_MVEI
            bool "ARMv8.1: M55, etc"

        config R_TINYMAIX_USING_ARCH_RV32P
            bool "T-head E907, etc"

        config R_TINYMAIX_USING_ARCH_RV64V
            bool "T-head C906,C910, etc"
    endchoice

    config R_TINYMAIX_USING_ARCK_TYPE
        int
        default 0    if R_TINYMAIX_USING_ARCH_CPU
        default 1    if R_TINYMAIX_USING_ARCH_ARM_SIMD
        default 2    if R_TINYMAIX_USING_ARCH_ARM_NEON
        default 3    if R_TINYMAIX_USING_ARCH_ARM_MVEI
        default 4    if R_TINYMAIX_USING_ARCH_RV32P
        default 5    if R_TINYMAIX_USING_ARCH_RV64V

    choice
        prompt "Option Level"
            default R_TINYMAIX_USING_OPT0
        help
            Select the option level

        config R_TINYMAIX_USING_OPT0
            bool "Default, least code and buf"

        config R_TINYMAIX_USING_OPT1
            bool "Opt for speed, need more code and buf"

        config R_TINYMAIX_USING_OPT2
            bool "TODO"
    endchoice

    config R_TINYMAIX_USING_OPTION_LEVEL
        int
        default 0    if R_TINYMAIX_USING_OPT0
        default 1    if R_TINYMAIX_USING_OPT1
        default 2    if R_TINYMAIX_USING_OPT2

    choice
        prompt "Model Type"
            default R_TINYMAIX_USING_MODULE_INT8
        help
            Select the option level

        config R_TINYMAIX_USING_MODULE_INT8
            bool "Default, module int8"

        config R_TINYMAIX_USING_MODULE_INT16
            bool "Module int16"

        config R_TINYMAIX_USING_MODULE_FP32
            bool "Module FP32"

        config R_TINYMAIX_USING_MODULE_FP16
            bool "Module FP16"

        config R_TINYMAIX_USING_MODULE_FP8_143
            bool "Module FP8 143"

        config R_TINYMAIX_USING_MODULE_FP8_152
            bool "Module FP8 152"
    endchoice

    config R_TINYMAIX_USING_MODULE_TYPE
        int
        default 0    if R_TINYMAIX_USING_MODULE_INT8
        default 1    if R_TINYMAIX_USING_MODULE_INT16
        default 2    if R_TINYMAIX_USING_MODULE_FP32
        default 3    if R_TINYMAIX_USING_MODULE_FP16
        default 4    if R_TINYMAIX_USING_MODULE_FP8_143
        default 5    if R_TINYMAIX_USING_MODULE_FP8_152

    choice
        prompt "Version"
        default PKG_USING_R_TINYMAIX_LATEST_VERSION
        help
            Select the package version

        config PKG_USING_R_TINYMAIX_LATEST_VERSION
            bool "latest"
    endchoice

    config PKG_R_TINYMAIX_VER
       string
       default "latest"    if PKG_USING_R_TINYMAIX_LATEST_VERSION


endif
```
