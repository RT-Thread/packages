## iot/iot_cloud/ali-iotkit/v20x/Kconfig
```kconfig
# Kconfig file for package ali-iotkit v203

choice
    prompt "Select Aliyun platform"
	default PKG_USING_ALI_IOTKIT_IS_LINKPLATFORM
    help
        Select Aliyun platform

    config PKG_USING_ALI_IOTKIT_IS_LINKDEVELOP
        bool "LinkDevelop Platform"
        help
            Use LinkDevelop Platform
        
    config PKG_USING_ALI_IOTKIT_IS_LINKPLATFORM
        bool "LinkPlatform Platform"
        help
            Use LinkPlatform Platform
endchoice

config PKG_USING_ALI_IOTKIT_MQTT
    bool "Enable MQTT"
    default n 

if PKG_USING_ALI_IOTKIT_MQTT
    config PKG_USING_ALI_IOTKIT_MQTT_SAMPLE
        bool "Enable MQTT sample"
        default y
    config PKG_USING_ALI_IOTKIT_MQTT_DIRECT
        bool "Enable MQTT direct connect"
        default y
    config PKG_USING_ALI_IOTKIT_MQTT_TLS
        bool "Enable SSL"
        default n
        select PKG_USING_MBEDTLS
endif

config PKG_USING_ALI_IOTKIT_COAP
    bool "Enable COAP"
    default n

if PKG_USING_ALI_IOTKIT_COAP
    config PKG_USING_ALI_IOTKIT_COAP_SAMPLE
        bool "Enable COAP sample"
        default y
    config PKG_USING_ALI_IOTKIT_COAP_DTLS
        bool "Enable SSL"
        default n
        select PKG_USING_MBEDTLS
endif

config PKG_USING_ALI_IOTKIT_OTA
    bool "Enable OTA"
    default n

if PKG_USING_ALI_IOTKIT_OTA
    choice
        prompt "Select OTA channel"
		default PKG_USING_ALI_IOTKIT_MQTT_OTA
        help
            Select OTA channel
            
        config PKG_USING_ALI_IOTKIT_MQTT_OTA
            bool "Use MQTT OTA channel"
            select PKG_USING_MBEDTLS
            select PKG_USING_ALI_IOTKIT_MQTT
            select PKG_USING_ALI_IOTKIT_MQTT_TLS
            help
                Obtain OTA information through MQTT

        config PKG_USING_ALI_IOTKIT_COAP_OTA
            bool "Use COAP OTA channel"
            select PKG_USING_MBEDTLS
            select PKG_USING_ALI_IOTKIT_COAP
            help
                Obtain OTA information through COAP
    endchoice
endif
```

## iot/iot_cloud/azure-iot-sdk/Kconfig
```kconfig
# Kconfig file for package azure
menuconfig PKG_USING_AZURE
    bool "Azure IoT SDK: Microsoft azure cloud SDK for RT-Thread"
    default n
    select PKG_USING_NETUTILS
    select PKG_NETUTILS_NTP
    select PKG_USING_MBEDTLS

if PKG_USING_AZURE

    config PKG_AZURE_PATH
        string
        default "/packages/iot/iot_cloud/azure-iot-sdk"

    choice
        prompt "Choose Protocol"
        default PKG_USING_AZURE_MQTT_PROTOCOL
        help
            Select the Sample Protocol

        config PKG_USING_AZURE_MQTT_PROTOCOL
            bool "Using MQTT Protocol"

        config PKG_USING_AZURE_HTTP_PROTOCOL
            bool "Using HTTP Protocol"
    endchoice

    config PKG_USING_AZURE_TELEMTRY_EXAMPLE
        bool "Enable Azure iothub telemetry example"
        default n

    config PKG_USING_AZURE_C2D_EXAMPLE
        bool "Enable Azure iothub cloud to device example"
        default n

    choice
        prompt "Version"
        default PKG_USING_AZURE_LATEST_VERSION
        help
            Select the package version

        config PKG_USING_AZURE_V10208
            bool "v1.2.8"

        config PKG_USING_AZURE_V10209
            bool "v1.2.9"

        config PKG_USING_AZURE_LATEST_VERSION
            bool "latest"
    endchoice

    config PKG_AZURE_VER
       string
       default "v1.2.8"    if PKG_USING_AZURE_V10208
       default "v1.2.9"    if PKG_USING_AZURE_V10209
       default "latest"    if PKG_USING_AZURE_LATEST_VERSION

endif
```

## iot/iot_cloud/ez_iot_os/Kconfig
```kconfig
menuconfig PKG_USING_EZ_IOT_OS
    bool "ez_iot_os: Ezviz Cloud IoT SDK for RT-Thread."
    default n

if PKG_USING_EZ_IOT_OS
    config PKG_EZ_IOT_OS_PATH
        string
        default "/packages/iot/iot_cloud/ez_iot_os"

        menu "ez-iot configuration"
        source "$PKGS_DIR/packages/iot/iot_cloud/ez_iot_os/eziot/ez_iot_core/Kconfig"
        source "$PKGS_DIR/packages/iot/iot_cloud/ez_iot_os/eziot/ez_iot_bm/base/Kconfig"
        source "$PKGS_DIR/packages/iot/iot_cloud/ez_iot_os/eziot/ez_iot_bm/hub/Kconfig"
        source "$PKGS_DIR/packages/iot/iot_cloud/ez_iot_os/eziot/ez_iot_bm/model/Kconfig"
        source "$PKGS_DIR/packages/iot/iot_cloud/ez_iot_os/eziot/ez_iot_bm/ota/Kconfig"
        source "$PKGS_DIR/packages/iot/iot_cloud/ez_iot_os/eziot/ez_iot_bm/shadow/Kconfig"
        source "$PKGS_DIR/packages/iot/iot_cloud/ez_iot_os/eziot/ez_iot_bm/tsl/Kconfig"
        endmenu

        menu "os/bsp configuration"
        source "$PKGS_DIR/packages/iot/iot_cloud/ez_iot_os/platform/bsp/rt-thread/Kconfig"
        endmenu

        menu "components configuration"
        source "$PKGS_DIR/packages/iot/iot_cloud/ez_iot_os/components/cJSON/Kconfig"
        source "$PKGS_DIR/packages/iot/iot_cloud/ez_iot_os/components/ezconn/Kconfig"
        source "$PKGS_DIR/packages/iot/iot_cloud/ez_iot_os/components/ezlog/Kconfig"
        source "$PKGS_DIR/packages/iot/iot_cloud/ez_iot_os/components/ezlist/Kconfig"
        source "$PKGS_DIR/packages/iot/iot_cloud/ez_iot_os/components/eztimer/Kconfig"
        source "$PKGS_DIR/packages/iot/iot_cloud/ez_iot_os/components/ezutil/misc/Kconfig"
        source "$PKGS_DIR/packages/iot/iot_cloud/ez_iot_os/components/ezutil/s2j/Kconfig"
        source "$PKGS_DIR/packages/iot/iot_cloud/ez_iot_os/components/ezutil/uuid/Kconfig"
        source "$PKGS_DIR/packages/iot/iot_cloud/ez_iot_os/components/ezxml/Kconfig"
        source "$PKGS_DIR/packages/iot/iot_cloud/ez_iot_os/components/FlashDB/Kconfig"
        source "$PKGS_DIR/packages/iot/iot_cloud/ez_iot_os/components/http_server/Kconfig"
        source "$PKGS_DIR/packages/iot/iot_cloud/ez_iot_os/components/mbedtls/Kconfig"
        source "$PKGS_DIR/packages/iot/iot_cloud/ez_iot_os/components/mqtt/Kconfig"
        source "$PKGS_DIR/packages/iot/iot_cloud/ez_iot_os/components/utest/Kconfig"
        source "$PKGS_DIR/packages/iot/iot_cloud/ez_iot_os/components/webclient/Kconfig"
        endmenu

        menu "unit-test configuration"
        source "$PKGS_DIR/packages/iot/iot_cloud/ez_iot_os/unit_test/Kconfig"
        endmenu

        menu "examples configuration"
        source "$PKGS_DIR/packages/iot/iot_cloud/ez_iot_os/examples/Kconfig"
        endmenu

        choice
            prompt "Version"
            default PKG_USING_EZ_IOT_OS_V20000
            help
                Select the package version

            config PKG_USING_EZ_IOT_OS_V20000
                bool "v2.0.0"

            config PKG_USING_EZ_IOT_OS_LATEST_VERSION
                bool "latest"
        endchoice

        config PKG_EZ_IOT_OS_VER
        string
        default "v2.0.0"        if PKG_USING_EZ_IOT_OS_V20000
        default "latest"        if PKG_USING_EZ_IOT_OS_LATEST_VERSION
endif
```

## iot/iot_cloud/ez_iot_os/components/FlashDB/Kconfig
```kconfig
menuconfig EZIOT_COMPONENT_FLASHDB_ENABLE
    bool "Enable FlashDB"
    default y

config EZIOT_COMPONENT_FLASHDB_USING_KVDB
    bool "using KVDB feature"
    default y
    depends on EZIOT_COMPONENT_FLASHDB_ENABLE

config EZIOT_COMPONENT_FLASHDB_KV_AUTO_UPDATE
    bool "Auto update KV to latest default when current KVDB version number is changed"
    default n
    depends on EZIOT_COMPONENT_FLASHDB_USING_KVDB

config EZIOT_COMPONENT_FLASHDB_USING_TSDB
    bool "using TSDB (Time series database) feature"
    default n
    depends on EZIOT_COMPONENT_FLASHDB_ENABLE

choice EZIOT_COMPONENT_FLASHDB_USING_MODE
    prompt "Choice which storage mode to use"
    default EZIOT_COMPONENT_FLASHDB_USING_FILE_LIBC_MODE
    depends on EZIOT_COMPONENT_FLASHDB_ENABLE

config EZIOT_COMPONENT_FLASHDB_USING_FILE_LIBC_MODE
    bool "Using file storage mode by LIBC file API, like fopen/fread/fwrte/fclose"
config EZIOT_COMPONENT_FLASHDB_USING_FILE_POSIX_MODE
    bool "Using file storage mode by POSIX file API, like open/read/write/close"
config EZIOT_COMPONENT_FLASHDB_USING_FAL_MODE
    bool "Using FAL(Flash Abstraction Layer) storage mode"
endchoice

choice EZIOT_COMPONENT_FLASHDB_WRITE_GRAN
    prompt "the flash write granularity"
    default EZIOT_COMPONENT_FLASHDB_WRITE_GRAN_1BIT
    depends on EZIOT_COMPONENT_FLASHDB_ENABLE && EZIOT_COMPONENT_FLASHDB_USING_FAL_MODE

config EZIOT_COMPONENT_FLASHDB_WRITE_GRAN_1BIT
    bool "1 Bit"
config EZIOT_COMPONENT_FLASHDB_WRITE_GRAN_8BIT
    bool "1 Bit"
config EZIOT_COMPONENT_FLASHDB_WRITE_GRAN_32BIT
    bool "Using FAL(Flash Abstraction Layer) storage mode"
endchoice

config EZIOT_COMPONENT_FLASHDB_BIG_ENDIAN
    bool "MCU Endian Configuration, default is Little Endian Order"
    default n
    depends on EZIOT_COMPONENT_FLASHDB_ENABLE

config EZIOT_COMPONENT_FLASHDB_DEBUG_ENABLE
    bool "print debug information"
    default n
    depends on EZIOT_COMPONENT_FLASHDB_ENABLE
```

## iot/iot_cloud/ez_iot_os/components/ezconn/Kconfig
```kconfig
menuconfig EZIOT_COMPONENT_EZCONN_ENABLE
    bool "Enable ezconn"
    default y

config EZIOT_COMPONENT_EZCONN_HTTPD_STACK_SIZE
    int "Stack size of httpd server used by distribute"
    default 8192
    depends on EZIOT_COMPONENT_EZCONN_ENABLE
```

## iot/iot_cloud/ez_iot_os/components/ezlog/Kconfig
```kconfig
menuconfig EZIOT_COMPONENT_EZLOG_ENABLE
    bool "Enable ezlog"
    default y

config EZIOT_COMPONENT_EZLOG_OUTPUT_ENABLE
    bool "Enable log output"
    default y
    depends on EZIOT_COMPONENT_EZLOG_ENABLE

config EZIOT_COMPONENT_EZLOG_ASSERT_ENABLE
    bool "Enable assert check"
    default n
    depends on EZIOT_COMPONENT_EZLOG_ENABLE

config EZIOT_COMPONENT_EZLOG_LINE_BUF_SIZE
    int "Buffer size for every line's log"
    range 512 16384
    default 1024
    depends on EZIOT_COMPONENT_EZLOG_ENABLE

config EZIOT_COMPONENT_EZLOG_LINE_NUM_MAX_LEN
    int "Output line number max length"
    default 5
    depends on EZIOT_COMPONENT_EZLOG_ENABLE

config EZIOT_COMPONENT_EZLOG_FILTER_TAG_MAX_LEN
    int "Output filter's tag max length"
    default 16
    depends on EZIOT_COMPONENT_EZLOG_ENABLE

config EZIOT_COMPONENT_EZLOG_FILTER_KW_MAX_LEN
    int "Output filter's keyword max length"
    default 16
    depends on EZIOT_COMPONENT_EZLOG_ENABLE

config EZIOT_COMPONENT_EZLOG_FILTER_TAG_LVL_MAX_NUM
    int "Output filter's tag level max num"
    range 0 5
    default 5
    depends on EZIOT_COMPONENT_EZLOG_ENABLE

choice EZIOT_COMPONENT_EZLOG_NEWLINE_SIGN
    prompt "Output newline sign"
    default EZIOT_COMPONENT_EZLOG_NEWLINE_SIGN_CRLF
    depends on EZIOT_COMPONENT_EZLOG_ENABLE

    help
        This option allows configuring the desired line endings in print data
        when a newline ('\n', LF) appears on stdout.
        Three options are possible:

        CRLF: '\r\n', whenever LF is encountered, prepend it with CR

        LF: '\n', no modification is applied, stdout is sent as is

        CR: '\r', each occurence of LF is replaced with CR

config EZIOT_COMPONENT_EZLOG_NEWLINE_SIGN_CRLF
    bool "CRLF"
config EZIOT_COMPONENT_EZLOG_NEWLINE_SIGN_LF
    bool "LF"
config EZIOT_COMPONENT_EZLOG_NEWLINE_SIGN_CR
    bool "CR"
endchoice

config EZIOT_COMPONENT_EZLOG_COLOR_ENABLE
    bool "Enable log color"
    default y
    depends on EZIOT_COMPONENT_EZLOG_ENABLE

config EZIOT_COMPONENT_EZLOG_ASYNC_OUTPUT_ENABLE
    bool "Enable asynchronous output mode"
    default n
    depends on EZIOT_COMPONENT_EZLOG_ENABLE

config EZIOT_COMPONENT_EZLOG_ASYNC_LINE_OUTPUT
    bool "Each asynchronous output's log which must end with newline sign"
    default y
    depends on EZIOT_COMPONENT_EZLOG_ENABLE && EZIOT_COMPONENT_EZLOG_ASYNC_OUTPUT_ENABLE

config EZIOT_COMPONENT_EZLOG_ASYNC_OUTPUT_USING_PTHREAD
    bool "Asynchronous output mode using POSIX pthread implementation"
    default y
    depends on EZIOT_COMPONENT_EZLOG_ENABLE && EZIOT_COMPONENT_EZLOG_ASYNC_OUTPUT_ENABLE

config EZIOT_COMPONENT_EZLOG_BUF_OUTPUT_ENABLE
    bool "Enable buffered output mode"
    default n
    depends on EZIOT_COMPONENT_EZLOG_ENABLE
```

## iot/iot_cloud/ez_iot_os/components/eztimer/Kconfig
```kconfig
menuconfig EZIOT_COMPONENT_EZTIMER_ENABLE
    bool "Enable eztimer"
    default y

config EZIOT_CONPONENT_TIMER_TASK_STACK_SIZE
    int "Stack size of timer task"
    default 4096
    depends on EZIOT_COMPONENT_EZTIMER_ENABLE
```

## iot/iot_cloud/ez_iot_os/components/ezutil/misc/Kconfig
```kconfig
menuconfig EZIOT_COMPONENT_EZUTIL_MISC_ENABLE
    bool "Enable ezutil misc"
    default y
```

## iot/iot_cloud/ez_iot_os/components/ezutil/s2j/Kconfig
```kconfig
menuconfig EZIOT_COMPONENT_EZUTIL_S2J_ENABLE
    bool "Enable ezutil s2j"
    default y
```

## iot/iot_cloud/ez_iot_os/components/ezutil/uuid/Kconfig
```kconfig
menuconfig EZIOT_COMPONENT_EZUTIL_UUID_ENABLE
    bool "Enable ezutil uuid"
    default y
```

## iot/iot_cloud/ez_iot_os/components/http_server/Kconfig
```kconfig
menuconfig EZIOT_COMPONENT_EZHTTPD_ENABLE
    bool "Enable http_server"
    default y
```

## iot/iot_cloud/ez_iot_os/components/mbedtls/Kconfig
```kconfig
menuconfig EZIOT_COMPONENT_MBEDTLS_ENABLE
    bool "Enable mbedtls"
    default y
```

## iot/iot_cloud/ez_iot_os/components/mqtt/Kconfig
```kconfig
menuconfig EZIOT_COMPONENT_MQTT_ENABLE
    bool "Enable mqtt client"
    default y
```

## iot/iot_cloud/ez_iot_os/components/webclient/Kconfig
```kconfig
menuconfig EZIOT_COMPONENT_WEBCLIENT_ENABLE
    bool "Enable webclient"
    default y
```
