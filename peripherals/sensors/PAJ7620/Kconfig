## peripherals/sensors/PAJ7620/Kconfig
```kconfig
# Kconfig file for package PAJ7620
menuconfig PKG_USING_PAJ7620
    bool "PAJ7620: a gesture detection module"
    select RT_USING_I2C
    select RT_USING_I2C_BITOPS
    default n

if PKG_USING_PAJ7620

    config PKG_PAJ7620_PATH
        string
        default "/packages/peripherals/sensors/PAJ7620"

    config PAJ7620_USING_SAMPLES
    bool "enable samples"
    default n

    choice
        prompt "Version"
        default PKG_USING_PAJ7620_LATEST_VERSION
        help
            Select the package version

        config PKG_USING_PAJ7620_V100
            bool "v1.0.0"

        config PKG_USING_PAJ7620_LATEST_VERSION
            bool "latest"
    endchoice


    config PKG_PAJ7620_VER
       string
       default "v1.0.0"    if PKG_USING_PAJ7620_V100
       default "latest"    if PKG_USING_PAJ7620_LATEST_VERSION

endif
```

## peripherals/sensors/ad7746/Kconfig
```kconfig
# Kconfig file for package ad7746
menuconfig PKG_USING_AD7746
    bool "AD7746: a high resolution, capacitance-to-digital converter (CDC)."
    select RT_USING_PIN
    select RT_USING_I2C
    select RT_USING_I2C_BITOPS
    select RT_USING_CPLUSPLUS
    default n

if PKG_USING_AD7746

    config PKG_AD7746_PATH
        string
        default "/packages/peripherals/sensors/ad7746"

    config AD7746_I2C_NAME
        string "i2c bus name"
        default "i2c2"

    config AD7746_USING_READ_TEMPERATURE
        bool "AD7746 Temperature Display : print current temperature"
        help
            Print AD7746 Temperature: read current temperature from on-chip temperature sensor
        default n

    config AD7746_USING_READ_WRITE
        bool "AD7746 Register Read Write : i2c command line tools for ad7746"
        help
            Print AD7746 Read Write: read/write command line tools for ad7746
        default n

    config AD7746_USING_READ_CAPACITANCE
        bool "AD7746 Capacitance Display : print current capacitance"
        help
            Print AD7746 capacitance: read current capacitance
        default n

    config AD7746_USING_READ_CAPACITANCE_EXTENSION
        bool "AD7746 Capacitance Display : print current capacitance (with extension)"
        help
            Print AD7746 capacitance: read current capacitance (with extension)
        default n

    choice
        prompt "Version"
        default PKG_USING_AD7746_LATEST_VERSION
        help
            Select the package version

        config PKG_USING_AD7746_V100
            bool "v1.0.0"

        config PKG_USING_AD7746_LATEST_VERSION
            bool "latest"
    endchoice

    config PKG_AD7746_VER
       string
       default "v1.0.0"    if PKG_USING_AD7746_V100
       default "latest"    if PKG_USING_AD7746_LATEST_VERSION

    config PKG_AD7746_VER_NUM
        hex
        default 0x10000 if PKG_USING_AD7746_V100
        default 0x99999 if PKG_USING_AD7746_LATEST_VERSION

endif
```

## peripherals/sensors/adt74xx/Kconfig
```kconfig
# Kconfig file for package adt74xx
menuconfig PKG_USING_ADT74XX
    bool "adt74xx: digital temperature sensor adt74xx driver"
    default n

if PKG_USING_ADT74XX

    config PKG_ADT74XX_PATH
        string
        default "/packages/peripherals/sensors/adt74xx"

    choice
        prompt "Version"
        default PKG_USING_ADT74XX_LATEST_VERSION
        help
            Select the package version


        config PKG_USING_ADT74XX_LATEST_VERSION
            bool "latest"
    endchoice

    config PKG_ADT74XX_VER
       string

       default "latest"    if PKG_USING_ADT74XX_LATEST_VERSION
endif
```

## peripherals/sensors/aht10/Kconfig
```kconfig
# Kconfig file for package aht10
menuconfig PKG_USING_AHT10
    bool "AHT10: digital humidity and temperature sensor driver"
    default n

if PKG_USING_AHT10

    config PKG_AHT10_PATH
        string
        default "/packages/peripherals/sensors/aht10"

    config PKG_AHT10_USING_SOFT_FILTER
        bool "Enable average filter by software"
        default n
        help
            "It will automatic sample sensor's data by average filter thread."

    config PKG_AHT10_USING_SENSOR_V2
        bool "Enable sensor divce framework"
        depends on RT_VER_NUM >= 0x50001
        select RT_USING_SENSOR
        select RT_USING_SENSOR_V2
        default n
        
    config PKG_USING_AHT10_SAMPLE
        bool "Enable aht10 sample"
        default n
        if PKG_USING_AHT10_SAMPLE
            config PKG_AHT10_I2C_BUS_NAME
                string "The name of the I2C bus used by AHT10"
                default "i2c3"
        endif

    if PKG_AHT10_USING_SOFT_FILTER

        config PKG_AHT10_AVERAGE_TIMES
            int "The number of averaging"
            default 10
            help
                "When selected filter function, it will be the number you will average."

        config PKG_AHT10_SAMPLE_PERIOD
            int "Peroid of sampling data(unit ms)"
            default 1000
            help
                "When selected filter function, it will be the period you will sample. The unit of the period is millisecond."
    endif

    choice
        prompt "Version"
        help
            Select the package version

        config PKG_USING_AHT10_LATEST_VERSION
            bool "latest"
            depends on RT_VER_NUM >= 0x50001

        config PKG_USING_AHT10_V300
            bool "v3.0.0"
            depends on RT_VER_NUM >= 0x50001 || RT_USING_SENSOR_V2

        config PKG_USING_AHT10_V210
            bool "v2.1.0"
            depends on RT_VER_NUM < 0x50000 || !RT_USING_SENSOR_V2

        config PKG_USING_AHT10_V200
            bool "v2.0.0"
            depends on RT_VER_NUM < 0x50000

        config PKG_USING_AHT10_V100
            bool "v1.0.0"
            depends on RT_VER_NUM < 0x50000

    endchoice

    config PKG_AHT10_VER
       string
       default "v1.0.0"    if PKG_USING_AHT10_V100
       default "v2.0.0"    if PKG_USING_AHT10_V200
       default "v2.1.0"    if PKG_USING_AHT10_V210
       default "v3.0.0"    if PKG_USING_AHT10_V300
       default "latest"    if PKG_USING_AHT10_LATEST_VERSION

endif
```

## peripherals/sensors/am2320/Kconfig
```kconfig
# Kconfig file for package am2320
menuconfig PKG_USING_AM2320
    bool "digital humidity and temperature sensor am2320 driver library."
    default n

if PKG_USING_AM2320

    config PKG_AM2320_PATH
        string
        default "/packages/peripherals/sensors/am2320"

    choice
        prompt "Version"
        default PKG_USING_AM2320_LATEST_VERSION
        help
            Select the package version

        config PKG_USING_AM2320_V001
            bool "v0.0.1"

        config PKG_USING_AM2320_LATEST_VERSION
            bool "latest"
    endchoice

    config PKG_AM2320_VER
       string
       default "v0.0.1"    if PKG_USING_AM2320_V001
       default "latest"    if PKG_USING_AM2320_LATEST_VERSION

endif
```

## peripherals/sensors/ap3216c/Kconfig
```kconfig
# Kconfig file for package ap3216c
menuconfig PKG_USING_AP3216C
    bool "ap3216c: a digital ambient light and a proximity sensor ap3216c driver library."
    default n

if PKG_USING_AP3216C

    config PKG_AP3216C_PATH
        string
        default "/packages/peripherals/sensors/ap3216c"

    config AP3216C_USING_SENSOR_DEVICE
        bool "Enable sensor divce framework"
        select RT_USING_SENSOR
        default n

    config AP3216C_USING_HW_INT
        bool "Enable hardware interrupt."
        default n
        help
            "It will enable hardware interrupt for the sensor, include als and ps interrupt."

    if AP3216C_USING_HW_INT

        config AP3216C_INT_PIN
            int "The number of the sensor hardware interrupt pin."
            default 47
            help
                "When selected hardware interrupt, it will be the number of pin."

    endif

    choice
        prompt "Version"
        help
            Select the package version

        config PKG_USING_AP3216C_LATEST_VERSION
            bool "latest"
            depends on RT_VER_NUM >= 0x50000

        config PKG_USING_AP3216C_V200
            bool "v2.0.0"

        config PKG_USING_AP3216C_V100
            bool "v1.0.0"
    endchoice

    config PKG_AP3216C_VER
       string
       default "v1.0.0"    if PKG_USING_AP3216C_V100
       default "v2.0.0"    if PKG_USING_AP3216C_V200
       default "latest"    if PKG_USING_AP3216C_LATEST_VERSION

endif
```

## peripherals/sensors/as7341/Kconfig
```kconfig
# Kconfig file for package as7341
menuconfig PKG_USING_AS7341
    bool "AS7341: AS7341 visible light sensor, can measure 8 wavelengths of visible light."
    default n

if PKG_USING_AS7341

    config PKG_AS7341_PATH
        string
        default "/packages/peripherals/sensors/as7341"

    choice
        prompt "Version"
        default PKG_USING_AS7341_LATEST_VERSION
        help
            Select the package version

        config PKG_USING_AS7341_V100
            bool "v1.0.0"

        config PKG_USING_AS7341_LATEST_VERSION
            bool "latest"
    endchoice

    config PKG_AS7341_VER
       string
       default "v1.0.0"    if PKG_USING_AS7341_V100
       default "latest"    if PKG_USING_AS7341_LATEST_VERSION

endif
```

## peripherals/sensors/balance/Kconfig
```kconfig
# Kconfig file for package balance
menuconfig PKG_USING_BALANCE
    bool "Use hx71xx and weighing pressure sensor to measure weight"
    default n

if PKG_USING_BALANCE

    config PKG_BALANCE_PATH
        string
        default "/packages/peripherals/sensors/balance"

    choice
        prompt "Version"
        default PKG_USING_BALANCE_LATEST_VERSION
        help
            Select the package version


        config PKG_USING_BALANCE_LATEST_VERSION
            bool "latest"
    endchoice

    config PKG_BALANCE_VER
       string
       default "latest"    if PKG_USING_BALANCE_LATEST_VERSION

endif
```

## peripherals/sensors/bh1750/Kconfig
```kconfig
# Kconfig file for package BH1750FVI
menuconfig PKG_USING_BH1750
    bool "bh1750 sensor driver package, support: ambient light."
    default n

if PKG_USING_BH1750

    config PKG_BH1750_PATH
        string
        default "/packages/peripherals/sensors/bh1750"

    choice
        prompt "Version"
        default PKG_USING_BH1750_LATEST_VERSION
        help
            Select the package version

        config PKG_USING_BH1750_V100
            bool "v1.0.0"

        config PKG_USING_BH1750_V200
            bool "v2.0.0"

        config PKG_USING_BH1750_LATEST_VERSION
            bool "latest"
    endchoice

    config PKG_BH1750_VER
       string
       default "v1.0.0"    if PKG_USING_BH1750_V100
       default "v2.0.0"    if PKG_USING_BH1750_V200
       default "latest"    if PKG_USING_BH1750_LATEST_VERSION

    if PKG_USING_BH1750_V100
        config BH1750_USING_SOFT_FILTER
            bool "Enable average filter by software"
            default n
            help
                "It will automatic sample sensor's data by average filter thread."

        if BH1750_USING_SOFT_FILTER

            config BH1750_AVERAGE_TIMES
                int "The number of averaging"
                default 10
                help
                    "When selected filter function, it will be the number you will add and divide amount."

            config BH1750_SAMPLE_PERIOD
                int "Peroid of sampling data(unit ms)"
                default 1000
                help
                    "When selected filter function, it will be the period you will sample. The unit of the period is millisecond."
        endif
    endif

endif
```

## peripherals/sensors/bma400/Kconfig
```kconfig
# Kconfig file for package bma400
menuconfig PKG_USING_BMA400
    bool "BMA400 sensor driver package, support: accelerometer, step."
    default n

if PKG_USING_BMA400

    config PKG_BMA400_PATH
        string
        default "/packages/peripherals/sensors/bma400"

    config PKG_BMA400_USING_SENSOR_V1
        bool "Enable sensor_v1 divce framework"
        select RT_USING_SENSOR
        default n

    config PKG_USING_BMA400_ACCE
        bool "Enable bma400 acce"
        default y

    config PKG_USING_BMA400_STEP
        bool "Enable bma400 step"
        default y

    choice
        prompt "Version"
        default PKG_USING_BMA400_LATEST_VERSION
        help
            Select the package version

        config PKG_USING_BMA400_V001
            bool "v0.0.1"

        config PKG_USING_BMA400_LATEST_VERSION
            bool "latest"
    endchoice

    config PKG_BMA400_VER
       string
       default "v0.0.1"    if PKG_USING_BMA400_V001
       default "latest"    if PKG_USING_BMA400_LATEST_VERSION

endif
```

## peripherals/sensors/bme280/Kconfig
```kconfig
# Kconfig file for package bme280
menuconfig PKG_USING_BME280
    bool "BME280 sensor driver package, support: barometric, humidity."
    default n

if PKG_USING_BME280

    config PKG_BME280_PATH
        string
        default "/packages/peripherals/sensors/bme280"

    choice
        prompt "Version"
        default PKG_USING_BME280_LATEST_VERSION
        help
            Select the package version

        config PKG_USING_BME280_V001
            bool "v0.0.1"

        config PKG_USING_BME280_LATEST_VERSION
            bool "latest"
    endchoice

    config PKG_BME280_VER
       string
       default "v0.0.1"    if PKG_USING_BME280_V001
       default "latest"    if PKG_USING_BME280_LATEST_VERSION

endif
```

## peripherals/sensors/bme680/Kconfig
```kconfig
# Kconfig file for package bme680
menuconfig PKG_USING_BME680
    bool "BME680: Digital 4-in-1 sensor with gas, humidity, pressure and temperature."
    default n

if PKG_USING_BME680

    config PKG_BME680_PATH
        string
        default "/packages/peripherals/sensors/bme680"

    config PKG_USING_BME680_FLOAT_POINT_COMPENSATION
        bool "Enable float point compensation"
        default n

    config PKG_USING_BME680_DEBUG
        bool "Enable debug log output"
        default n

    config PKG_USING_BME680_SAMPLE_I2C
        bool "Enable bme680 i2c sample"
        default n

    if PKG_USING_BME680_SAMPLE_I2C

        config PKG_USING_BME680_SAMPLE_I2C_BUS_NAME
            string "i2c bus name"
            default "i2c1"

        choice
            prompt "Select i2c address"
            default PKG_USING_BME680_I2C_ADDR_LOW

            config PKG_USING_BME680_I2C_ADDR_LOW
                bool "0x76"

            config PKG_USING_BME680_I2C_ADDR_HIGH
                bool "0x77"
        endchoice

        config PKG_USING_BME680_SAMPLE_I2C_ADDRESS
            hex
            default 0x76      if PKG_USING_BME680_I2C_ADDR_LOW
            default 0x77      if PKG_USING_BME680_I2C_ADDR_HIGH

    endif

    choice
        prompt "Version"
        default PKG_USING_BME680_LATEST_VERSION
        help
            Select the package version

        config PKG_USING_BME680_V100
            bool "v1.0.0"

        config PKG_USING_BME680_LATEST_VERSION
            bool "latest"
    endchoice

    config PKG_BME680_VER
       string
       default "v1.0.0"    if PKG_USING_BME680_V100
       default "latest"    if PKG_USING_BME680_LATEST_VERSION

endif
```

## peripherals/sensors/bmi088/Kconfig
```kconfig
# Kconfig file for package bmi088
menuconfig PKG_USING_BMI088
    bool "bmi088: a bmi088 package for rt-thread."
    default n

if PKG_USING_BMI088

    config PKG_BMI088_PATH
        string
        default "/packages/peripherals/sensors/bmi088"
        
    config PKG_BMI088_USING_SENSOR_V1
        bool "Enable sensor_v1 divce framework"
        select RT_USING_SENSOR
        default n

    choice
        prompt "Version"
        default PKG_USING_BMI088_LATEST_VERSION
        help
            Select the package version

        config PKG_USING_BMI088_V100
            bool "v1.0.0"

        config PKG_USING_BMI088_LATEST_VERSION
            bool "latest"
    endchoice

    config PKG_BMI088_VER
        string
        default "latest"    if PKG_USING_BMI088_LATEST_VERSION

endif
```
