## system/event_recorder/Kconfig
```kconfig
# Kconfig file for package event_recorder
menuconfig PKG_USING_EVENT_RECORDER
    bool "event_recorder: A lightweight event record and replay tools for debug and test."
    default n

if PKG_USING_EVENT_RECORDER

    config PKG_EVENT_RECORDER_PATH
        string
        default "/packages/system/event_recorder"

    choice
        prompt "Record storage tpye"
        default EVENT_RECORDER_USING_FLASHDB
        config EVENT_RECORDER_USING_FLASHDB
            select PKG_USING_FLASHDB
            bool "Using FlashDB"
    endchoice

    choice
        prompt "Version"
        default PKG_USING_EVENT_RECORDER_V010
        help
            Select the package version

        config PKG_USING_EVENT_RECORDER_V010
            bool "v0.1.0"

        config PKG_USING_EVENT_RECORDER_LATEST_VERSION
            bool "latest"
    endchoice

    config PKG_EVENT_RECORDER_VER
       string
       default "v0.1.0"    if PKG_USING_EVENT_RECORDER_V010
       default "latest"    if PKG_USING_EVENT_RECORDER_LATEST_VERSION

endif
```

## system/fal/Kconfig
```kconfig
# Kconfig file for package fal
menuconfig PKG_USING_FAL
    bool "fal: Flash Abstraction Layer implement. Manage flash device and partition."
    select RT_USING_LIBC if PKG_FAL_VER_NUM <= 0x00300
    default n

if PKG_USING_FAL

    config PKG_FAL_PATH
        string
        default "/packages/system/fal"

    config FAL_DEBUG_CONFIG
        bool "Enable debug log output"
        default y

    config FAL_DEBUG
       int
       default 1    if FAL_DEBUG_CONFIG
       default 0

    config FAL_PART_HAS_TABLE_CFG
        bool "FAL partition table config has defined on 'fal_cfg.h'"
        default y
        help
            If defined partition table on 'fal_cfg.h' please enable this option.
            When this option is disable, it will auto find and load the partition table
            on a specified location in flash partition.

    if !FAL_PART_HAS_TABLE_CFG

        config FAL_PART_TABLE_FLASH_DEV_NAME
            string "The flash device which saving partition table"
            default "onchip"
             help
                It will auto find the partition table on this flash device.

        config FAL_PART_TABLE_END_OFFSET
            int "The patition table end address relative to flash device offset."
            default 65536
            help
                The auto find and load the partition table process is forward from this
                offset address on flash.

    endif

    config FAL_USING_SFUD_PORT
        bool "FAL uses SFUD drivers"
        default n
        help
            The fal_flash_sfud_port.c in the samples\porting directory will be used.

    if FAL_USING_SFUD_PORT
        config FAL_USING_NOR_FLASH_DEV_NAME
            string "The name of the device used by FAL"
            default "norflash0"
    endif

    choice
        prompt "version"
        default PKG_USING_FAL_V00400
        help
            Select the version

        config PKG_USING_FAL_V00400
            bool "v0.4.0"

        config PKG_USING_FAL_V00300
            bool "v0.3.0"

        config PKG_USING_FAL_V00200
            bool "v0.2.0"

        config PKG_USING_FAL_V00100
            bool "v0.1.0"


        config PKG_USING_FAL_LATEST_VERSION
            bool "latest"
    endchoice

    config PKG_FAL_VER
       string
       default "latest"    if PKG_USING_FAL_LATEST_VERSION
       default "v0.4.0"    if PKG_USING_FAL_V00400
       default "v0.3.0"    if PKG_USING_FAL_V00300
       default "v0.2.0"    if PKG_USING_FAL_V00200
       default "v0.1.0"    if PKG_USING_FAL_V00100

    config PKG_FAL_VER_NUM
        hex
        default 0x99999    if PKG_USING_FAL_LATEST_VERSION
        default 0x00400    if PKG_USING_FAL_V00400 
        default 0x00300    if PKG_USING_FAL_V00300 
        default 0x00200    if PKG_USING_FAL_V00200
        default 0x00100    if PKG_USING_FAL_V00100

endif
```
