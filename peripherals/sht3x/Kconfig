## peripherals/tca9548a/Kconfig
```kconfig
# Kconfig file for package TCA9548A (PW548A)
menuconfig PKG_USING_TCA9548A
    bool "TCA9548A: Low Voltage 8-Channel I2C Switch with Reset (PW548A)"
    default n
    select RT_USING_I2C
    help
        The TCA9548A (chip marking: PW548A) is a low-voltage 8-channel I2C
        switch with reset from Texas Instruments. It features 1-to-8
        bidirectional translating switches controlled via I2C bus,
        allowing voltage-level translation between 1.8V, 2.5V, 3.3V,
        and 5V buses.

if PKG_USING_TCA9548A

    config PKG_TCA9548A_PATH
        string
        default "/packages/peripherals/tca9548a"

    config TCA9548A_USING_EXAMPLE
        bool "Enable TCA9548A example"
        default n
        help
            Enable the TCA9548A example code to demonstrate basic usage
            including device scanning, channel switching, and reset.

    menu "TCA9548A Device Configuration"

    config TCA9548A_DEV0_ENABLE
        bool "Device 0 - Enable"
        default y
        help
            Enable the first TCA9548A device.
            Each device can be on any I2C bus with any valid address.

    if TCA9548A_DEV0_ENABLE

        config TCA9548A_DEV0_BUS_NAME
            string "Device 0 - I2C bus name"
            default "i2c1"
            help
                The I2C bus device name this TCA9548A is connected to
                (e.g., "i2c1", "i2c0", "i2c2").

        config TCA9548A_DEV0_ADDR
            hex "Device 0 - I2C address (7-bit)"
            range 0x70 0x77
            default 0x70
            help
                The 7-bit I2C address of this TCA9548A device.
                Valid range: 0x70 - 0x77 (determined by A0, A1, A2 hardware pins).

        config TCA9548A_DEV0_NAME
            string "Device 0 - Device name"
            default "tca9548a_0"
            help
                A unique name for this TCA9548A device instance.
                Used to identify the device in the application code
                via tca9548a_find("tca9548a_0").

    endif

    config TCA9548A_DEV1_ENABLE
        bool "Device 1 - Enable"
        depends on TCA9548A_DEV0_ENABLE
        default n
        help
            Enable the second TCA9548A device.
            Only available when Device 0 is enabled.

    if TCA9548A_DEV1_ENABLE

        config TCA9548A_DEV1_BUS_NAME
            string "Device 1 - I2C bus name"
            default "i2c1"
            help
                The I2C bus device name this TCA9548A is connected to.

        config TCA9548A_DEV1_ADDR
            hex "Device 1 - I2C address (7-bit)"
            range 0x70 0x77
            default 0x70
            help
                The 7-bit I2C address of this TCA9548A device.

        config TCA9548A_DEV1_NAME
            string "Device 1 - Device name"
            default "tca9548a_1"
            help
                A unique name for this TCA9548A device instance.

    endif

    config TCA9548A_DEV2_ENABLE
        bool "Device 2 - Enable"
        depends on TCA9548A_DEV1_ENABLE
        default n
        help
            Enable the third TCA9548A device.
            Only available when Device 1 is enabled.

    if TCA9548A_DEV2_ENABLE

        config TCA9548A_DEV2_BUS_NAME
            string "Device 2 - I2C bus name"
            default "i2c1"
            help
                The I2C bus device name this TCA9548A is connected to.

        config TCA9548A_DEV2_ADDR
            hex "Device 2 - I2C address (7-bit)"
            range 0x70 0x77
            default 0x70
            help
                The 7-bit I2C address of this TCA9548A device.

        config TCA9548A_DEV2_NAME
            string "Device 2 - Device name"
            default "tca9548a_2"
            help
                A unique name for this TCA9548A device instance.

    endif

    config TCA9548A_DEV3_ENABLE
        bool "Device 3 - Enable"
        depends on TCA9548A_DEV2_ENABLE
        default n
        help
            Enable the fourth TCA9548A device.
            Only available when Device 2 is enabled.

    if TCA9548A_DEV3_ENABLE

        config TCA9548A_DEV3_BUS_NAME
            string "Device 3 - I2C bus name"
            default "i2c1"
            help
                The I2C bus device name this TCA9548A is connected to.

        config TCA9548A_DEV3_ADDR
            hex "Device 3 - I2C address (7-bit)"
            range 0x70 0x77
            default 0x70
            help
                The 7-bit I2C address of this TCA9548A device.

        config TCA9548A_DEV3_NAME
            string "Device 3 - Device name"
            default "tca9548a_3"
            help
                A unique name for this TCA9548A device instance.

    endif

    config TCA9548A_DEV4_ENABLE
        bool "Device 4 - Enable"
        depends on TCA9548A_DEV3_ENABLE
        default n
        help
            Enable the fifth TCA9548A device.
            Only available when Device 3 is enabled.

    if TCA9548A_DEV4_ENABLE

        config TCA9548A_DEV4_BUS_NAME
            string "Device 4 - I2C bus name"
            default "i2c1"
            help
                The I2C bus device name this TCA9548A is connected to.

        config TCA9548A_DEV4_ADDR
            hex "Device 4 - I2C address (7-bit)"
            range 0x70 0x77
            default 0x70
            help
                The 7-bit I2C address of this TCA9548A device.

        config TCA9548A_DEV4_NAME
            string "Device 4 - Device name"
            default "tca9548a_4"
            help
                A unique name for this TCA9548A device instance.

    endif

    config TCA9548A_DEV5_ENABLE
        bool "Device 5 - Enable"
        depends on TCA9548A_DEV4_ENABLE
        default n
        help
            Enable the sixth TCA9548A device.
            Only available when Device 4 is enabled.

    if TCA9548A_DEV5_ENABLE

        config TCA9548A_DEV5_BUS_NAME
            string "Device 5 - I2C bus name"
            default "i2c1"
            help
                The I2C bus device name this TCA9548A is connected to.

        config TCA9548A_DEV5_ADDR
            hex "Device 5 - I2C address (7-bit)"
            range 0x70 0x77
            default 0x70
            help
                The 7-bit I2C address of this TCA9548A device.

        config TCA9548A_DEV5_NAME
            string "Device 5 - Device name"
            default "tca9548a_5"
            help
                A unique name for this TCA9548A device instance.

    endif

    config TCA9548A_DEV6_ENABLE
        bool "Device 6 - Enable"
        depends on TCA9548A_DEV5_ENABLE
        default n
        help
            Enable the seventh TCA9548A device.
            Only available when Device 5 is enabled.

    if TCA9548A_DEV6_ENABLE

        config TCA9548A_DEV6_BUS_NAME
            string "Device 6 - I2C bus name"
            default "i2c1"
            help
                The I2C bus device name this TCA9548A is connected to.

        config TCA9548A_DEV6_ADDR
            hex "Device 6 - I2C address (7-bit)"
            range 0x70 0x77
            default 0x70
            help
                The 7-bit I2C address of this TCA9548A device.

        config TCA9548A_DEV6_NAME
            string "Device 6 - Device name"
            default "tca9548a_6"
            help
                A unique name for this TCA9548A device instance.

    endif

    config TCA9548A_DEV7_ENABLE
        bool "Device 7 - Enable"
        depends on TCA9548A_DEV6_ENABLE
        default n
        help
            Enable the eighth TCA9548A device.
            Only available when Device 6 is enabled.

    if TCA9548A_DEV7_ENABLE

        config TCA9548A_DEV7_BUS_NAME
            string "Device 7 - I2C bus name"
            default "i2c1"
            help
                The I2C bus device name this TCA9548A is connected to.

        config TCA9548A_DEV7_ADDR
            hex "Device 7 - I2C address (7-bit)"
            range 0x70 0x77
            default 0x70
            help
                The 7-bit I2C address of this TCA9548A device.

        config TCA9548A_DEV7_NAME
            string "Device 7 - Device name"
            default "tca9548a_7"
            help
                A unique name for this TCA9548A device instance.

    endif

    endmenu

    choice
        prompt "Version"
        default PKG_USING_TCA9548A_LATEST_VERSION
        help
            Select the package version

        config PKG_USING_TCA9548A_V100
            bool "v1.0.0"

        config PKG_USING_TCA9548A_LATEST_VERSION
            bool "latest"
    endchoice

    config PKG_TCA9548A_VER
        string
        default "v1.0.0"    if PKG_USING_TCA9548A_V100
        default "latest"     if PKG_USING_TCA9548A_LATEST_VERSION

endif
```

## peripherals/tm1668/Kconfig
```kconfig
# Kconfig file for package TM1668
menuconfig PKG_USING_TM1668
    bool "tm1668: led driver package based on 3 pin"
    default n
    help
        Select this option to use the TM1668 LED driver package.

if PKG_USING_TM1668
    config PKG_TM1668_PATH
        string
        default "/packages/peripherals/tm1668"

    choice
        prompt "Version"
        default PKG_USING_TM1668_LATEST_VERSION
        help
            Select the package version

    config PKG_USING_TM1668_V100
        bool "v1.0.0"

    config PKG_USING_TM1668_LATEST_VERSION
        bool "latest"
endchoice

    config PKG_TM1668_VER
       string
       default "v1.0.0" if PKG_USING_TM1668_V100
       default "latest" if PKG_USING_TM1668_LATEST_VERSION

    config TM1668_STB_PIN_NAME
        string "TM1668 STB pin name"
        default "PB.12"
        help
            Pin name for TM1668 STB (NianDong Board PB.12).

    config TM1668_CLK_PIN_NAME
        string "TM1668 CLK pin name"
        default "PE.12"
        help
            Pin name for TM1668 CLK (NianDong Board PE.12).

    config TM1668_DIO_PIN_NAME
        string "TM1668 DIO pin name"
        default "PB.10"
        help
            Pin name for TM1668 DIO (NianDong Board PB.10).

    config USING_TM1668_DEMO
        bool "Enable TM1668 Demo (example folder)"
        default n
        help
            Enable this option to compile the example code in the "example" folder. 
endif
```

## peripherals/tmc51xx/Kconfig
```kconfig
# Kconfig file for package tmc51xx
menuconfig PKG_USING_TMC51XX
    bool "tmc51xx power driver for stepper motors."
    default n

if PKG_USING_TMC51XX

    config PKG_TMC51XX_PATH
        string
        default "/packages/peripherals/tmc51xx"

    choice
        prompt "Version"
        default PKG_USING_TMC51XX_LATEST_VERSION
        help
            Select the package version

        config PKG_USING_TMC51XX_V100
            bool "v1.0.0"

        config PKG_USING_TMC51XX_LATEST_VERSION
            bool "latest"
    endchoice

    config PKG_TMC51XX_VER
       string
       default "v1.0.0"    if PKG_USING_TMC51XX_V100
       default "latest"    if PKG_USING_TMC51XX_LATEST_VERSION

endif
```

## peripherals/touch/Kconfig
```kconfig
menu "touch drivers"

rsource "gt9147/Kconfig"
rsource "gt1151/Kconfig"
rsource "gt917s/Kconfig"
rsource "gt911/Kconfig"
rsource "ft6206/Kconfig"
rsource "ft5426/Kconfig"
rsource "ft6236/Kconfig"
rsource "xpt2046/Kconfig"
rsource "cst816x/Kconfig"
rsource "cst812t/Kconfig"

endmenu
```

## peripherals/touch/cst812t/Kconfig
```kconfig
# Kconfig file for package cst812t
menuconfig PKG_USING_CST812T
    bool "cst812t touch ic for RT-Thread's TrackPad"
    select RT_USING_I2C
    select RT_USING_TOUCH
    default n

if PKG_USING_CST812T

    config PKG_CST812T_PATH
        string
        default "/packages/peripherals/touch/cst812t"

    config PKG_USING_CST812T_EXAMPLE
        bool "Use example demo touch data reading"
        default n

    choice
        prompt "Version"
        help
            Select the package version

        config PKG_USING_CST812T_LATEST_VERSION
            bool "latest"
    endchoice

    config PKG_CST812T_VER
       string
       default "latest"    if PKG_USING_CST812T_LATEST_VERSION

endif
```

## peripherals/touch/cst816x/Kconfig
```kconfig
# Kconfig file for package cst816x
menuconfig PKG_USING_CST816X
    bool "CST816X touch driver package."
    default n

if PKG_USING_CST816X

    config PKG_CST816X_PATH
        string
        default "/packages/peripherals/touch/cst816x"

    choice
        prompt "Version"
        help
            Select the package version

        config PKG_USING_CST816X_LATEST_VERSION
            bool "latest"
    endchoice

    config PKG_CST816X_VER
       string
       default "latest"    if PKG_USING_CST816X_LATEST_VERSION

endif
```

## peripherals/touch/ft3x07/Kconfig
```kconfig
# Kconfig file for package ft3x07
menuconfig PKG_USING_FT3X07
    bool "FT3X07 touch chip software package."
    default n

if PKG_USING_FT3X07

    config PKG_FT3X07_PATH
        string
        default "/packages/peripherals/touch/ft3x07"

    choice
        prompt "Version"
        default PKG_USING_FT3X07_LATEST_VERSION
        help
            Select the package version

        config PKG_USING_FT3X07_LATEST_VERSION
            bool "latest"
    endchoice
          
    config PKG_FT3X07_VER
       string
       default "latest"    if PKG_USING_FT3X07_LATEST_VERSION

endif
```

## peripherals/touch/ft5426/Kconfig
```kconfig
# Kconfig file for package ft5426
menuconfig PKG_USING_FT5426
    bool "FT5426 touch driver package."
    default n

if PKG_USING_FT5426

    config PKG_FT5426_PATH
        string
        default "/packages/peripherals/touch/ft5426"

    config PKG_USING_FT5426_SAMPLE
    bool "enable samples"
    default n

    choice
        prompt "Version"
        default PKG_USING_FT5426_LATEST_VERSION
        help
            Select the package version

        config PKG_USING_FT5426_LATEST_VERSION
            bool "latest"
    endchoice

    config PKG_FT5426_VER
       string
       default "v0.0.1"    if PKG_USING_FT5426_V001
       default "latest"    if PKG_USING_FT5426_LATEST_VERSION

endif
```

## peripherals/touch/ft6206/Kconfig
```kconfig
# Kconfig file for package ft6206
menuconfig PKG_USING_FT6206
    bool "FT6206 touch driver package."
    default n

if PKG_USING_FT6206

    config PKG_FT6206_PATH
        string
        default "/packages/peripherals/touch/ft6206"

    choice
        prompt "Version"
        default PKG_USING_FT6206_LATEST_VERSION
        help
            Select the package version

        config PKG_USING_FT6206_LATEST_VERSION
            bool "latest"
    endchoice
          
    config PKG_FT6206_VER
       string
       default "v1.0.0"    if PKG_USING_FT6206_V100
       default "latest"    if PKG_USING_FT6206_LATEST_VERSION

endif
```

## peripherals/touch/ft6236/Kconfig
```kconfig
# Kconfig file for package ft6236
menuconfig PKG_USING_FT6236
    bool "FT6236 touch driver package."
    default n

if PKG_USING_FT6236

    config PKG_FT6236_PATH
        string
        default "/packages/peripherals/touch/ft6236"

    config PKG_USING_FT6236_SAMPLE
    bool "enable samples"
    default n

    choice
        prompt "Version"
        help
            Select the package version

        config PKG_USING_FT6236_LATEST_VERSION
            bool "latest"

        config PKG_USING_FT6236_V100
            bool "v1.0.0"
    endchoice

    config PKG_FT6236_VER
       string
       default "v1.0.0"    if PKG_USING_FT6236_V100
       default "latest"    if PKG_USING_FT6236_LATEST_VERSION

endif
```
