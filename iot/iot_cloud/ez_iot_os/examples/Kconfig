## iot/iot_cloud/joylink/Kconfig
```kconfig
# Kconfig file for package joylink
menuconfig PKG_USING_JOYLINK
    bool "Joylink Cloud SDK for IoT platform"
    default n
    select PKG_USING_CJSON
    select PKG_USING_EASYFLASH
    select RT_USING_RTC

if PKG_USING_JOYLINK

    config PKG_JOYLINK_PATH
        string
        default "/packages/iot/iot_cloud/joylink"

    choice
        prompt "your chip model"
        default WM_W60X_A8xx
        help
            the type of chip what you are using
        config WM_W60X_A8xx
            bool "WinnerMicro"
        config JOYLINK_OTHER
            bool "other chip"
    endchoice

    if WM_W60X_A8xx
        config JOYLINK_USING_OTA
            bool "Enable OTA update feature"
            default n

        config JOYLINK_USING_NETCONFIG
            bool "Enable network configure feature"
            default n

        if JOYLINK_USING_NETCONFIG

            config JOYLINK_USING_THUNDER_SLAVE
                bool "Enable thunderconfig mode"
                default n

            config JOYLINK_USING_SOFTAP
                bool "Enable softap mode"
                default n

            if JOYLINK_USING_SOFTAP
                config JOYLINK_SOFTAP_SSID
                    string "Softap ssid name"
                    default "ssid_test"
            endif

        endif

        choice
            prompt "Output LOG level"
            default JOYLINK_OUTPUT_LEVEL_DEBUG
            help
                select the log level

            config JOYLINK_OUTPUT_LEVEL_DEBUG
                bool "DEBUG"

            config JOYLINK_OUTPUT_LEVEL_WARN
                bool "WARN"

            config JOYLINK_OUTPUT_LEVEL_ERROR
                bool "ERROR"

            config JOYLINK_OUTPUT_LEVEL_INFO
                bool "INFO"

            config JOYLINK_OUTPUT_LEVEL_NOTICE
                bool "NOTICE"

            config JOYLINK_OUTPUT_LEVEL_FATAL
                bool "FATAL"
        endchoice

        choice

            prompt "Sample product type"
            default JOYLINK_USING_SAMPLES_HEATER
            help
                select the type of product

            config JOYLINK_USING_SAMPLES_BAND
                bool "Wristband"

            config JOYLINK_USING_SAMPLES_HEATER
                bool "Heater"

        endchoice

        if JOYLINK_USING_SAMPLES_BAND || JOYLINK_USING_SAMPLES_HEATER

            config JOYLINK_USING_AUTO_INIT
                bool "Enable automatic initialize"
                default n

            config JOYLINK_SAMPLE_UUID
                string "Device uuid"
                default "012345"

            config JOYLINK_SAMPLE_PUB_KEY
                string "Device public key"
                default "0123456789"

            config JOYLINK_SAMPLE_PRIVATE_KEY
                string "Device private key"
                default "0123456789"

        endif

        choice
            prompt "Version"
            default PKG_USING_JOYLINK_V02001901
            help
                Select the package version

            config PKG_USING_JOYLINK_V02001901
                bool "v2.0.19.0"

            config PKG_USING_JOYLINK_LATEST_VERSION
                bool "latest"
        endchoice

        config PKG_JOYLINK_VER
        string
        default "v2.0.19.1"    if PKG_USING_JOYLINK_V02001901
        default "latest"       if PKG_USING_JOYLINK_LATEST_VERSION
    endif

endif
```

## iot/iot_cloud/onenet/Kconfig
```kconfig
# Kconfig file for package onenet
menuconfig PKG_USING_ONENET
    bool "OneNET: China Mobile OneNet cloud SDK for RT-Thread"
    default n
    select PKG_USING_CJSON

if PKG_USING_ONENET

    config PKG_ONENET_PATH
        string
        default "/packages/iot/iot_cloud/onenet"

    config PKG_USING_ONENET_SAMPLE
        bool "Enable OneNET sample"
        default n

    config ONENET_USING_MQTT
        bool "Enable support MQTT protocol"
        default y
        select PKG_USING_PAHOMQTT

    config ONENET_USING_HTTP
        bool "Enable support HTTP protocol"
        default n
        select PKG_USING_WEBCLIENT

    if ONENET_USING_HTTP
        config ONENET_USING_AUTO_REGISTER
            bool "Enable OneNET automatic register device"
            default n
            help
                Enable automatic registration device functions, don't need to register on the web page
    endif

    if ONENET_USING_MQTT
        if PKG_USING_ONENET_V010
            config ONENET_MQTT_SUBTOPIC
                string "mqtt subtopic"
                default "/test_topic"
        endif
    endif

    if ONENET_USING_AUTO_REGISTER
        config ONENET_REGISTRATION_CODE
            string "registration code"
            default "17eu2xb5k1GtbdY5"
            help
                product registration code

    endif

    if !ONENET_USING_AUTO_REGISTER
        config ONENET_INFO_DEVID
            string "device id"
            default "29573339"
            help
                product device id

        config ONENET_INFO_AUTH
            string "auth info"
            default "EF4016D6658466CA3E3606"
            help
                product authentication info

    endif

    config ONENET_INFO_PROID
        string "product id"
        default "131494"

    choice
        prompt "version"
        help
            Select the onenet version

        config PKG_USING_ONENET_LATEST_VERSION
            bool "latest"

        config PKG_USING_ONENET_V120
            bool "v1.2.0"

        config PKG_USING_ONENET_V100
            bool "v1.0.0"

    endchoice

    config PKG_ONENET_VER
       string
       default "v1.2.0"    if PKG_USING_ONENET_V120
       default "v1.0.0"    if PKG_USING_ONENET_V100
       default "latest"    if PKG_USING_ONENET_LATEST_VERSION

endif
```

## iot/iot_cloud/tencent-iot-sdk/Kconfig
```kconfig
# Kconfig file for package tencent-iot-sdk
menuconfig PKG_USING_TENCENT_IOT_EXPLORER
    bool "tencent-iot-sdk:  Tencent Cloud IoT Explorer Platform SDK for RT-Thread"
    select RT_USING_SAL             if RT_VER_NUM < 0x40100
    select SAL_USING_POSIX          if RT_VER_NUM < 0x40100
    select RT_USING_POSIX_FS        if RT_VER_NUM >= 0x40100
    select RT_USING_POSIX_SOCKET    if RT_VER_NUM >= 0x40100
    default n

if PKG_USING_TENCENT_IOT_EXPLORER

    config PKG_TENCENT_IOT_EXPLORER_PATH
        string
        default "/packages/iot/iot_cloud/tencent-iot-sdk"

    config PKG_USING_TENCENT_IOT_EXPLORER_PRODUCT_ID
        string "Config Product Id"
        default 0WUKPUCOTC

    config PKG_USING_TENCENT_IOT_EXPLORER_DEVICE_NAME
        string "Config Device Name"
        default "dev001"

    config PKG_USING_TENCENT_IOT_EXPLORER_DEVICE_SECRET
        string "Config Device Secret"
        default "N6B8M91PB4YDTRCpqvOp4w=="

    config PKG_USING_DYN_REG
        bool "Enable dynamic register"
        default n

    if PKG_USING_DYN_REG
        config PKG_USING_TENCENT_IOT_EXPLORER_PRODUCT_SECRET
            string "Config Product Key"
            default ""
            help
                dynamic register device needed othterwise null
    endif

    config PKG_USING_LOG_UPLOAD
        bool "Enable err log upload"
        default n

    config PKG_USING_MULTITHREAD_ENABLED
        bool "Enable multi thread function"
        default n

    config PKG_USING_TENCENT_IOT_EXPLORER_TLS
        bool "Enable TLS/DTLS"
        default n
        select PKG_USING_MBEDTLS

    choice
        prompt "Select Product Type"
        help
            Select product communication protocol

        config PKG_USING_DATA_TEMPLATE_PROTOCOL
            bool "Data template protocol"
            help
                Use data template protocol

        config PKG_USING_SELF_DEFINE_PROTOCOL
            bool "self-define protocol"
            help
                Use self-define protocol
    endchoice

    if PKG_USING_DATA_TEMPLATE_PROTOCOL
        config PKG_USING_EVENT_POST
            bool "Enable Event"
            default n

        config PKG_USING_ACTION
            bool "Enable Action"
            default n

        config PKG_USING_SMART_LIGHT_SAMPLE
            bool "Enable Smart_light Sample"
            default y
    endif

    if PKG_USING_SELF_DEFINE_PROTOCOL
        config PKG_USING_TENCENT_IOT_EXPLORER_MQTT
            bool "Enable MQTT Sample"
            default y

        config PKG_USING_TENCENT_IOT_EXPLORER_RAW_DATA
            bool "Enable RAW_DATA SAMPLE"
            default n
    endif

    config PKG_USING_TENCENT_IOT_EXPLORER_OTA
        bool "Enable OTA"
        default n

    if PKG_USING_TENCENT_IOT_EXPLORER_OTA
        choice
            prompt "Config OTA download by https or http"
            help
               Select download channel
            config PKG_USING_OTA_HTTP
                bool "Download by http"
            config PKG_USING_OTA_HTTPS
                bool "Download by https"
                select PKG_USING_TENCENT_IOT_EXPLORER_TLS
        endchoice
    endif

    config PKG_USING_TENCENT_IOT_EXPLORER_GATEWAY
        bool "Enable GateWay"
        default n

    choice
        prompt "Version"
        default PKG_USING_TENCENT_IOT_EXPLORER_LATEST_VERSION
        help
            Select the tencent-iot-explorer version

        config PKG_USING_TENCENT_IOT_EXPLORER_LATEST_VERSION
            bool "latest"

        config PKG_USING_TENCENT_IOT_EXPLORER_V300
            bool "v3.0.0"

        config PKG_USING_TENCENT_IOT_EXPLORER_V302
            bool "v3.0.2"

        config PKG_USING_TENCENT_IOT_EXPLORER_V313
            bool "v3.1.3"

    endchoice

    config PKG_TENCENT_IOT_EXPLORER_VER
       string
       default "v3.1.3"    if PKG_USING_TENCENT_IOT_EXPLORER_V313
       default "v3.0.2"    if PKG_USING_TENCENT_IOT_EXPLORER_V302
       default "v3.0.0"    if PKG_USING_TENCENT_IOT_EXPLORER_V300
       default "latest"    if PKG_USING_TENCENT_IOT_EXPLORER_LATEST_VERSION

endif
```

## iot/iot_cloud/tencent-iothub/Kconfig
```kconfig
menuconfig PKG_USING_TENCENT_IOTHUB
    bool "tencent-iothub:  Tencent Cloud SDK for IoT platform"
    select RT_USING_SAL
    select SAL_USING_POSIX
    default n

if PKG_USING_TENCENT_IOTHUB

    config PKG_TENCENT_IOTHUB_PATH
        string
        default "/packages/iot/iot_cloud/tencent-iothub"
        
    choice
        prompt "Select Tencent IOT platform"
        help
            Select Tencent iot platform
            
        config PKG_USING_IOT_HUB_PLATFORM
            bool "Iot_hub platform"
            help
                Use Iot-hub platform
            
        config PKG_USING_IOT_EXPLORER_PLATFORM
            bool "Iot_explorer platform"
            help
                Use Iot_explorer platform
    endchoice   
        
    config PKG_USING_TENCENT_IOTHUB_PRODUCT_ID
        string "Config Product Id"
        default 03UKNYBUZG      

    config PKG_USING_TENCENT_IOTHUB_DEVICE_NAME
        string "Config Device Name"
        default general_sdev1        

    config PKG_USING_TENCENT_IOTHUB_DEVICE_SECRET
        string "Config Device Secret"
        default "VI04Eh4N8VgM29U/dnu9cQ=="
        
    config PKG_USING_TENCENT_IOTHUB_DYNREG
        bool "Enable dynamic register"
        default n

    if PKG_USING_TENCENT_IOTHUB_DYNREG  
        config PKG_USING_TENCENT_IOTHUB_PRODUCT_KEY
            string "Config Product Key"
            default ""
            help
                dynamic register device needed othterwise null  
    endif
    
    config PKG_USING_TENCENT_IOTHUB_LOG_UPLOAD
        bool "Enable err log upload"
        default n
    
    config PKG_USING_TENCENT_IOTHUB_TLS
        bool "Enable TLS/DTLS"
        default n
        select PKG_USING_MBEDTLS
    
    if PKG_USING_IOT_HUB_PLATFORM   
        config PKG_USING_TENCENT_IOTHUB_MQTT
            bool "Enable MQTT"
            default n
                    
        if PKG_USING_TENCENT_IOTHUB_MQTT
            choice
                prompt "Enable shadow"
                help
                    Enable shadow protocol or not
                    
                config PKG_USING_TENCENT_IOTHUB_MQTT_BASIC
                    bool "ONLY MQTT"
                    
                config PKG_USING_TENCENT_IOTHUB_SHADOW
                    bool "USE SHADOW"

            endchoice   
        endif

        config PKG_USING_TENCENT_IOTHUB_COAP
            bool "Enable COAP"
            default n
            select PKG_USING_TENCENT_IOTHUB_TLS
            
        
        config PKG_USING_TENCENT_IOTHUB_SCENARIOS
            bool "Enable SCENARIOS"
            default n

        if PKG_USING_TENCENT_IOTHUB_SCENARIOS              
            choice  
                prompt "Select SCENARIOS"
                help
                   Select SCENARIOS
                config PKG_USING_TENCENT_IOTHUB_DOOR_MQTT
                    bool "Use Scenario door mqtt"
                    select PKG_USING_TENCENT_IOTHUB_MQTT
                  
                config PKG_USING_TENCENT_IOTHUB_DOOR_COAP
                    bool "Use Scenario door coap"
                    select PKG_USING_TENCENT_IOTHUB_COAP                    
                    
                config PKG_USING_TENCENT_IOTHUB_AIRCON_SHADOW
                    bool "Use Scenario aircon shadow"
                    select PKG_USING_TENCENT_IOTHUB_MQTT
                    select PKG_USING_TENCENT_IOTHUB_SHADOW
                                        
            endchoice
        endif       
    endif   
    
    if PKG_USING_IOT_EXPLORER_PLATFORM  
        config PKG_USING_TENCENT_IOTEXPLORER_DATA_TEMPLATE
            bool "Enable data template"
            default n
                    
        if PKG_USING_TENCENT_IOTEXPLORER_DATA_TEMPLATE
            choice
                prompt "Enable event"
                help
                    Enable event report or not

                config PKG_USING_EVENT
                    bool "USE event"    
                    
                config PKG_USING_NO_EVENT
                    bool "ONLY data template"
                    
            endchoice   
        endif


        
        config PKG_USING_TENCENT_IOTHUB_SCENARIOS
            bool "Enable SCENARIOS"
            default n

        if PKG_USING_TENCENT_IOTHUB_SCENARIOS              
            choice  
                prompt "Select SCENARIOS"
                help
                   Select SCENARIOS
                config PKG_USING_TENCENT_IOTEXPLORER_DATA_TEMPLATE_LIGHT
                    bool "Use Scenario light data template"
                    select PKG_USING_TENCENT_IOTEXPLORER_DATA_TEMPLATE
                  
            endchoice
        endif       
    endif
    

    choice
        prompt "Version"
        default PKG_USING_TENCENT_IOTHUB_LATEST_VERSION
        help
            Select the tencent-iotkit-hub version

        config PKG_USING_TENCENT_IOTHUB_LATEST_VERSION
            bool "latest"
        
        config PKG_USING_TENCENT_IOTHUB_V300
            bool "v3.0.0"   
        config PKG_USING_TENCENT_IOTHUB_V302
            bool "v3.0.2"       
            
    endchoice

    config PKG_TENCENT_IOTHUB_VER
       string
       default "v3.0.2"    if PKG_USING_TENCENT_IOTHUB_V302
       default "v3.0.0"    if PKG_USING_TENCENT_IOTHUB_V300
       default "latest"    if PKG_USING_TENCENT_IOTHUB_LATEST_VERSION
    
endif
```
