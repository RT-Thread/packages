## iot/airkissOpen/Kconfig
```kconfig
# Kconfig file for package airkissOpen
menuconfig PKG_USING_AIRKISS_OPEN
    bool "airkissOpen: Tencent Airkiss Protocol parse library"
    default n
    select RT_USING_LWIP
    select RT_USING_WIFI

if PKG_USING_AIRKISS_OPEN

    config PKG_AIRKISS_OPEN_PATH
        string
        default "/packages/iot/airkissOpen"

    config AIRKISS_OPEN_DEMO_ENABLE
        bool "Enable airkiss demo"
        default y

    choice
        prompt "Version"
        default PKG_USING_AKO_Vlast
        help
            Select the package version

        config PKG_USING_AKO_V100
            bool "v1.0.0"

        config PKG_USING_AKO_Vlast
            bool "latest"
    endchoice

    config PKG_AIRKISS_OPEN_VER
       string
       default "v1.0.0"    if PKG_USING_AKO_V100
       default "latest"    if PKG_USING_AKO_Vlast

endif
```

## iot/at_device/Kconfig
```kconfig
# AT device configuretion
menuconfig PKG_USING_AT_DEVICE
    bool "AT DEVICE: RT-Thread AT component porting or samples for different device"
    default n
    select RT_USING_AT
    select AT_USING_CLIENT
    select AT_USING_SOCKET

if PKG_USING_AT_DEVICE

    config PKG_AT_DEVICE_PATH
        string
        default "/packages/iot/at_device"

    if PKG_AT_DEVICE_VER_NUM >= 0x20000

        source "$PKGS_DIR/packages/iot/at_device/m26/Kconfig"
        source "$PKGS_DIR/packages/iot/at_device/ec20/Kconfig"
        source "$PKGS_DIR/packages/iot/at_device/esp32/Kconfig"
        source "$PKGS_DIR/packages/iot/at_device/esp8266/Kconfig"
        source "$PKGS_DIR/packages/iot/at_device/rw007/Kconfig"
        source "$PKGS_DIR/packages/iot/at_device/sim800c/Kconfig"
        source "$PKGS_DIR/packages/iot/at_device/sim76xx/Kconfig"
        source "$PKGS_DIR/packages/iot/at_device/mw31/Kconfig"
        source "$PKGS_DIR/packages/iot/at_device/w60x/Kconfig"
        source "$PKGS_DIR/packages/iot/at_device/a9g/Kconfig"
        source "$PKGS_DIR/packages/iot/at_device/bc26/Kconfig"
        source "$PKGS_DIR/packages/iot/at_device/air720/Kconfig"
        source "$PKGS_DIR/packages/iot/at_device/me3616/Kconfig"
        source "$PKGS_DIR/packages/iot/at_device/m6315/Kconfig"        

    endif

    if PKG_AT_DEVICE_VER_NUM < 0x20000

        source "$PKGS_DIR/packages/iot/at_device/v1.x.x/Kconfig"

    endif

    choice

        prompt "Version"
        default PKG_USING_AT_DEVICE_V202 if (AT_SW_VERSION_NUM = 0x10300)
        # compare RT_VER_NUM for netdev component
        default PKG_USING_AT_DEVICE_V160 if (RT_VER_NUM = 0x30103 || RT_VER_NUM = 0x40001 || (RT_VER_NUM > 0x40001 && AT_SW_VERSION_NUM = 0x10200))
        default PKG_USING_AT_DEVICE_V150 if (AT_SW_VERSION_NUM = 0x10200)
        default PKG_USING_AT_DEVICE_V130 if (AT_SW_VERSION_NUM = 0x10100)
        default PKG_USING_AT_DEVICE_V120 if (AT_SW_VERSION_NUM < 0x10100 && AT_SW_VERSION_NUM >= 0x10000)
        default PKG_USING_AT_DEVICE_LATEST_VERSION
        help
            Select the at_device version

        if (AT_SW_VERSION_NUM = 0x10300)

            config PKG_USING_AT_DEVICE_V202
                bool "v2.0.2"

            config PKG_USING_AT_DEVICE_V201
                bool "v2.0.1"

            config PKG_USING_AT_DEVICE_V200
                bool "v2.0.0"

        endif

        if (RT_VER_NUM = 0x30103 || RT_VER_NUM = 0x40001 || (RT_VER_NUM > 0x40001 && AT_SW_VERSION_NUM = 0x10200))

            config PKG_USING_AT_DEVICE_V160
                bool "v1.6.0"

        endif

        if AT_SW_VERSION_NUM = 0x10200
            config PKG_USING_AT_DEVICE_V150
                bool "v1.5.0"

            config PKG_USING_AT_DEVICE_V140
                bool "v1.4.0"
        endif

        if AT_SW_VERSION_NUM = 0x10100
            config PKG_USING_AT_DEVICE_V130
                bool "v1.3.0"
        endif

        # AT command component version from v1.0.0 to v1.1.0 or at version not definition
        if (AT_SW_VERSION_NUM < 0x10100 && AT_SW_VERSION_NUM >= 0x10000)
            config PKG_USING_AT_DEVICE_V120
                bool "v1.2.0"
        endif

        config PKG_USING_AT_DEVICE_LATEST_VERSION
            bool "latest"

    endchoice

    config PKG_AT_DEVICE_VER
        string
        default "latest"    if PKG_USING_AT_DEVICE_LATEST_VERSION
        default "v2.0.2"    if PKG_USING_AT_DEVICE_V202
        default "v2.0.1"    if PKG_USING_AT_DEVICE_V201
        default "v2.0.0"    if PKG_USING_AT_DEVICE_V200
        default "v1.6.0"    if PKG_USING_AT_DEVICE_V160
        default "v1.5.0"    if PKG_USING_AT_DEVICE_V150
        default "v1.4.0"    if PKG_USING_AT_DEVICE_V140
        default "v1.3.0"    if PKG_USING_AT_DEVICE_V130
        default "v1.2.0"    if PKG_USING_AT_DEVICE_V120

    config PKG_AT_DEVICE_VER_NUM
        hex
        default 0x99999    if PKG_USING_AT_DEVICE_LATEST_VERSION
        default 0x20002    if PKG_USING_AT_DEVICE_V202
        default 0x20001    if PKG_USING_AT_DEVICE_V201
        default 0x20000    if PKG_USING_AT_DEVICE_V200
        default 0x10600    if PKG_USING_AT_DEVICE_V160
        default 0x10500    if PKG_USING_AT_DEVICE_V150
        default 0x10400    if PKG_USING_AT_DEVICE_V140
        default 0x10300    if PKG_USING_AT_DEVICE_V130
        default 0x10200    if PKG_USING_AT_DEVICE_V120

endif
```

## iot/at_device/a9g/Kconfig
```kconfig
# A9G AT device configuration
menuconfig AT_DEVICE_USING_A9G
    bool "Ai-Think A9G"
    default n

if AT_DEVICE_USING_A9G

    config AT_DEVICE_A9G_INIT_ASYN
        bool "Enable initialize by thread"
        default n

    config AT_DEVICE_A9G_SAMPLE
        bool "Enable sample"
        default y

    if AT_DEVICE_A9G_SAMPLE

       config A9G_SAMPLE_POWER_PIN
            int "Power pin"
            default -1

        config A9G_SAMPLE_STATUS_PIN
            int "Power status pin"
            default -1

        config A9G_SAMPLE_CLIENT_NAME
            string "AT client device name"
            default "uart3"

        config A9G_SAMPLE_RECV_BUFF_LEN
            int "The maximum length of receive line buffer"
            default 512

    endif

endif
```

## iot/at_device/air720/Kconfig
```kconfig
# Air720 AT device configuration
menuconfig AT_DEVICE_USING_AIR720
    bool "luat Air720"
    default n

if AT_DEVICE_USING_AIR720

    config AT_DEVICE_AIR720_INIT_ASYN
        bool "Enable initialize by thread"
        default n

    config AT_DEVICE_AIR720_SAMPLE
        bool "Enable sample"
        default y

    if AT_DEVICE_AIR720_SAMPLE

       config AIR720_SAMPLE_POWER_PIN
            int "Power pin"
            default -1

        config AIR720_SAMPLE_STATUS_PIN
            int "Power status pin"
            default -1

        config AIR720_SAMPLE_CLIENT_NAME
            string "AT client device name"
            default "uart3"

        config AIR720_SAMPLE_RECV_BUFF_LEN
            int "The maximum length of receive line buffer"
            default 512

    endif

endif
```

## iot/at_device/bc26/Kconfig
```kconfig
# BC26 AT device configuration
menuconfig AT_DEVICE_USING_BC26
    bool "Quectel BC26"
    default n

if AT_DEVICE_USING_BC26

    config AT_DEVICE_BC26_INIT_ASYN
        bool "Enable initialize by thread"
        default n

    config AT_DEVICE_BC26_SAMPLE
        bool "Enable sample"
        default y

    if AT_DEVICE_BC26_SAMPLE

        config BC26_SAMPLE_POWER_PIN
            int "Power pin"
            default -1

        config BC26_SAMPLE_STATUS_PIN
            int "Power status pin"
            default -1

        config BC26_SAMPLE_CLIENT_NAME
            string "AT client device name"
            default "uart2"

        config BC26_SAMPLE_RECV_BUFF_LEN
            int "The maximum length of receive line buffer"
            default 512

    endif

endif
```

## iot/at_device/bc28/Kconfig
```kconfig
# BC28 AT device configuration
menuconfig AT_DEVICE_USING_BC28
    bool "Quectel BC28"
    default n

if AT_DEVICE_USING_BC28

    choice
        prompt "Select operating band"
        default AT_DEVICE_BC28_OP_BAND_8

        config AT_DEVICE_BC28_OP_BAND_1
            bool "B1 @H-FDD: 2100MHz"

        config AT_DEVICE_BC28_OP_BAND_3
            bool "B3 @H-FDD: 1800MHz"

        config AT_DEVICE_BC28_OP_BAND_5
            bool "B5 @H-FDD: 850MHz"

        config AT_DEVICE_BC28_OP_BAND_8
            bool "B8 @H-FDD: 900MHz"

        config AT_DEVICE_BC28_OP_BAND_20
            bool "B20 @H-FDD: 800MHz"

        config AT_DEVICE_BC28_OP_BAND_28
            bool "B28 @H-FDD: 700MHz"
    endchoice

    config AT_DEVICE_BC28_OP_BAND
       int
       default 1     if AT_DEVICE_BC28_OP_BAND_1
       default 3     if AT_DEVICE_BC28_OP_BAND_3
       default 5     if AT_DEVICE_BC28_OP_BAND_5
       default 8     if AT_DEVICE_BC28_OP_BAND_8
       default 20    if AT_DEVICE_BC28_OP_BAND_20
       default 28    if AT_DEVICE_BC28_OP_BAND_28

    config AT_DEVICE_BC28_INIT_ASYN
        bool "Enable initialize by thread"
        default n

    config AT_DEVICE_BC28_SAMPLE
        bool "Enable sample"
        default y

    if AT_DEVICE_BC28_SAMPLE

        config BC28_SAMPLE_POWER_PIN
            int "Power pin (Reset)"
            default -1

        config BC28_SAMPLE_STATUS_PIN
            int "Power status pin"
            default -1

        config BC28_SAMPLE_CLIENT_NAME
            string "AT client device name"
            default "uart3"

        config BC28_SAMPLE_RECV_BUFF_LEN
            int "The maximum length of receive line buffer"
            default 512

        config BC28_SAMPLE_MIN_SOCKET
            int "The minimum available socket id"
            default 0

        choice
            prompt "Select baud rate"
            default BC28_SAMPLE_BAUD_RATE_9600

            config BC28_SAMPLE_BAUD_RATE_4800
                bool "4800"

            config BC28_SAMPLE_BAUD_RATE_9600
                bool "9600"

            config BC28_SAMPLE_BAUD_RATE_115200
                bool "115200"
        endchoice

        config BC28_SAMPLE_BAUD_RATE
            int
            default 4800      if BC28_SAMPLE_BAUD_RATE_4800
            default 9600      if BC28_SAMPLE_BAUD_RATE_9600
            default 115200    if BC28_SAMPLE_BAUD_RATE_115200

    endif

endif
```

## iot/at_device/ec20/Kconfig
```kconfig
# EC20 AT device configuration
menuconfig AT_DEVICE_USING_EC20
    bool "Quectel EC20"
    default n

if AT_DEVICE_USING_EC20

    config AT_DEVICE_EC20_INIT_ASYN
        bool "Enable initialize by thread"
        default n

    config AT_DEVICE_EC20_SAMPLE
        bool "Enable sample"
        default y

    if AT_DEVICE_EC20_SAMPLE

        config EC20_SAMPLE_POWER_PIN
            int "Power pin"
            default -1

        config EC20_SAMPLE_STATUS_PIN
            int "Power status pin"
            default -1

        config EC20_SAMPLE_CLIENT_NAME
            string "AT client device name"
            default "uart2"

        config EC20_SAMPLE_RECV_BUFF_LEN
            int "The maximum length of receive line buffer"
            default 512

    endif

endif
```

## iot/at_device/ec200x/Kconfig
```kconfig
# EC200T/EC200S AT device configuration
menuconfig AT_DEVICE_USING_EC200X
    bool "Quectel EC200T/EC200S"
    default n

if AT_DEVICE_USING_EC200X

    config AT_DEVICE_EC200X_INIT_ASYN
        bool "Enable initialize by thread"
        default n

    config AT_DEVICE_EC200X_SAMPLE
        bool "Enable sample"
        default y

    if AT_DEVICE_EC200X_SAMPLE

        config EC200X_SAMPLE_POWER_PIN
            int "Power pin"
            default -1

        config EC200X_SAMPLE_STATUS_PIN
            int "Power status pin"
            default -1

        config EC200X_SAMPLE_WAKEUP_PIN
            int "Wakeup pin"
            default -1
            
        config EC200X_SAMPLE_CLIENT_NAME
            string "AT client device name"
            default "uart2"

        config EC200X_SAMPLE_RECV_BUFF_LEN
            int "The maximum length of receive line buffer"
            default 512

    endif

endif
```

## iot/at_device/esp32/Kconfig
```kconfig
# ESP32 AT device configuration
menuconfig AT_DEVICE_USING_ESP32
    bool "Espressif ESP32"
    default n

if AT_DEVICE_USING_ESP32

    config AT_DEVICE_ESP32_INIT_ASYN
        bool "Enable initialize by thread"
        default n

    config AT_DEVICE_ESP32_SAMPLE
        bool "Enable sample"
        default y

    if AT_DEVICE_ESP32_SAMPLE

        config ESP32_SAMPLE_WIFI_SSID
            string "WIFI ssid"
            default "rtthread"

        config ESP32_SAMPLE_WIFI_PASSWORD
            string "WIFI password"
            default "12345678"

        config ESP32_SAMPLE_CLIENT_NAME
            string "AT client device name"
            default "uart2"

        config ESP32_SAMPLE_RECV_BUFF_LEN
            int "The maximum length of receive line buffer"
            default 512

    endif

endif
```

## iot/at_device/esp8266/Kconfig
```kconfig
# ESP8266 AT device configuration
menuconfig AT_DEVICE_USING_ESP8266
    bool "Espressif ESP8266"
    default n

if AT_DEVICE_USING_ESP8266

    config AT_DEVICE_ESP8266_INIT_ASYN
        bool "Enable initialize by thread"
        default n

    config AT_DEVICE_ESP8266_SAMPLE
        bool "Enable sample"
        default y

    if AT_DEVICE_ESP8266_SAMPLE

        config ESP8266_SAMPLE_WIFI_SSID
            string "WIFI ssid"
            default "rtthread"

        config ESP8266_SAMPLE_WIFI_PASSWORD
            string "WIFI password"
            default "12345678"

        config ESP8266_SAMPLE_CLIENT_NAME
            string "AT client device name"
            default "uart2"

        config ESP8266_SAMPLE_RECV_BUFF_LEN
            int "The maximum length of receive line buffer"
            default 512

    endif

endif
```

## iot/at_device/l610/Kconfig
```kconfig
# L610 AT device configuration
menuconfig AT_DEVICE_USING_L610
    bool "Fibocom L610"
    default n

if AT_DEVICE_USING_L610

    config AT_DEVICE_L610_INIT_ASYN
        bool "Enable initialize by thread"
        default n

    config AT_DEVICE_L610_SAMPLE
        bool "Enable sample"
        default y

    if AT_DEVICE_L610_SAMPLE

        config L610_SAMPLE_POWER_PIN
            int "Power pin"
            default -1

        config L610_SAMPLE_STATUS_PIN
            int "Power status pin"
            default -1

        config L610_SAMPLE_CLIENT_NAME
            string "AT client device name"
            default "uart2"

        config L610_SAMPLE_RECV_BUFF_LEN
            int "The maximum length of receive line buffer"
            default 512

    endif

endif
```

## iot/at_device/m26/Kconfig
```kconfig
# M26/MC20 AT device configuration
menuconfig AT_DEVICE_USING_M26
    bool "Quectel M26/MC20"
    default n

if AT_DEVICE_USING_M26

    config AT_DEVICE_M26_INIT_ASYN
        bool "Enable initialize by thread"
        default n

    config AT_DEVICE_M26_SAMPLE
        bool "Enable sample"
        default y

    if AT_DEVICE_M26_SAMPLE

        config M26_SAMPLE_POWER_PIN
            int "Power pin"
            default -1

        config M26_SAMPLE_STATUS_PIN
            int "Power status pin"
            default -1

        config M26_SAMPLE_CLIENT_NAME
            string "AT client device name"
            default "uart2"

        config M26_SAMPLE_RECV_BUFF_LEN
            int "The maximum length of receive line buffer"
            default 512

    endif

endif
```
