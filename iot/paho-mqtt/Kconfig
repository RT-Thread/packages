## iot/paho-mqtt/Kconfig
```kconfig
config PKG_USING_PAHO_MQTT
    bool "A mqtt package"
    default n

if PKG_USING_PAHO_MQTT

    config PKG_PAHO_MQTT_PATH
        string
        default "/packages/iot/paho-mqtt"

    config PKG_PAHO_MQTT_VER
        string
        default "v1.0.0"


endif
```

## iot/pahomqtt/Kconfig
```kconfig
menuconfig PKG_USING_PAHOMQTT
    bool "Paho MQTT: Eclipse Paho MQTT C/C++ client for Embedded platforms"
    default n

if PKG_USING_PAHOMQTT

    choice
        prompt "MQTT mode"
        help
            Select the MQTT Implementation

        config PAHOMQTT_PIPE_MODE
            bool "Pipe mode: high performance and depends on DFS"
            select RT_USING_DEVICE_IPC
            select RT_USING_SAL             if RT_VER_NUM < 0x40100
            select SAL_USING_POSIX          if RT_VER_NUM < 0x40100
            select RT_USING_POSIX_FS        if RT_VER_NUM >= 0x40100
            select RT_USING_POSIX_SOCKET    if RT_VER_NUM >= 0x40100
            select RT_USING_POSIX_PIPE      if RT_VER_NUM >= 0x40100

        config PAHOMQTT_UDP_MODE
            bool "UDP mode: small footprint, need net supported loopback"
            select RT_LWIP_NETIF_LOOPBACK
    endchoice

    config PKG_USING_PAHOMQTT_EXAMPLE
        bool "Enable MQTT example"
        default n

    config PKG_USING_PAHOMQTT_TEST
        bool "Enable MQTT test"
        default n

    config MQTT_USING_TLS
        bool "Enable support tls protocol"
        default n
        select PKG_USING_MBEDTLS

    config RT_PKG_MQTT_THREAD_STACK_SIZE
        int "Set MQTT thread stack size"
        default 4096

    config PKG_PAHOMQTT_SUBSCRIBE_HANDLERS
        int "Max pahomqtt subscribe topic handlers"
        default 1
        help
            Max pahomqtt subscribe topic handlers

    config MQTT_DEBUG
        bool "Enable debug log output"
        default y

    config PKG_PAHOMQTT_PATH
        string
        default "/packages/iot/pahomqtt"

    choice
        prompt "version"
        help
            Select the pahomqtt version

        ### Notice, the posix/libc had changed the structure of folder since RT-Thread V4.1.0.
        ### if the pahomqtt will release new tag, should add it here.
        config PKG_USING_PAHOMQTT_LATEST
            bool "latest"
            depends on RT_VER_NUM >= 0x40100

        config PKG_USING_PAHOMQTT_V120
            bool "v1.2.0"
            depends on RT_VER_NUM >= 0x40100

        config PKG_USING_PAHOMQTT_V110
            bool "v1.1.0"
            depends on RT_VER_NUM < 0x40100

        config PKG_USING_PAHOMQTT_V100
            bool "v1.0.0"
            depends on RT_VER_NUM < 0x40100
    endchoice

    config PKG_PAHOMQTT_VER
       string
       default "v1.2.0"    if PKG_USING_PAHOMQTT_V120
       default "v1.1.0"    if PKG_USING_PAHOMQTT_V110
       default "v1.0.0"    if PKG_USING_PAHOMQTT_V100
       default "latest"    if PKG_USING_PAHOMQTT_LATEST

endif
```

## iot/pdulib/Kconfig
```kconfig
# Kconfig file for package pdulib
menuconfig PKG_USING_PDULIB
    bool "pudlib:A TEXT parsing library for short messages in PDU format."
    default n

if PKG_USING_PDULIB

    config PKG_PDULIB_PATH
        string
        default "/packages/iot/pdulib"


    config PKG_USING_PDULIB_EXAMPLES
        bool "Enable pdulib sample"
        default n

    config PDULIB_DEBUG
        bool "Enable pdulib debug"
        default n

    choice
        prompt "Version"
        default PKG_USING_PDULIB_LATEST_VERSION
        help
            Select the package version

        config PKG_USING_PDULIB_V100
            bool "v1.0.0"

        config PKG_USING_PDULIB_LATEST_VERSION
            bool "latest"
    endchoice

    config PKG_PDULIB_VER
       string
       default "v1.0.0"    if PKG_USING_PDULIB_V100
       default "latest"    if PKG_USING_PDULIB_LATEST_VERSION

endif
```

## iot/ppp_device/Kconfig
```kconfig
# Kconfig file for package ppp_device
menuconfig PKG_USING_PPP_DEVICE
    bool "PPP DEVICE: lwIP PPP porting for Cellular Module( 2G/3G/4G )"
    default n
    select RT_USING_SAL
    select RT_USING_LWIP
    select RT_LWIP_PPP
    select RT_LWIP_PPPOS

if PKG_USING_PPP_DEVICE

    config PKG_PPP_DEVICE_PATH
        string
        default "/packages/iot/ppp_device"

    config PPP_DEVICE_DEBUG
        bool "Enable debug log output"
        default n

    config PPP_DEVICE_DEBUG_TX
        depends on PPP_DEVICE_DEBUG
        bool "Enable debug for tx data"
        default n

    config PPP_DEVICE_DEBUG_RX
        depends on PPP_DEVICE_DEBUG
        bool "Enable debug for rx data"
        default n

    config PPP_DEVICE_DEBUG_DROP
        depends on PPP_DEVICE_DEBUG
        bool "Enable debug for drop data"
        default n

    config USING_PPP_AUTHORIZE
        bool "Enable authorize connect feature"
        default n

    config PPP_LCP_LINK_DETECT
        bool "Enable link status detect feature"
        default y

    if PPP_LCP_LINK_DETECT

       config LCP_ECHOINTERVAL
           int "Link status detect timeout"
           default 10
           range 1 20

    endif

    choice
        prompt "Select Internet Service Provider"
        default PPP_APN_CMCC

        config PPP_APN_CMCC
            bool "china mobile"

        config PPP_APN_CUCC
            bool "china unicom"

        config PPP_APN_CTCC
            bool "china telecom"

        endchoice

    choice
        prompt "Select modem type"
        default PPP_DEVICE_USING_AIR720

        config PPP_DEVICE_USING_AIR720
            bool "Luat Air720"

        config PPP_DEVICE_USING_EC20
            bool "Quectel EC20"

        config PPP_DEVICE_USING_M6312
            bool "China mobile M6312"

        config PPP_DEVICE_USING_SIM800
            bool "SIMCOM SIM800"

    endchoice

    config PPP_DEVICE_SAMPLE
        bool "Enable sample to use ppp device"
        default y

    if PPP_DEVICE_SAMPLE

    config PPP_CLIENT_NAME
        string "ppp device uart name"
        default "uart3"

    endif

    choice
        prompt "Version"
        default PKG_USING_PPP_DEVICE_V100
        help
            Select the package version

        config PKG_USING_PPP_DEVICE_V100
            bool "v1.0.0"

        config PKG_USING_PPP_DEVICE_LATEST_VERSION
            bool "latest"
    endchoice

    config PKG_PPP_DEVICE_VER
       string
       default "v1.0.0"    if PKG_USING_PPP_DEVICE_V100
       default "latest"    if PKG_USING_PPP_DEVICE_LATEST_VERSION

   config PKG_PPP_DEVICE_VER_NUM
        hex
        default 0x10000    if PKG_USING_PPP_DEVICE_V100
        default 0x99999    if PKG_USING_PPP_DEVICE_LATEST_VERSION

endif
```

## iot/protobuf-c/Kconfig
```kconfig
# Kconfig file for package protobuf-c
menuconfig PKG_USING_PROTOBUF_C
    bool "protobuf-c: a C implementation of the Google Protocol Buffers data serialization format on RT-Thread"
    default n

if PKG_USING_PROTOBUF_C

    config PKG_PROTOBUF_C_PATH
        string
        default "/packages/iot/protobuf-c"

    config PROTOBUF_C_USING_EXAMPLE
        bool "protobuf-c exampleS"
        help
            protobuf-c examples
        default n    
    if PROTOBUF_C_USING_EXAMPLE
        config PROTOBUF_C_USING_ENCODE_DECODE_EXAMPLE
            bool "protobuf-c example: encode and decode in memory"
            help
                protobuf-c example: encode and decode in memory
            default n

        config PROTOBUF_C_USING_ENCODE_DECODE_FILE_EXAMPLE
            select RT_USING_DFS
            bool "protobuf-c example: encode to file and decode from file"
            help
                protobuf-c example: encode to file and decode from file
            default n
    endif

    choice
        prompt "Version"
        default PKG_USING_PROTOBUF_C_LATEST_VERSION
        help
            Select the package version
        config PKG_USING_PROTOBUF_C_V100
            bool "v1.0.0"
        config PKG_USING_PROTOBUF_C_LATEST_VERSION
            bool "latest"
    endchoice

    config PKG_PROTOBUF_C_VER
       string
       default "v1.0.0"    if PKG_USING_PROTOBUF_C_V100
       default "latest"    if PKG_USING_PROTOBUF_C_LATEST_VERSION

    config PKG_PROTOBUF_C_VER_NUM
        hex
        default 0x10000 if PKG_USING_PROTOBUF_C_V100
        default 0x99999 if PKG_USING_PROTOBUF_C_LATEST_VERSION

endif
```

## iot/qmodbus/Kconfig
```kconfig
# Kconfig file for package qmodbus

menuconfig PKG_USING_QMODBUS
    bool "qmodbus is a quick and easy to use modbus communication protocol stack."
    default n

if PKG_USING_QMODBUS

    config PKG_QMODBUS_PATH
        string
        default "/packages/iot/qmodbus"

    config MB_USING_PORT_RTT
        bool
        default y
        
    config MB_USING_RAW_PRT
        bool "using raw data print"
        default n

    config MB_USING_ADDR_CHK
        bool "using slave address check"
        default y
        
    config MB_USING_MBAP_CHK
        bool "using MBAP head check"
        default y
    
    config MB_USING_RTU_BACKEND
        bool "using RTU backend"
        select RT_USING_SERIAL
        select RT_USING_PIN
        default y 
    
    config MB_USING_TCP_BACKEND
        bool "using TCP backend"
        select RT_USING_SAL
        default n
    
    config MB_USING_RTU_PROTOCOL
        bool "using MODBUS-RTU protocol"
        default y
    
    config MB_USING_TCP_PROTOCOL
        bool "using MODBUS-TCP protocol"
        default n
    
    config MB_USING_MASTER
        bool "using master function"
        default y
    
    config MB_USING_SLAVE
        bool "using slave function"
        default n
    
    config MB_USING_SAMPLE
        bool "using sample"
        default n

    if MB_USING_SAMPLE
        config MB_USING_SAMPLE_RTU_MASTER
            bool "sample RTU master"
            select MB_USING_RTU_BACKEND
            select MB_USING_RTU_PROTOCOL
            select MB_USING_MASTER
            default n

        config MB_USING_SAMPLE_RTU_SLAVE
            bool "sample RTU slave"
            select MB_USING_RTU_BACKEND
            select MB_USING_RTU_PROTOCOL
            select MB_USING_SLAVE
            default n
            
        config MB_USING_SAMPLE_TCP_MASTER
            bool "sample TCP master"
            select MB_USING_TCP_BACKEND
            select MB_USING_TCP_PROTOCOL
            select MB_USING_MASTER
            default n
        
        config MB_USING_SAMPLE_TCP_SLAVE
            bool "sample TCP slave"
            select MB_USING_TCP_BACKEND
            select MB_USING_TCP_PROTOCOL
            select MB_USING_SLAVE
            default n
    endif

    choice
        prompt "Version"
        default PKG_USING_QMODBUS_LATEST_VERSION
        help
            Select the package version

        config PKG_USING_QMODBUS_LATEST_VERSION
            bool "latest"
            
        config PKG_USING_QMODBUS_V100
            bool "v1.00"
    endchoice

    config PKG_QMODBUS_VER
       string
       default "latest" if PKG_USING_QMODBUS_LATEST_VERSION
       default "v1.00"  if PKG_USING_QMODBUS_V100

endif
```

## iot/qxwz/Kconfig
```kconfig
# Kconfig file for package qxwz
menuconfig PKG_USING_QXWZ
    bool "qxwz_application: high precision location library for RT-Thread."
    default n

if PKG_USING_QXWZ

    config PKG_QXWZ_PATH
        string
        default "/packages/iot/qxwz"

    choice
        prompt "Version"
        default PKG_USING_QXWZ_LATEST_VERSION
        help
            Select the package version

        config PKG_USING_QXWZ_V122
            bool "v1.2.2"

        config PKG_USING_QXWZ_LATEST_VERSION
            bool "latest"
    endchoice

    config PKG_QXWZ_VER
       string
       default "v1.2.2"    if PKG_USING_QXWZ_V122
       default "latest"    if PKG_USING_QXWZ_LATEST_VERSION

endif
```

## iot/rt-link_hw/Kconfig
```kconfig
# Kconfig file for rt-link_hw
menuconfig PKG_USING_RT_LINK_HW
    bool "RT-Link_hw"
    default n

if PKG_USING_RT_LINK_HW

    choice
        prompt "Select the underlying transport"
        default PKG_RT_LINK_USING_UART

        config PKG_RT_LINK_USING_UART
            bool "use UART"
        config PKG_RT_LINK_USING_UDP
            bool "use UDP"
        config PKG_RT_LINK_USING_TCP
            bool "use TCP"
    endchoice

    if PKG_RT_LINK_USING_UART
        config PKG_PKG_RT_LINK_HW_DEVICE_NAME
            string "the name of base actual device"
            default "uart2"
    endif

    if PKG_RT_LINK_USING_UDP
        config RTLINK_LOCAL_UDP_PORT
            int "local udp port"
            default 8080
            range 0 65535

        config RTLINK_REMOTE_UDP_PORT
            int "remote udp port"
            default 8080
            range 0 65535

        config RTLINK_REMOTE_HOST_IP
            string "the other side IP address for rtlink"
            default "192.168.12.109"
    endif

    if PKG_RT_LINK_USING_TCP
        config RTLINK_LOCAL_TCP_PORT
            int "local tcp port"
            default 8080
            range 0 65535

        config RTLINK_REMOTE_TCP_PORT
            int "remote tcp port"
            default 8080
            range 0 65535

        config RTLINK_REMOTE_HOST_IP
            string "the other side IP address for rtlink"
            default "192.168.12.109"

        config RTLINK_IN_SERVER_MODE
            bool "config rtlink in server mode"
            default y
    endif

    choice
        prompt "Version"
        default PKG_USING_RT_LINK_HW_LATEST_VERSION
        help
            Select the package version

        config PKG_USING_RT_LINK_HW_LATEST_VERSION
            bool "latest"
    endchoice

    if PKG_USING_RT_LINK_HW_LATEST_VERSION
        config PKG_RT_LINK_HW_VER
        string
        default "latest"
    endif

    config PKG_RT_LINK_HW_PATH
    string
    default "/packages/iot/rt-link_hw"

endif
```

## iot/rt_cjson_tools/Kconfig
```kconfig
# Kconfig file for package rt_cjson_tools
menuconfig PKG_USING_RT_CJSON_TOOLS
    bool "cJSON Tools: Provide JSON data parsing and perform corresponding actions"
    default n

if PKG_USING_RT_CJSON_TOOLS

    config PKG_RT_CJSON_TOOLS_PATH
        string
        default "/packages/iot/rt_cjson_tools"

    choice
        prompt "Version"
        default PKG_USING_RT_CJSON_TOOLS_LATEST_VERSION
        help
            Select the package version

        config PKG_USING_RT_CJSON_TOOLS_LATEST_VERSION
            bool "latest"
    endchoice
          
    config PKG_RT_CJSON_TOOLS_VER
       string
       default "latest"    if PKG_USING_RT_CJSON_TOOLS_LATEST_VERSION

    config RT_CJSON_TOOLS_ENABLE_EXAMPLE
        bool "Enable example"
        default n

    if RT_CJSON_TOOLS_ENABLE_EXAMPLE

        config RT_CJSON_TOOLS_EXAMPLE_STACK_SZIE
            int "Example thread stack size"
            range 256 10240
            default 1024

        config RT_CJSON_TOOLS_EXAMPLE_PRIORITY
            int "Example thread priority"
            range 1 31
            default 15

    endif

endif
```

## iot/rtt-matter-adaptation-layer/Kconfig
```kconfig
# Kconfig file for package RTT-MATTER-Adaptation_Layer
menuconfig PKG_USING_RTT_MATTER_ADAPTATION_LAYER
    bool "Matter protocol stack porting on RT-Thread based on guidance from Connectivity Standards Alliance (CSA) Working Group."
    default n

if PKG_USING_RTT_MATTER_ADAPTATION_LAYER

    config PKG_RTT_MATTER_ADAPTATION_LAYER_PATH
        string
        default "/packages/iot/rtt-matter-adaptation-layer"

    choice
        prompt "Version"
        default PKG_USING_RTT_MATTER_ADAPTATION_LAYER_LATEST_VERSION
        help
            Select the package version

        config PKG_USING_RTT_MATTER_ADAPTATION_LAYER_LATEST_VERSION
            bool "latest"
    endchoice

    config PKG_RTT_MATTER_ADAPTATION_LAYER_VER
       string
       default "latest"    if PKG_USING_RTT_MATTER_ADAPTATION_LAYER_LATEST_VERSION

endif
```
