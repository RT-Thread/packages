## arduino/sensors/Adafruit-TSC2007/Kconfig
```kconfig
# Kconfig file for package Adafruit-TSC2007
menuconfig PKG_USING_ARDUINO_ADAFRUIT_TSC2007
    bool "Adafruit TSC2007: Resistive Touch Screen Drivers."
    select PKG_USING_RTDUINO
    select RTDUINO_USING_WIRE
    select PKG_USING_ARDUINO_ADAFRUIT_BUSIO
    default n

if PKG_USING_ARDUINO_ADAFRUIT_TSC2007

    config PKG_ARDUINO_ADAFRUIT_TSC2007_PATH
        string
        default "/packages/arduino/sensors/Adafruit-TSC2007"

    choice
        prompt "Version"
        default PKG_USING_ARDUINO_ADAFRUIT_TSC2007_LATEST_VERSION
        help
            Select the package version

        config PKG_USING_ARDUINO_ADAFRUIT_TSC2007_LATEST_VERSION
            bool "latest"
    endchoice

    config PKG_ARDUINO_ADAFRUIT_TSC2007_VER
       string
       default "latest"    if PKG_USING_ARDUINO_ADAFRUIT_TSC2007_LATEST_VERSION

endif
```

## arduino/sensors/Adafruit-TSL2561/Kconfig
```kconfig
# Kconfig file for package Adafruit-TSL2561
menuconfig PKG_USING_ARDUINO_ADAFRUIT_TSL2561
    bool "Adafruit TSL2561: Ambient Light Intensity Sensor."
    select PKG_USING_RTDUINO
    select RTDUINO_USING_WIRE
    select PKG_USING_ARDUINO_ADAFRUIT_SENSOR
    default n

if PKG_USING_ARDUINO_ADAFRUIT_TSL2561

    config PKG_ARDUINO_ADAFRUIT_TSL2561_PATH
        string
        default "/packages/arduino/sensors/Adafruit-TSL2561"

    choice
        prompt "Version"
        default PKG_USING_ARDUINO_ADAFRUIT_TSL2561_LATEST_VERSION
        help
            Select the package version

        config PKG_USING_ARDUINO_ADAFRUIT_TSL2561_LATEST_VERSION
            bool "latest"
    endchoice

    config PKG_ARDUINO_ADAFRUIT_TSL2561_VER
       string
       default "latest"    if PKG_USING_ARDUINO_ADAFRUIT_TSL2561_LATEST_VERSION

endif
```

## arduino/sensors/Adafruit-TSL2591-Library/Kconfig
```kconfig
# Kconfig file for package Adafruit-TSL2591-Library
menuconfig PKG_USING_ARDUINO_ADAFRUIT_TSL2591_LIBRARY
    bool "Adafruit TSL2591: Digital Luminosity (light) Sensors"
    select PKG_USING_RTDUINO
    select RTDUINO_USING_WIRE
    select PKG_USING_ARDUINO_ADAFRUIT_SENSOR
    select PKG_USING_ARDUINO_ADAFRUIT_BUSIO
    default n

if PKG_USING_ARDUINO_ADAFRUIT_TSL2591_LIBRARY

    config PKG_ARDUINO_ADAFRUIT_TSL2591_LIBRARY_PATH
        string
        default "/packages/arduino/sensors/Adafruit-TSL2591-Library"

    choice
        prompt "Version"
        default PKG_USING_ARDUINO_ADAFRUIT_TSL2591_LIBRARY_LATEST_VERSION
        help
            Select the package version

        config PKG_USING_ARDUINO_ADAFRUIT_TSL2591_LIBRARY_LATEST_VERSION
            bool "latest"
    endchoice

    config PKG_ARDUINO_ADAFRUIT_TSL2591_LIBRARY_VER
       string
       default "latest"    if PKG_USING_ARDUINO_ADAFRUIT_TSL2591_LIBRARY_LATEST_VERSION

endif
```

## arduino/sensors/Adafruit-VCNL4010/Kconfig
```kconfig
# Kconfig file for package Adafruit-VCNL4010
menuconfig PKG_USING_ARDUINO_ADAFRUIT_VCNL4010
    bool "Adafruit Vcnl4010: Proximity And Ambient Light Sensor, Infrared Emitter."
    select PKG_USING_RTDUINO
    select RTDUINO_USING_WIRE
    select PKG_USING_ARDUINO_ADAFRUIT_BUSIO 
    default n

if PKG_USING_ARDUINO_ADAFRUIT_VCNL4010

    config PKG_ARDUINO_ADAFRUIT_VCNL4010_PATH
        string
        default "/packages/arduino/sensors/Adafruit-VCNL4010"

    choice
        prompt "Version"
        default PKG_USING_ARDUINO_ADAFRUIT_VCNL4010_LATEST_VERSION
        help
            Select the package version

        config PKG_USING_ARDUINO_ADAFRUIT_VCNL4010_LATEST_VERSION
            bool "latest"
    endchoice

    config PKG_ARDUINO_ADAFRUIT_VCNL4010_VER
       string
       default "latest"    if PKG_USING_ARDUINO_ADAFRUIT_VCNL4010_LATEST_VERSION

endif
```

## arduino/sensors/Adafruit-VCNL4040/Kconfig
```kconfig
# Kconfig file for package Adafruit-VCNL4040
menuconfig PKG_USING_ARDUINO_ADAFRUIT_VCNL4040
    bool "Adafruit Vcnl4040: Proximity and Ambient Light Sensor"
    select PKG_USING_RTDUINO
    select RTDUINO_USING_WIRE
    select PKG_USING_ARDUINO_ADAFRUIT_BUSIO
    default n

if PKG_USING_ARDUINO_ADAFRUIT_VCNL4040

    config PKG_ARDUINO_ADAFRUIT_VCNL4040_PATH
        string
        default "/packages/arduino/sensors/Adafruit-VCNL4040"

    choice
        prompt "Version"
        default PKG_USING_ARDUINO_ADAFRUIT_VCNL4040_LATEST_VERSION
        help
            Select the package version

        config PKG_USING_ARDUINO_ADAFRUIT_VCNL4040_LATEST_VERSION
            bool "latest"
    endchoice

    config PKG_ARDUINO_ADAFRUIT_VCNL4040_VER
       string
       default "latest"    if PKG_USING_ARDUINO_ADAFRUIT_VCNL4040_LATEST_VERSION

endif
```

## arduino/sensors/Adafruit-VEML6070/Kconfig
```kconfig
# Kconfig file for package Adafruit-VEML6070
menuconfig PKG_USING_ARDUINO_ADAFRUIT_VEML6070
    bool "Adafruit Veml6070: Advanced Ultraviolet (UV) Light Sensor"
    select PKG_USING_RTDUINO
    select RTDUINO_USING_WIRE
    default n

if PKG_USING_ARDUINO_ADAFRUIT_VEML6070

    config PKG_ARDUINO_ADAFRUIT_VEML6070_PATH
        string
        default "/packages/arduino/sensors/Adafruit-VEML6070"

    choice
        prompt "Version"
        default PKG_USING_ARDUINO_ADAFRUIT_VEML6070_LATEST_VERSION
        help
            Select the package version

        config PKG_USING_ARDUINO_ADAFRUIT_VEML6070_LATEST_VERSION
            bool "latest"
    endchoice

    config PKG_ARDUINO_ADAFRUIT_VEML6070_VER
       string
       default "latest"    if PKG_USING_ARDUINO_ADAFRUIT_VEML6070_LATEST_VERSION

endif
```

## arduino/sensors/Adafruit-VEML6075/Kconfig
```kconfig
# Kconfig file for package Adafruit-VEML6075
menuconfig PKG_USING_ARDUINO_ADAFRUIT_VEML6075
    bool "Adafruit Veml6075: Ultraviolet (UV) Light Sensor"
    select PKG_USING_RTDUINO
    select RTDUINO_USING_WIRE
    select PKG_USING_ARDUINO_ADAFRUIT_BUSIO
    default n

if PKG_USING_ARDUINO_ADAFRUIT_VEML6075

    config PKG_ARDUINO_ADAFRUIT_VEML6075_PATH
        string
        default "/packages/arduino/sensors/Adafruit-VEML6075"

    choice
        prompt "Version"
        default PKG_USING_ARDUINO_ADAFRUIT_VEML6075_LATEST_VERSION
        help
            Select the package version

        config PKG_USING_ARDUINO_ADAFRUIT_VEML6075_LATEST_VERSION
            bool "latest"
    endchoice

    config PKG_ARDUINO_ADAFRUIT_VEML6075_VER
       string
       default "latest"    if PKG_USING_ARDUINO_ADAFRUIT_VEML6075_LATEST_VERSION

endif
```

## arduino/sensors/Adafruit-VEML7700/Kconfig
```kconfig
# Kconfig file for package Adafruit-VEML7700
menuconfig PKG_USING_ARDUINO_ADAFRUIT_VEML7700
    bool "Adafruit Veml7700: Ambient Light Sensor"
    select PKG_USING_RTDUINO
    select RTDUINO_USING_WIRE
    select PKG_USING_ARDUINO_ADAFRUIT_BUSIO
    default n

if PKG_USING_ARDUINO_ADAFRUIT_VEML7700

    config PKG_ARDUINO_ADAFRUIT_VEML7700_PATH
        string
        default "/packages/arduino/sensors/Adafruit-VEML7700"

    choice
        prompt "Version"
        default PKG_USING_ARDUINO_ADAFRUIT_VEML7700_LATEST_VERSION
        help
            Select the package version

        config PKG_USING_ARDUINO_ADAFRUIT_VEML7700_LATEST_VERSION
            bool "latest"
    endchoice

    config PKG_ARDUINO_ADAFRUIT_VEML7700_VER
       string
       default "latest"    if PKG_USING_ARDUINO_ADAFRUIT_VEML7700_LATEST_VERSION

endif
```
