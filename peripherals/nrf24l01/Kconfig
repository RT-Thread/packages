## peripherals/nrf24l01/Kconfig
```kconfig
# Kconfig file for package nrf24l01
menuconfig PKG_USING_NRF24L01
    bool "nRF24L01: Single-chip 2.4GHz wireless transceiver."
    default n

if PKG_USING_NRF24L01

    config PKG_NRF24L01_PATH
        string
        default "/packages/peripherals/nrf24l01"

    choice
        prompt "Version"
        default PKG_USING_NRF24L01_LATEST_VERSION
        help
            Select the package version

        config PKG_USING_NRF24L01_V100
            bool "v1.0.0"
            
        config PKG_USING_NRF24L01_V200
            bool "v2.0.0"

        config PKG_USING_NRF24L01_LATEST_VERSION
            bool "latest"
    endchoice

    config PKG_NRF24L01_VER
       string
       default "v1.0.0"    if PKG_USING_NRF24L01_V100
       default "v2.0.0"    if PKG_USING_NRF24L01_V200
       default "latest"    if PKG_USING_NRF24L01_LATEST_VERSION
    
    config PKG_NRF24L01_VERSION
       string
       default "v1.0.0"    if PKG_USING_NRF24L01_V100
       default "v2.0.0"    if PKG_USING_NRF24L01_V200
       default "latest"    if PKG_USING_NRF24L01_LATEST_VERSION

    config PKG_USING_NRF24L01_DEMO
        bool "Use demo"
        default n

    if PKG_USING_NRF24L01_DEMO
        choice
            prompt "Role"
            default PKG_NRF24L01_DEMO_ROLE_PTX
            help
                Select the role
            config PKG_NRF24L01_DEMO_ROLE_PTX
                bool "PTX"
            config PKG_NRF24L01_DEMO_ROLE_PRX
                bool "PRX"
        endchoice
        
        config PKG_NRF24L01_DEMO_SPI_DEV_NAME
            string "The spi device name for nrf24l01"
            default "spi10"
            
        config PKG_NRF24L01_DEMO_CE_PIN
            int "The ce pin of nrf24l01"
            default -1
            
        config PKG_NRF24L01_DEMO_IRQ_PIN
            int "The irq pin of nrf24l01"
            default -1                
        
        config PKG_NRF24L01_DEMO_INTERVAL_SEND
            depends on PKG_NRF24L01_DEMO_ROLE_PTX
            int "The interval of sending data (for PTX_ROLE)"
            default 500
        
    endif
    
    config PKG_NRF24L01_ENABLING_DEBUG
        bool "Enable debug"
        default n
    
    if PKG_NRF24L01_ENABLING_DEBUG
        config PKG_NRF24L01_USING_INFO_REPORT
            bool "Use info report"
            default y
                
        config PKG_NRF24L01_USING_SHELL_CMD
            bool "Use shell cmd"
            default y
        
    endif
    
endif
```

## peripherals/nrf5x_sdk/Kconfig
```kconfig
# Kconfig file for package nrf5x_sdk



menuconfig PKG_USING_NRF5X_SDK
    bool "nrf5x_sdk: the sdk of nordic"
    default n

if PKG_USING_NRF5X_SDK
    config NRFX_RTC_ENABLED
    int 
    default 1
    config NRFX_RTC1_ENABLED
    int 
    default 1
    config NRF_CLOCK_ENABLED
    int 
    default 1
    config NRF_SDH_BLE_ENABLED
    int 
    default 1
    config NRF_SDH_ENABLED
    int 
    default 1
    config NRF_SDH_SOC_ENABLED
    int 
    default 1
    config NRF_SDH_BLE_PERIPHERAL_LINK_COUNT
    int 
    default 1
    config BLE_ADVERTISING_ENABLED
    int 
    default 1
    config NRF_BLE_QWR_ENABLED
    int 
    default 1
    config NRF_SDH_BLE_VS_UUID_COUNT
    int 
    default 1
    config NRF_BLE_CONN_PARAMS_ENABLED
    int 
    default 1
    config NRF_BLE_CONN_PARAMS_MAX_SLAVE_LATENCY_DEVIATION
    int 
    default 499
    config NRF_BLE_CONN_PARAMS_MAX_SUPERVISION_TIMEOUT_DEVIATION
    int 
    default 65535
    config NRF_BLE_GATT_ENABLED
    int 
    default 1

    choice
        prompt "sample(softdevice)"
        default SD_BLE_APP_BEACON
        
        config SD_BLE_APP_BEACON
        bool "ble_app_beacon"

        config SD_BLE_APP_BLINKY
            bool "ble_app_blinky"
            if SD_BLE_APP_BLINKY
                config BLE_LBS_ENABLED
                    int 
                    default 1
                config BLE_APP_BLINKY_ADV_LED
                    int "pin number of advertising indicator led"
                    range 0 47
                    default 16  
                config BLE_APP_BLINKY_CON_LED
                    int "pin number of connected indicator led"
                    range 0 47
                    default 14  
                config BLE_APP_BLINKY_TOG_LED
                    int "pin number of toggled led"
                    range 0 47
                    default 15    
                config BLE_APP_BLINKY_TRI_BUTTON
                    int "pin number of trigger button"
                    range 0 47
                    default 11       
            endif

        config SD_BLE_APP_UART
        bool "ble_app_uart"
        if SD_BLE_APP_UART
            config BLE_NUS_ENABLED
            int 
            default 1
            config NRF_SDH_BLE_GATT_MAX_MTU_SIZE
            int 
            default 247
        endif

        config SD_BLE_APP_HRS
        bool "ble_app_hrs"
        if SD_BLE_APP_HRS
            config BLE_HRS_ENABLED
            int 
            default 1
            config NRF_SDH_BLE_GATT_MAX_MTU_SIZE
            int 
            default 247
            config BLE_DIS_ENABLED
            int 
            default 1
            config BLE_BAS_ENABLED
            int 
            default 1
        endif

        config SD_BLE_APP_HIDS_MOUSE
        bool "ble_app_hids_mouse"
        
        config SD_BLE_APP_BAS
            bool "ble_app_bas"
            if SD_BLE_APP_BAS
                config BLE_BAS_ENABLED
                    int 
                    default 1
                config BLE_APP_BAS_ADC_CHANNEL_NUM
                    int "channel number of adc"
                    range 0 7
                    default 0  
                config BLE_APP_BAS_ADC_INPUT_PIN
                    int "the x of adc AINx"
                    range 0 7
                    default 1
            endif
        
    endchoice

    config PKG_NRF5X_SDK_PATH
        string
        default "/packages/peripherals/nrf5x_sdk"

    choice
        prompt "Version"
        default PKG_USING_NRF5X_SDK_LATEST_VERSION
        help
            Select the package version

        config PKG_USING_NRF5X_SDK_V1300
            bool "v13.0.0"
            
        config PKG_USING_NRF5X_SDK_V1600
            bool "v16.0.0"
            
        config PKG_USING_NRF5X_SDK_LATEST_VERSION
            bool "latest"
    endchoice
          
    config PKG_NRF5X_SDK_VER
       string
       default "v13.0.0"    if PKG_USING_NRF5X_SDK_V1300
       default "v16.0.0"    if PKG_USING_NRF5X_SDK_V1600
       default "latest"    if PKG_USING_NRF5X_SDK_LATEST_VERSION

endif
```

## peripherals/nuclei_sdk/Kconfig
```kconfig
# Only enable package nuclei_sdk when ARCH_NUCLEI is selected
if ARCH_NUCLEI
# Kconfig file for package nuclei_sdk
menuconfig PKG_USING_NUCLEI_SDK
    bool "Nuclei RISC-V Software Development Kit"
    default n

if PKG_USING_NUCLEI_SDK

    config PKG_NUCLEI_SDK_PATH
        string
        default "/packages/peripherals/nuclei_sdk"

    choice
        prompt "Version"
        default PKG_USING_NUCLEI_SDK_LATEST_VERSION
        help
            Select the package version

        config PKG_USING_NUCLEI_SDK_V023
            bool "0.2.3"

        config PKG_USING_NUCLEI_SDK_LATEST_VERSION
            bool "latest"
    endchoice

    config PKG_NUCLEI_SDK_VER
       string
       default "0.2.3"     if PKG_USING_NUCLEI_SDK_V023
       default "latest"    if PKG_USING_NUCLEI_SDK_LATEST_VERSION

endif
endif
```

## peripherals/pca9685/Kconfig
```kconfig
# Kconfig file for package pca9685
menuconfig PKG_USING_PCA9685
    bool "pca9685: I2C-bus controlled 16-channel PWM controller"
    default n

if PKG_USING_PCA9685

    config PKG_PCA9685_PATH
        string
        default "/packages/peripherals/pca9685"

    config PKG_USING_PCA9685_SAMPLE
        bool "Enable pca9685 sample"
        default n

    choice
        prompt "Version"
        default PKG_USING_PCA9685_LATEST_VERSION
        help
            Select the package version

        config PKG_USING_PCA9685_V100
            bool "v1.0.0"

        config PKG_USING_PCA9685_LATEST_VERSION
            bool "latest"
    endchoice

    config PKG_PCA9685_VER
       string
       default "v1.0.0"    if PKG_USING_PCA9685_V100
       default "latest"    if PKG_USING_PCA9685_LATEST_VERSION

endif
```

## peripherals/pcf8574/Kconfig
```kconfig
# Kconfig file for package pcf8574
menuconfig PKG_USING_PCF8574
    bool "pcf8574: Remote 8-bit I/O expander for I2C-bus"
    default n

if PKG_USING_PCF8574

    config PKG_PCF8574_PATH
        string
        default "/packages/peripherals/pcf8574"

    config PKG_USING_PCF8574_SAMPLE
		bool "Enable pcf8574 sample"
		default n

    choice
        prompt "Version"
        default PKG_USING_PCF8574_LATEST_VERSION
        help
            Select the package version

        config PKG_USING_PCF8574_V100
            bool "v1.0.0"

        config PKG_USING_PCF8574_LATEST_VERSION
            bool "latest"
    endchoice
          
    config PKG_PCF8574_VER
       string
       default "v1.0.0"    if PKG_USING_PCF8574_V100
       default "latest"    if PKG_USING_PCF8574_LATEST_VERSION

endif
```

## peripherals/phytium_sdk/Kconfig
```kconfig
# Kconfig file for package phytium_sdk
menuconfig PKG_USING_PHYTIUM_SDK
    bool "Phytium Software Development Kit ."
    default n

if PKG_USING_PHYTIUM_SDK

    config PKG_PHYTIUM_SDK_PATH
        string
        default "/packages/peripherals/phytium_sdk"

    choice
        prompt "Version"
        default PKG_USING_PHYTIUM_SDK_LATEST_VERSION
        help
            Select the package version

        config PKG_USING_PHYTIUM_SDK_LATEST_VERSION
            bool "latest"
    endchoice

    config PKG_PHYTIUM_SDK_VER
       string
       default "latest"    if PKG_USING_PHYTIUM_SDK_LATEST_VERSION

endif
```

## peripherals/pms_series/Kconfig
```kconfig
# Kconfig file for package pms
menuconfig PKG_USING_PMS_SERIES
    bool "pms_series: Digital universal particle concentration sensor driver library"
    default n

if PKG_USING_PMS_SERIES

    config PKG_PMS_SERIES_PATH
        string
        default "/packages/peripherals/pms_series"
    choice
        prompt "Model"
        default PMS_SERIES_USING_PMS5003ST
        help
            Select the PMS model

        config PMS_SERIES_USING_PMS1003
            bool "PMS1003"
        config PMS_SERIES_USING_PMS3003
            bool "PMS3003"
        config PMS_SERIES_USING_PMS5003
            bool "PMS5003"
        config PMS_SERIES_USING_PMS5003S
            bool "PMS5003S"
        config PMS_SERIES_USING_PMS5003ST
            bool "PMS5003ST"
        config PMS_SERIES_USING_PMS7003
            bool "PMS7003"
        config PMS_SERIES_USING_PMS7003M
            bool "PMS7003M"
        config PMS_SERIES_USING_PMSA003
            bool "PMSA003"
    endchoice
    config PKG_USING_PMS_SERIES_SAMPLE
        bool "Enable pms series sample"
        default n
        if PKG_USING_PMS_SERIES_SAMPLE
            config PMS_SERIES_SAMPLE_USING_DMA
                bool "Enable pms series sample dma"
                default n
            choice
                prompt "Enable pms series sample uart"
                default PMS_SERIES_SAMPLE_USING_UART2
                help
                    Select the PMS examples uart

                config PMS_SERIES_SAMPLE_USING_UART1
                    bool "UART1"
                config PMS_SERIES_SAMPLE_USING_UART2
                    bool "UART2"
                config PMS_SERIES_SAMPLE_USING_UART3
                    bool "UART3"
                config PMS_SERIES_SAMPLE_USING_UART4
                    bool "UART4"
                config PMS_SERIES_SAMPLE_USING_UART5
                    bool "UART5"
                config PMS_SERIES_SAMPLE_USING_UART6
                    bool "UART6"
            endchoice
        endif
    choice
        prompt "Version"
        default PKG_USING_PMS_SERIES_V100
        help
            Select the package version

        config PKG_USING_PMS_SERIES_V100
            bool "v1.0.0"

        config PKG_USING_PMS_SERIES_LATEST_VERSION
            bool "latest"
    endchoice

    config PKG_PMS_SERIES_VER
       string
       default "v1.0.0"    if PKG_USING_PMS_SERIES_V100
       default "latest"    if PKG_USING_PMS_SERIES_LATEST_VERSION

endif
```

## peripherals/qkey/Kconfig
```kconfig
# Kconfig file for package quick_key

menuconfig PKG_USING_QKEY
    bool "qkey : A quick and easy-to-use key driver package."
    default n

if PKG_USING_QKEY

    config PKG_QKEY_PATH
        string
        default "/packages/peripherals/qkey"

    config QKEY_USING_TEST
        bool "using test"
        default n

    config QKEY_USING_PULL
        bool "Key using pull up/down"
        default y

    config QKEY_TOTAL
        int "Key maximum total"
        default 5

    config QKEY_SCAN_PRIOD_MS
        int "Key scan time unit, unit : ms"
        default 10

    config QKEY_THREAD_NAME
        string "Key driver thread name"
        default "qkey"

    config QKEY_THREAD_STACK_SIZE
        int "Key driver thread stack size"
        default 1024

    config QKEY_THREAD_PRIO
        int "Key driver thread priority"
        default 3

    config QKEY_USING_ARRAY
        bool "using key array"
        default n

    if QKEY_USING_ARRAY

        config QKEY_ARRAY_ROW_TOTAL
            int "Key array row total"
            default 4

        config QKEY_ARRAY_COL_TOTAL
            int "Key array col total"
            default 3

        config QKEY_ARRAY_PIN_FIRST
            int "Key array pin number of the first key"
            default 256

    endif

    choice
        prompt "Version"
        default PKG_USING_QKEY_LATEST_VERSION
        help
            Select the package version

        config PKG_USING_QKEY_LATEST_VERSION
            bool "latest"

        config PKG_USING_QKEY_V112
            bool "v1.12"

        config PKG_USING_QKEY_V111
            bool "v1.11"

        config PKG_USING_QKEY_V110
            bool "v1.10"

        config PKG_USING_QKEY_V100
            bool "v1.00"
    endchoice

    config PKG_QKEY_VER
       string
       default "latest" if PKG_USING_QKEY_LATEST_VERSION
       default "v1.12"  if PKG_USING_QKEY_V112
       default "v1.11"  if PKG_USING_QKEY_V111
       default "v1.10"  if PKG_USING_QKEY_V110
       default "v1.00"  if PKG_USING_QKEY_V100

endif
```
