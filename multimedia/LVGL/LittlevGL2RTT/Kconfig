## multimedia/LVGL/LittlevGL2RTT/Kconfig
```kconfig
# Kconfig file for package LittlevGL2RTT
menuconfig PKG_USING_LITTLEVGL2RTT
    bool "LittlevGL2RTT (LVGL 7.x): The LittlevGL GUI Lib for RT-Thread"
    depends on RT_VER_NUM < 0x40100
    default n

if PKG_USING_LITTLEVGL2RTT

    config PKG_LITTLEVGL2RTT_PATH
        string
        default "/packages/multimedia/LVGL/LittlevGL2RTT"

    choice
        prompt "version"
        help
            Select the LittlevGL2RTT version

        config PKG_USING_LITTLEVGL2RTT_V001
            bool "v0.0.1"

        config PKG_USING_LITTLEVGL2RTT_LATEST_VERSION
            bool "latest"
    endchoice

    config PKG_LITTLEVGL2RTT_VER
       string
       default "v0.0.1" if PKG_USING_LITTLEVGL2RTT_V001
       default "latest" if PKG_USING_LITTLEVGL2RTT_LATEST_VERSION

    menu "LittlevGL2RTT Options"
        choice
            prompt "Memory management mode"
            default LV_MEM_DYNAMIC

            config LV_MEM_STATIC
                bool "static"
            config LV_MEM_DYNAMIC
                bool "dynamic"
        endchoice
        config LV_MEM_CUSTOM
            int
            default 0 if LV_MEM_STATIC
            default 1 if LV_MEM_DYNAMIC

        choice
            prompt "Color depth"
            default LV_COLOR_DEPTH_16

            config LV_COLOR_DEPTH_1
                bool "1bit"
            config LV_COLOR_DEPTH_8
                bool "8bit"
            config LV_COLOR_DEPTH_16
                bool "16bit"
            config LV_COLOR_DEPTH_24
                bool "24bit"
            config LV_COLOR_DEPTH_32
                bool "32bit"
        endchoice
        config LV_COLOR_DEPTH
            int
            default 1  if LV_COLOR_DEPTH_1
            default 8  if LV_COLOR_DEPTH_8
            default 16 if LV_COLOR_DEPTH_16
            default 24 if LV_COLOR_DEPTH_24
            default 32 if LV_COLOR_DEPTH_32

        config LV_MEM_KB_SIZE
            int "Memory Size used by 'lv_mem_alloc'(KB)"
            range 2 65536
            default 32
            depends on LV_MEM_STATIC

        config LV_MEM_AUTO_DEFRAG
            int "Automatically defrag on free"
            default 1
            range 0 1
            depends on LV_MEM_STATIC

        config LV_HOR_RES
            int "horizontal pixels"
            default 480
        config LV_VER_RES
            int "vertical pixels"
            default 272
        config LV_DPI
            int "DPI(dot per inch)"
            default 50

        choice
            prompt "Garbage Collector"
            default LV_GC_DISABLE

            config LV_GC_DISABLE
                bool "disable GC"
            config LV_GC_ENABLE
                bool "enable GC"
        endchoice
        config LV_ENABLE_GC
            int
            default 0  if LV_GC_DISABLE
            default 1  if LV_GC_ENABLE

    endmenu

    config LITTLEVGL2RTT_USING_DEMO
        bool
        prompt "LittlevGL2RTT demo example"
        default y
endif
```

## multimedia/LVGL/gui_guider_demo/Kconfig
```kconfig
# Kconfig file for package gui_guider_demo
menuconfig PKG_USING_GUI_GUIDER_DEMO
    bool "Enable LVGL GUI Guider demo for RT-Thread"
    default n

if PKG_USING_GUI_GUIDER_DEMO

    config PKG_GUI_GUIDER_DEMO_PATH
        string
        default "/packages/multimedia/LVGL/gui_guider_demo"

    config PKG_GUI_GUIDER_DEMO_VER
       string
       default "latest"

endif
```

## multimedia/LVGL/lv_music_demo/Kconfig
```kconfig
# Kconfig file for package lv_music_demo
menuconfig PKG_USING_LV_MUSIC_DEMO
    bool "Enable LVGL music player demo for RT-Thread"
    default n

if PKG_USING_LV_MUSIC_DEMO

    config PKG_LV_MUSIC_DEMO_PATH
        string
        default "/packages/multimedia/LVGL/lv_music_demo"

    config PKG_LV_MUSIC_DEMO_VER
        string
        default "v0.2.0"    if PKG_LVGL_VER_NUM = 0x080200 #LVGL v8.2.0
        default "v0.3.2"    if PKG_LVGL_VER_NUM >= 0x080300 && PKG_LVGL_VER_NUM <= 0x080307 #LVGL v8.3.0 - v8.3.7
        default "v0.3.3"    if PKG_LVGL_VER_NUM >= 0x080308 && PKG_LVGL_VER_NUM <= 0x080309 #LVGL v8.3.8 - v8.3.9
        default "v0.3.4"    if PKG_LVGL_VER_NUM >= 0x080310 && PKG_LVGL_VER_NUM < 0x080400 #LVGL v8.3.10 -
        default "latest"
endif
```

## multimedia/NUemWin/Kconfig
```kconfig
# Kconfig file for package NUemWin
menuconfig PKG_USING_NUEMWIN
    bool "NUemWin: a NUemWin package for rt-thread"
    default n

if PKG_USING_NUEMWIN

    config PKG_NUEMWIN_PATH
        string
        default "/packages/multimedia/NUemWin"

    config PKG_USING_NUEMWIN_EXAMPLE
        bool "Enable NUemWin example"
        default y

    if PKG_USING_NUEMWIN_EXAMPLE
        choice
            prompt "Examples"
            default PKG_USING_NUEMWIN_GUIDEMO
            help
                Select an example

            config PKG_USING_NUEMWIN_GUIDEMO
                bool "GUI Demo"

            config PKG_USING_NUEMWIN_SIMPLEDEMO
                bool "Simple Demo"

            config PKG_USING_NUEMWIN_APPWIZARD
                bool "AppWizard Demo"

            config PKG_USING_NUEMWIN_WEATHERFORECAST
                bool "Weather Forecast Demo"

        endchoice
    endif

    choice
        prompt "Version"
        default PKG_USING_NUEMWIN_LATEST_VERSION
        help
            Select the package version

        config PKG_USING_NUEMWIN_LATEST_VERSION
            bool "latest"
    endchoice

    config PKG_NUEMWIN_VER
       string
       default "latest"    if PKG_USING_NUEMWIN_LATEST_VERSION

    config PKG_NUEMWIN_VER_NUM
        hex
        default 0x99999    if PKG_USING_NUEMWIN_LATEST_VERSION

endif
```

## multimedia/PDFGen/Kconfig
```kconfig
# Kconfig file for package PDFGen
menuconfig PKG_USING_PDFGEN
    bool "PDFGen: Simple C PDF Writer/Generation library"
    select PKG_USING_RT_VSNPRINTF_FULL if RT_VER_NUM < 0x50200
    select RT_KLIBC_USING_VSNPRINTF_STANDARD if RT_VER_NUM >= 0x50200
    select RT_USING_LIBC     if RT_VER_NUM < 0x40100
    select RT_USING_DFS      if RT_VER_NUM < 0x40100
    select RT_USING_POSIX_FS if RT_VER_NUM >= 0x40100
    default n

if PKG_USING_PDFGEN

    config PKG_PDFGEN_PATH
        string
        default "/packages/multimedia/PDFGen"

    choice
        prompt "Version"
        default PKG_USING_PDFGEN_LATEST_VERSION
        help
            Select the package version

        config PKG_USING_PDFGEN_LATEST_VERSION
            bool "latest"
    endchoice

    config PKG_PDFGEN_VER
       string
       default "latest"    if PKG_USING_PDFGEN_LATEST_VERSION

endif
```

## multimedia/PainterEngine/Kconfig
```kconfig
menu "PainterEngine: A cross-platform graphics application framework written in C language"

source "$PKGS_DIR/packages/multimedia/PainterEngine/PainterEngine/Kconfig"
source "$PKGS_DIR/packages/multimedia/PainterEngine/PainterEngine_AUX/Kconfig"

endmenu
```

## multimedia/PainterEngine/PainterEngine/Kconfig
```kconfig
# Kconfig file for package PainterEngine
menuconfig PKG_USING_PAINTERENGINE
    bool "PainterEngine: A cross-platform graphics application framework written in C language"
    select PKG_USING_PAINTERENGINE_AUX
    default n

if PKG_USING_PAINTERENGINE

    config PKG_PAINTERENGINE_PATH
        string
        default "/packages/multimedia/PainterEngine/PainterEngine"

    choice
        prompt "Version"
        default PKG_USING_PAINTERENGINE_LATEST_VERSION
        help
            Select the package version

        config PKG_USING_PAINTERENGINE_LATEST_VERSION
            bool "latest"
    endchoice
          
    config PKG_PAINTERENGINE_VER
       string
       default "latest"    if PKG_USING_PAINTERENGINE_LATEST_VERSION

endif
```

## multimedia/PainterEngine/PainterEngine_AUX/Kconfig
```kconfig
# Kconfig file for package PainterEngine
menuconfig PKG_USING_PAINTERENGINE_AUX
    bool
    default n

if PKG_USING_PAINTERENGINE_AUX

    config PKG_PAINTERENGINE_AUX_PATH
        string
        default "/packages/multimedia/PainterEngine/PainterEngine_AUX"

    choice
        prompt "Version"
        default PKG_USING_PAINTERENGINE_AUX_LATEST_VERSION
        help
            Select the package version

        config PKG_USING_PAINTERENGINE_AUX_LATEST_VERSION
            bool "latest"
    endchoice
          
    config PKG_PAINTERENGINE_AUX_VER
       string
       default "latest"    if PKG_USING_PAINTERENGINE_AUX_LATEST_VERSION

endif
```

## multimedia/STemWin/Kconfig
```kconfig
# Kconfig file for package STemWin
menuconfig PKG_USING_STEMWIN
    bool "STemWin: a STemWin package for rt-thread"
    default n

if PKG_USING_STEMWIN

    config PKG_STEMWIN_PATH
        string
        default "/packages/multimedia/STemWin"

    config PKG_STEMWIN_MEM_SIZE
        int "STemWin memory size (KB)"
        default 60

    config PKG_USING_STEMWIN_EXAMPLE
        bool "Enable STemWin example"
        default n

    choice
        prompt "Version"
        default PKG_USING_STEMWIN_LATEST_VERSION
        help
            Select the package version

        config PKG_USING_STEMWIN_LATEST_VERSION
            bool "latest"
    endchoice

    config PKG_STEMWIN_VER
       string
       default "v1.0.0"    if PKG_USING_STEMWIN_V100
       default "latest"    if PKG_USING_STEMWIN_LATEST_VERSION

    config PKG_STEMWIN_VER_NUM
        hex
        default 0x99999    if PKG_USING_STEMWIN_LATEST_VERSION
        default 0x10000    if PKG_USING_STEMWIN_V100

endif
```

## multimedia/TJpgDec/Kconfig
```kconfig
# Kconfig file for package TJpgDec
menuconfig PKG_USING_TJPGD
    bool "TJpgDec: Tiny JPEG Decompressor."
    default n

if PKG_USING_TJPGD

    config PKG_TJPGD_PATH
        string
        default "/packages/multimedia/TJpgDec"

	config TJPGD_INPUT_BUFFER_SIZE
		int "Size of stream input buffer"
		default 512

	choice
        prompt "Output format"
        default TJPGD_USING_FORMAT_RGB888
        help
            Select the RGB output format

        config TJPGD_USING_FORMAT_RGB888
            bool "RGB888"

        config TJPGD_USING_FORMAT_RGB565
            bool "RGB565"
    endchoice

    config TJPGD_USING_SCALE
        bool "Use output descaling"
        default y
		
	config TJPGD_USING_TBLCLIP
        bool "Use table for saturation"
        default y
		
    config PKG_TJPGD_SAMPLE
        bool "Enable tjpgd sample"
        default y

    choice
        prompt "Version"
        default PKG_USING_TJPGD_LATEST_VERSION
        help
            Select the package version

        config PKG_USING_TJPGD_V100
            bool "v1.0.0"

        config PKG_USING_TJPGD_LATEST_VERSION
            bool "latest"
    endchoice
          
    config PKG_TJPGD_VER
       string
       default "v1.0.0"    if PKG_USING_TJPGD_V100
       default "latest"    if PKG_USING_TJPGD_LATEST_VERSION

endif
```

## multimedia/TinyJPEG/Kconfig
```kconfig
# Kconfig file for package TinyJPEG
menuconfig PKG_USING_TINYJPEG
    bool "TinyJPEG: Light-weight JPEG encoder package."
    default n

if PKG_USING_TINYJPEG

    config PKG_TINYJPEG_PATH
        string
        default "/packages/multimedia/TinyJPEG"

    choice
        prompt "Version"
        default PKG_USING_TINYJPEG_LATEST_VERSION
        help
            Select the package version

        config PKG_USING_TINYJPEG_V100
            bool "v1.0.0"

        config PKG_USING_TINYJPEG_LATEST_VERSION
            bool "latest"
    endchoice

    config PKG_TINYJPEG_VER
       string
       default "v1.0.0"    if PKG_USING_TINYJPEG_V100
       default "latest"    if PKG_USING_TINYJPEG_LATEST_VERSION

endif
```

## multimedia/fastlz/Kconfig
```kconfig
config PKG_USING_FASTLZ
    bool "a fastlz package for rt-thread"
    default n

if PKG_USING_FASTLZ

    config PKG_FASTLZ_PATH
        string
        default "/packages/multimedia/fastlz"

    config PKG_FASTLZ_VER
        string
        default "v1.0.0"

endif
```

## multimedia/helix/Kconfig
```kconfig
# Kconfig file for package helix
menuconfig PKG_USING_HELIX
    bool "The Helix MP3 Decoder."
    default n

if PKG_USING_HELIX

    config PKG_HELIX_PATH
        string
        default "/packages/multimedia/helix"

    choice
        prompt "version"
        help
            Select the helix version
        config PKG_USING_HELIX_V100
            bool "v1.0.0"

        config PKG_USING_HELIX_LATEST_VERSION
            bool "latest"

    endchoice

    if PKG_USING_HELIX_V100
        config PKG_HELIX_VER
        string
        default "v1.0.0"
    endif

    if PKG_USING_HELIX_LATEST_VERSION
       config PKG_HELIX_VER
       string
       default "latest"
    endif

endif
```

## multimedia/litetype/Kconfig
```kconfig
# Kconfig file for package LiteType
menuconfig PKG_USING_LITETYPE
    bool "LiteType: Lightweight font engine for embedded systems"
    default n

if PKG_USING_LITETYPE

    config PKG_LITETYPE_PATH
        string
        default "/packages/multimedia/litetype"

    config PKG_USING_LITETYPE_STREAMIO
        bool "Enable file stream I/O"
        default y
        help
            Enable file stream I/O support. Required for loading fonts
            from filesystem. Disable this for memory-only usage.

    config PKG_USING_LITETYPE_LBF
        bool "Enable LBF bitmap font format"
        default y
        help
            Enable LiteBitFile bitmap font format support.
            Bitmap fonts store rasterized data for fastest rendering.

    config PKG_USING_LITETYPE_LVF
        bool "Enable LVF vector font format"
        default y
        help
            Enable LiteVectorFile vector font format support.
            Vector fonts store outline curves for lossless scaling.

    config PKG_USING_LITETYPE_LCF
        bool "Enable LCF combined font format"
        default y
        help
            Enable LiteCombineFile combined font format support.
            Combined fonts pack up to 5 sub-fonts (LBF/LVF) into one file.

    config PKG_USING_LITETYPE_ENCODER
        bool "Enable encoder (Creator API)"
        default n
        help
            Enable font creation/encoding functionality.
            Required only if you need to create font files on target device.

    config PKG_USING_LITETYPE_ITALIC
        bool "Enable italic style support"
        default y
        help
            Enable italic style transformation for font rendering.

    config PKG_USING_LITETYPE_BOLD
        bool "Enable bold style support"
        default y
        help
            Enable bold style transformation for font rendering.

    config PKG_USING_LITETYPE_DIAG
        bool "Enable diagnostic logging"
        default n
        help
            Enable diagnostic log output for debugging.
            Increases code size, disable for production builds.

    config PKG_USING_LITETYPE_SAMPLE
        bool "Enable LiteType sample"
        default n
        help
            Build the basic sample demonstrating LiteType usage.

    choice
        prompt "Version"
        default PKG_USING_LITETYPE_LATEST_VERSION
        help
            Select the package version

        config PKG_USING_LITETYPE_V101
            bool "v1.0.1"

        config PKG_USING_LITETYPE_LATEST_VERSION
            bool "latest"
    endchoice

    config PKG_LITETYPE_VER
       string
       default "v1.0.1"    if PKG_USING_LITETYPE_V101
       default "latest"    if PKG_USING_LITETYPE_LATEST_VERSION

endif
```

## multimedia/littlevgl/Kconfig
```kconfig
menu "littlevgl: powerful and easy-to-use embedded GUI library"

source "$PKGS_DIR/packages/multimedia/littlevgl/LittlevGL2RTT/Kconfig"

endmenu
```

## multimedia/lvgl/Kconfig
```kconfig
menu "lvgl: powerful and easy-to-use embedded GUI library"

source "$PKGS_DIR/packages/multimedia/lvgl/LittlevGL2RTT/Kconfig"
source "$PKGS_DIR/packages/multimedia/lvgl/lvgl/Kconfig"

endmenu
```
