## misc/simulated_sensor/Kconfig
```kconfig
# Kconfig file for package Simulated Sensor
menuconfig PKG_USING_SIMULATED_SENSOR
    bool "Simulated Sensor for RT-Thread"
    default n
    help
        Simulated sensor package, generate simulated sensor data.

if PKG_USING_SIMULATED_SENSOR

    config PKG_SIMULATED_SENSOR_PATH
        string
        default "/packages/misc/simulated_sensor"

    menu "Simulated Sensor MQTT Configuration"
        config PKG_SIMULATED_SENSOR_MQTT
            bool "Enable MQTT data upload"
            select PKG_USING_PAHOMQTT
            select PKG_USING_CJSON
            default n
            help
                Send simulated sensor data to server via MQTT protocol.

        config PKG_SIMULATED_SENSOR_MQTT_BROKER
            string "MQTT broker address"
            depends on PKG_SIMULATED_SENSOR_MQTT
            default "tcp://broker.emqx.io:1883"
            help
                Specify MQTT broker URI, e.g. tcp://xxx:1883.

        config PKG_SIMULATED_SENSOR_MQTT_TOPIC
            string "MQTT publish topic"
            depends on PKG_SIMULATED_SENSOR_MQTT
            default "simu_sensor/data"
            help
                MQTT topic to publish simulated sensor data.

        config PKG_SIMULATED_SENSOR_MQTT_CLIENT_ID
            string "MQTT client ID"
            depends on PKG_SIMULATED_SENSOR_MQTT
            default "rtthread-simu"
            help
                MQTT client identifier.

        config PKG_SIMULATED_SENSOR_MQTT_USERNAME
            string "MQTT broker username"
            depends on PKG_SIMULATED_SENSOR_MQTT
            default "USER1"
            help
                Username for MQTT broker authentication.

        config PKG_SIMULATED_SENSOR_MQTT_PASSWORD
            string "MQTT broker password"
            depends on PKG_SIMULATED_SENSOR_MQTT
            default "USER1"
            help
                Password for MQTT broker authentication.

        config PKG_SIMULATED_SENSOR_MQTT_INTERVAL
            int "MQTT publish interval (ms)"
            depends on PKG_SIMULATED_SENSOR_MQTT
            default 5000
            range 500 60000
            help
                Sensor data publish period in milliseconds. Minimum value is 500ms.

    endmenu

    config PKG_SIMULATED_SENSOR_SAMPLE_ENABLED
        bool "Enable sample code"
        default n
        help
            Enable sample code for simulated sensor package.

    # Package source version choice
    # NOTE: currently only master branch option, extend more tag/commit later
    choice PKG_SIMULATED_SENSOR_VERSION_SEL
        prompt "Simulated Sensor package source version"
        default PKG_USING_SIMULATED_SENSOR_LATEST_VERSION
        help
            Select git source version for simulated sensor package.

        config PKG_USING_SIMULATED_SENSOR_LATEST_VERSION
            bool "latest (master branch)"
    endchoice

    config PKG_SIMULATED_SENSOR_VER
        string
        depends on PKG_USING_SIMULATED_SENSOR
        default "latest" if PKG_USING_SIMULATED_SENSOR_LATEST_VERSION

endif
```

## multimedia/LVGL/gd32embeddedui_demos/Kconfig
```kconfig
# Kconfig file for package gd32embeddedui_demos
menuconfig PKG_USING_GD32EMBEDDEDUI_DEMOS
    bool "GD32EmbeddedUI: editable LVGL UI project"
    depends on PKG_USING_LVGL
    depends on PKG_LVGL_VER_NUM = 0x080311
    default n
    help
        Editable GD32EmbeddedUI project and generated UI sources for LVGL 8.3.11.
        Use the target project's existing LVGL display and input drivers, then
        call ui_init() after driver initialization.
        Change display.width and display.height in GD32Embeddedui.gdlvgl to
        adjust the screen size, then regenerate code in GD32EmbeddedUI.

if PKG_USING_GD32EMBEDDEDUI_DEMOS

    config PKG_GD32EMBEDDEDUI_DEMOS_PATH
        string
        default "/packages/multimedia/LVGL/gd32embeddedui_demos"

    config PKG_GD32EMBEDDEDUI_DEMOS_VER
        string
        default "latest"

endif

comment "GD32EmbeddedUI demos require LVGL v8.3.11"
    depends on !PKG_USING_LVGL || PKG_LVGL_VER_NUM != 0x080311
```

## multimedia/Qt/Kconfig
```kconfig
# Kconfig file for the Qt RT-Thread kernel-mode package
menuconfig PKG_USING_QT_RTTHREAD
    bool "Qt for RT-Thread (kernel mode)"
    select RT_USING_CPLUSPLUS
    select RT_USING_DEVICE
    select RT_USING_DFS
    select RT_USING_POSIX_DEVIO
    select RT_USING_POSIX_POLL
    select RT_USING_GRAPHIC
    select RT_USING_INPUT
    default n

if PKG_USING_QT_RTTHREAD

config PKG_QT_RTTHREAD_PATH
    string
    default "/packages/multimedia/Qt"

config PKG_QT_RTTHREAD_SDK_PATH
    string "Assembled target SDK path"
    default "sdk/kernel"
    help
        Absolute path, or a path relative to the package root, containing
        include/, lib/, plugins/, and qml/. Qt is prepared outside the normal
        BSP build and SCons only consumes this relocatable SDK.

config PKG_QT_RTTHREAD_DEFAULT_ENTRY
    bool "Provide qt_run shell command and default Qt thread"
    default y
    help
        Applications provide `extern \"C\" void qt_main(void *parameter)`.
        Disable this option when the BSP owns Qt thread creation and policy.

if PKG_QT_RTTHREAD_DEFAULT_ENTRY

config PKG_QT_RTTHREAD_THREAD_STACK_SIZE
    int "Qt thread stack size in bytes"
    default 8388608 if PKG_QT_RTTHREAD_QML
    default 2097152

config PKG_QT_RTTHREAD_THREAD_PRIORITY
    int "Qt thread priority"
    range 0 255
    default 25

config PKG_QT_RTTHREAD_THREAD_TIMESLICE
    int "Qt thread time slice"
    default 10

config PKG_QT_RTTHREAD_POINTER_DEVICE
    string "Pointer/touch device"
    default "/dev/input1"

config PKG_QT_RTTHREAD_KEYBOARD_DEVICE
    string "Keyboard device"
    default "/dev/input0"

config PKG_QT_RTTHREAD_FONTDIR
    string "Qt font directory"
    default "/fonts/"
    help
        Directory containing TTF, TTC, or OTF fonts for QtGui, QWidget, and
        QML text. Applications can instead register an embedded font.

endif

config PKG_QT_RTTHREAD_WIDGETS
    bool "Qt Widgets"
    default y

config PKG_QT_RTTHREAD_QML
    bool "QML and software Qt Quick"
    depends on RT_USING_MEMHEAP_AS_HEAP
    default y
    help
        Qt Quick allocates full-frame and intermediate software-rendering
        buffers that exceed the SLAB heap's maximum allocation. Select
        "Use memheap objects as heap" in RT-Thread memory management first.

config PKG_QT_RTTHREAD_QUICK_CONTROLS2
    bool "Qt Quick Controls 2"
    depends on PKG_QT_RTTHREAD_QML
    default y

choice
    prompt "Static Qt Quick Controls 2 style"
    depends on PKG_QT_RTTHREAD_QUICK_CONTROLS2
    default PKG_QT_RTTHREAD_STYLE_FUSION

config PKG_QT_RTTHREAD_STYLE_FUSION
    bool "Fusion (recommended for software rendering)"

config PKG_QT_RTTHREAD_STYLE_MATERIAL
    bool "Material"

config PKG_QT_RTTHREAD_STYLE_UNIVERSAL
    bool "Universal"
endchoice

choice
    prompt "Input integration"
    default PKG_QT_RTTHREAD_INPUT_PLATFORM

config PKG_QT_RTTHREAD_INPUT_PLATFORM
    bool "rtthreadfb built-in evdev handlers"

config PKG_QT_RTTHREAD_INPUT_GENERIC
    bool "Generic evdev plugins (legacy QWidget profile)"

config PKG_QT_RTTHREAD_INPUT_TSLIB
    bool "tslib touchscreen"
endchoice

config PKG_QT_RTTHREAD_IMAGEFORMATS
    bool "GIF, ICO and JPEG image plugins"
    default y

config PKG_QT_RTTHREAD_DEMO
    bool "Link an external Qt demo archive"
    default n
    help
        Link a static archive that exports `extern \"C\" void qt_main(void *)`.
        This works for QtCore, QWidget, QML, and Qt Quick demos.

config PKG_QT_RTTHREAD_DEMO_ARCHIVE
    string "Demo archive"
    depends on PKG_QT_RTTHREAD_DEMO
    default ""
    help
        Absolute path, or a path relative to the package root, of the static
        archive containing qt_main. The archive is linked with -u qt_main.

config PKG_QT_RTTHREAD_GALLERY_DEMO
    bool "Qt Quick Controls 2 Gallery extra plugins"
    depends on PKG_QT_RTTHREAD_QUICK_CONTROLS2
    select PKG_QT_RTTHREAD_DEMO
    default n
    help
        The Gallery imports all bundled Controls 2 styles and Qt.labs.settings.
        Enable this only for that Qt Quick Controls 2 demo.

choice
    prompt "Version"
    default PKG_USING_QT_RTTHREAD_LATEST_VERSION
    help
        The package's vendored port directory pins the matching patch series.

config PKG_USING_QT_RTTHREAD_LATEST_VERSION
    bool "latest"
endchoice

config PKG_QT_RTTHREAD_VER
    string
    default "latest" if PKG_USING_QT_RTTHREAD_LATEST_VERSION

endif
```

## peripherals/hal-sdk/fm33/Kconfig
```kconfig
menu "FM33 Drivers"

# FM33LG0xx
source "$PKGS_DIR/packages/peripherals/hal-sdk/fm33/fm33lg0xx_fl_library/Kconfig"

# FM33LC0xx
# source "$PKGS_DIR/packages/peripherals/hal-sdk/fm33/fm33lc0xx_fl_library/Kconfig"

endmenu
```

## peripherals/hal-sdk/fm33/fm33lg0xx_fl_library/Kconfig
```kconfig
# Kconfig file for package fm33lg0xx_fl_library
menuconfig PKG_USING_FM33LG0XX_FL_LIBRARY
    bool "FM33LG0xx FL Library package"
    default n

if PKG_USING_FM33LG0XX_FL_LIBRARY

    config PKG_FM33LG0XX_FL_LIBRARY_PATH
        string
        default "/packages/peripherals/hal-sdk/fm33/fm33lg0xx_fl_library"

    choice
        prompt "Version"
        help
            Select the package version

        config PKG_USING_FM33LG0XX_FL_LIBRARY_V235
            bool "v2.3.5"

        config PKG_USING_FM33LG0XX_FL_LIBRARY_LATEST_VERSION
            bool "latest"
    endchoice

    config PKG_FM33LG0XX_FL_LIBRARY_VER
       string
       default "v2.3.5"    if PKG_USING_FM33LG0XX_FL_LIBRARY_V235
       default "latest"    if PKG_USING_FM33LG0XX_FL_LIBRARY_LATEST_VERSION

endif
```

## peripherals/hal-sdk/stm32/stm32n657xx_fsbl/Kconfig
```kconfig
# Kconfig file for package stm32n657xx_fsbl
menuconfig PKG_USING_STM32N657xx_FSBL
    bool "STM32 N657xx FSBL package"
    default n

if PKG_USING_STM32N657xx_FSBL

    config PKG_STM32N657xx_FSBL_PATH
        string
        default "/packages/peripherals/hal-sdk/stm32/stm32n657xx_fsbl"

    choice
        prompt "Version"
        help
            Select the package version

        config PKG_USING_STM32N657xx_FSBL_LATEST_VERSION
            bool "latest"
    endchoice

    config PKG_STM32N657xx_FSBL_VER
       string
       default "latest"    if PKG_USING_STM32N657xx_FSBL_LATEST_VERSION

endif
```
