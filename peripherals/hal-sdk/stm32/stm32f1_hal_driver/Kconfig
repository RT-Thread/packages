## peripherals/ikunLed/Kconfig
```kconfig
# Kconfig file for package ikunLed
menuconfig PKG_USING_IKUNLED
    bool "ikunLed: A Led driver based on char device"
    select RT_USING_PIN
    default n
    help
        Enable this option to use the IKUNLED package.

if PKG_USING_IKUNLED  
    config PKG_IKUNLED_PATH
        string
        default "/packages/peripherals/ikunLed"

    choice
        prompt "Version"
        default PKG_USING_IKUNLED_LATEST_VERSION
        help
            Select the package version

        config PKG_USING_IKUNLED_110_VERSION
            bool "v1.1.0"
        config PKG_USING_IKUNLED_LATEST_VERSION
            bool "latest"
    endchoice

    config PKG_IKUNLED_VER
       string
       default "v1.1.0" if PKG_USING_IKUNLED_110_VERSION
	   default "latest" if PKG_USING_IKUNLED_LATEST_VERSION
       
    config USING_IKUNLED_DEMO
        bool "Enable IKUNLED Demo (example folder)"
        default n
        help
            Enable this option to compile the example code in the "example" folder.

    if USING_IKUNLED_DEMO
        config IKUNLED_DEMO_NAME
            string "IKUNLED Demo Name"
            default "ledX"
            help
                Configure the name identifier for the IKUNLED demo.

        config IKUNLED_DEMO_PIN
            string "IKUNLED Demo Control Pin"
            default "PB.12"
            help
                Configure the GPIO pin (format: Port.Pin, e.g., PB.12).

        choice
            prompt "IKUNLED Demo Active Level"
            default IKUNLED_DEMO_ACTIVE_HIGH

            config IKUNLED_DEMO_ACTIVE_LOW
                bool "Low level active (0)"

            config IKUNLED_DEMO_ACTIVE_HIGH
                bool "High level active (1)"
        endchoice

        config IKUNLED_DEMO_ACTIVE_LEVEL
            int
            default 1 if IKUNLED_DEMO_ACTIVE_HIGH
            default 0 if IKUNLED_DEMO_ACTIVE_LOW
            default 1
    endif  
endif 
```

## peripherals/ili9341/Kconfig
```kconfig
# Kconfig file for package ILI9341
menuconfig PKG_USING_ILI9341
    depends on  RT_VER_NUM >= 0x50000
    bool "TFT-LCD ILI9341 SPI screen driver software package"
    default n
    select RT_USING_PIN
    select RT_USING_SPI

if PKG_USING_ILI9341

    config PKG_ILI9341_PATH
        string
        default "/packages/peripherals/ili9341"

    config PKG_ILI_9341_SPI_BUS_NAME
        string "spi bus name"
        default "spi1"

    config PKG_ILI_9341_SPI_DEVICE_NAME
            string "spi device name"
            default "spi10"

    config PKG_ILI_9341_WIDTH
        int "Width of the LCD display"
        default 240

    config PKG_ILI_9341_HEIGHT
        int "Height of the LCD display"
        default 320

    config PKG_ILI_9341_DC_PIN
        int "DC pin connected to the LCD display"
        default -1

    config PKG_ILI_9341_RES_PIN
        int "RESET pin connected to the LCD display"
        default -1

    config PKG_ILI_9341_CS_PIN
        int "CS pin connected to the LCD display"
        default -1

    config PKG_ILI_9341_BLK_PIN
        int "Backlight pin connected to the LCD display"
        default -1
    choice
        prompt "Version"
        default PKG_USING_ILI9341_LATEST_VERSION
        help
            Select the package version

        config PKG_USING_ILI9341_V100
            bool "v1.0.0"

        config PKG_USING_ILI9341_LATEST_VERSION
            bool "latest"
    endchoice

    config PKG_ILI9341_VER
       string
       default "v1.0.0"    if PKG_USING_ILI9341_V100
       default "latest"    if PKG_USING_ILI9341_LATEST_VERSION

endif
```

## peripherals/ins5t8025/Kconfig
```kconfig
# Kconfig file for package ins5t8025
menuconfig PKG_USING_INS5T8025
    bool "ins5t8025: hardware RTC chip driver package based on soft IIC"
    default n
    select RT_USING_I2C
    help
        A driver package for hardware RTC chip INS5T8025 on IIC bus

if PKG_USING_INS5T8025
    config PKG_INS5T8025_PATH
        string
        default "/packages/peripherals/ins5t8025"

    choice
        prompt "Version"
        default PKG_USING_INS5T8025_LATEST_VERSION
        help
            Select the package version

        config PKG_USING_INS5T8025_LATEST_VERSION
            bool "latest"
    endchoice

    config PKG_INS5T8025_VER
       string
       default "latest" if PKG_USING_INS5T8025_LATEST_VERSION
    config INS5T8025_I2C_BUS
        string "name of IIC bus for INS5T8025"
        default "i2c2_sw"
        help
            Set INS5T8025 I2C bus.

    config INS5T8025_ALARM_INT_PIN
        string "INS5T8025 ALARM INT Pin"
        default "PE.4"
        help
            Configure the GPIO pin (format: Port.Pin, e.g., PB.12).

    config USING_INS5T8025_DEMO
        bool "Enable INS5T8025 Demo (example folder)"
        default n
        help
            Enable this option to compile the example code in the "example" folder.
endif
```

## peripherals/io_input_filter/Kconfig
```kconfig
# Kconfig file for package io_input_filter
menuconfig PKG_USING_IO_INPUT_FILTER
    bool "IO Input Filter: I/O input software filter module"
    select RT_USING_PIN
    select RT_USING_TIMER_SOFT
    default n

if PKG_USING_IO_INPUT_FILTER

    config PKG_IO_INPUT_FILTER_PATH
        string
        default "/packages/peripherals/io_input_filter"

    config IIF_TIMES
        int "Filter times"
        default 10

    config IIF_PERIOD
        int "Filter period(ms)"
        default 5

    config IIF_EXAMPLE
        bool "Example"
        default n

    choice
        prompt "Version"
        default PKG_USING_IO_INPUT_FILTER_V200
        help
            Select the package version

        config PKG_USING_IO_INPUT_FILTER_V100
            bool "v1.0.0"

        config PKG_USING_IO_INPUT_FILTER_V200
            bool "v2.0.0"

        config PKG_USING_IO_INPUT_FILTER_LATEST_VERSION
            bool "latest"
    endchoice

    config PKG_IO_INPUT_FILTER_VER
       string
       default "v1.0.0"    if PKG_USING_IO_INPUT_FILTER_V100
       default "v2.0.0"    if PKG_USING_IO_INPUT_FILTER_V200
       default "latest"    if PKG_USING_IO_INPUT_FILTER_LATEST_VERSION

endif
```

## peripherals/irOnUart/Kconfig
```kconfig
# Kconfig file for package irOnUart
menuconfig PKG_USING_IRUART
    bool "irOnUart: infrared UART package"
    default n
    help
        Enable infrared UART package..

if PKG_USING_IRUART
    config PKG_IRUART_PATH
        string
        default "/packages/peripherals/irOnUart"

    choice
        prompt "Version"
        default PKG_USING_IRUART_LATEST_VERSION
        help
            Select the package version

    config PKG_USING_IRUART_V100
        bool "v1.0.0"

    config PKG_USING_IRUART_LATEST_VERSION
        bool "latest"
endchoice

    config PKG_IRUART_VER
       string
       default "v1.0.0" if PKG_USING_IRUART_V100
       default "latest" if PKG_USING_IRUART_LATEST_VERSION

    config IR_USART_NAME
        string "Infrared UART name"
        default "uart4"
        help
            UART name for infrared .

    config IR_PWM_NAME
        string "Infrared PWM name"
        default "pwm1"
        help
            PWM name for infrared .

    config IR_PWM_CHAN
        int "Infrared PWM channel"
        default 4
        help
            PWM channel for infrared .
     
endif
```

## peripherals/ist8310/Kconfig
```kconfig
# drivers/sensors/ist8310/Kconfig

menuconfig PKG_USING_IST8310
    bool "IST8310: 3-axis magnetometer driver package"
    default n
    select RT_USING_I2C
    help
        A driver package for IST8310 3-axis magnetometer

if PKG_USING_IST8310

    config PKG_IST8310_PATH
        string
        default "/packages/peripherals/ist8310"

    choice
        prompt "Version"
        default PKG_USING_IST8310_LATEST_VERSION
        help
            Select the package version

        config PKG_USING_IST8310_LATEST_VERSION
            bool "latest"
    endchoice

    config PKG_IST8310_VER
        string
        default "latest" if PKG_USING_IST8310_LATEST_VERSION

    config PKG_USING_IST8310_SAMPLE
        bool "Enable ist8310 sample"
        default n
        if PKG_USING_IST8310_SAMPLE
            config IST8310_SAMPLE_I2C_DEV_NAME
            string "i2c dev name with ist8310"
            default "i2c2"
        endif

    config IST8310_USING_MAG
        bool "Enable ist8310 mag"
        default y
        help
            Enable magnetometer function

    config IST8310_USING_SOFT_FILTER
        bool "Enable software filter"
        default n
        depends on IST8310_USING_MAG
        help
            Enable software filter for smoothing data

    if IST8310_USING_SOFT_FILTER
        config IST8310_SAMPLE_PERIOD
            int "Sample period (ms)"
            default 100
            range 10 1000
            help
                Set the sampling period in milliseconds

        config IST8310_AVERAGE_TIMES
            int "Average times"
            default 5
            range 1 20
            help
                Set the number of samples for averaging
    endif
endif
```
