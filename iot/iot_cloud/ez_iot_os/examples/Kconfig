## iot/iot_cloud/tencent-iotkit/Kconfig
```kconfig
menuconfig PKG_USING_TENCENT_IOTKIT
    bool "Tencent-iotkit:  Tencent Cloud SDK for IoT platform"
    select RT_USING_SAL
    select SAL_USING_POSIX
    default n

if PKG_USING_TENCENT_IOTKIT

    config PKG_TENCENT_IOTKIT_PATH
        string
        default "/packages/iot/iot_cloud/tencent-iotkit"

   choice
        prompt "Select Auth Mode"
        help
            Select Tencentyun Auth Mode
                     
        config PKG_USING_TENCENT_IOTKIT_IS_SING
            bool "AUTH BY DYNAMIC SIGN"
            help
                AUTH BY DYNAMIC SIGN
				
        config PKG_USING_TENCENT_IOTKIT_IS_TOKEN
            bool "AUTH BY TOKEN"
            help
                AUTH BY TOKEN				
    endchoice 
	
    config PKG_USING_TENCENT_IOTKIT_PRODUCT_ID
        string "Config Product Id"
        default iot-1l60dtl0  	

    config PKG_USING_TENCENT_IOTKIT_PRODUCT_KEY
        string "Config Product Key"
        default mqtt-1egtdjqza

    config PKG_USING_TENCENT_IOTKIT_DEVICE_NAME
        string "Config Device Name"
        default rt_thread_dev1        

    config PKG_USING_TENCENT_IOTKIT_DEVICE_SECRET
        string "Config Device Secret"
        default 92b0e676cdd608c4fb56386967613764

		
    config PKG_USING_TENCENT_IOTKIT_MQTT
        bool "Enable MQTT"
        default n 

    if PKG_USING_TENCENT_IOTKIT_MQTT
		choice
			prompt "Select MQTT data type"
			help
				Select MQTT data type
				
			config PKG_USING_TENCENT_IOTKIT_MQTT_ADVANCED
				bool "Enable MQTT Advanced"
				default y
			config PKG_USING_TENCENT_IOTKIT_MQTT_BASIC
				bool "Enable MQTT Basic"
				default n
		endchoice

		config PKG_USING_TENCENT_IOTKIT_MQTT_TLS
				bool "Enable MQTT SSL"
				default n
				select PKG_USING_MBEDTLS	
    endif

    config PKG_USING_TENCENT_IOTKIT_COAP
        bool "Enable COAP"
        default n
		
    if PKG_USING_TENCENT_IOTKIT_COAP
		choice
			prompt "Select COAP data type"
			help
				Select COAP data type
				
			config PKG_USING_TENCENT_IOTKIT_COAP_ADVANCED
				bool "Enable COAP Advanced"
				default y
			config PKG_USING_TENCENT_IOTKIT_COAP_BASIC
				bool "Enable COAP Basic"
				default n
		endchoice

		config PKG_USING_TENCENT_IOTKIT_COAP_DTLS
				bool "Enable COAP SSL"
				default n
				select PKG_USING_MBEDTLS	
    endif
	
    config PKG_USING_TENCENT_IOTKIT_SCENARIOS
        bool "Enable SCENARIOS"
        default n

    if PKG_USING_TENCENT_IOTKIT_SCENARIOS			   
        choice  
			prompt "Select SCENARIOS"
            help
               Select SCENARIOS
            config PKG_USING_TENCENT_IOTKIT_OTA
                bool "Use Scenario OTA"
              
            config PKG_USING_TENCENT_IOTKIT_SMARTBOX
                bool "Use Scenario SMARTBOX"
				
			config PKG_USING_TENCENT_IOTKIT_LIGHT
                bool "Use Scenario LIGHT"	
        endchoice
    endif
	
	config PKG_USING_TENCENT_IOTKIT_HTTP
        bool "Enable HTTP"
        default n

    choice
        prompt "Version"
        default PKG_USING_TENCENT_IOTKIT_LATEST_VERSION
        help
            Select the tencent-iotkit version

        config PKG_USING_TENCENT_IOTKIT_LATEST_VERSION
            bool "latest"
		
		config PKG_USING_TENCENT_IOTKIT_V29
            bool "v2.9"	
            
        config PKG_USING_TENCENT_IOTKIT_V26
            bool "v2.6"
    endchoice

    config PKG_TENCENT_IOTKIT_VER
       string
	   default "v2.6"    if PKG_USING_TENCENT_IOTKIT_V26
       default "v2.9"    if PKG_USING_TENCENT_IOTKIT_V29
       default "latest"    if PKG_USING_TENCENT_IOTKIT_LATEST_VERSION
    
endif
```

## iot/iot_cloud/ucloud_iot_sdk/Kconfig
```kconfig
# Kconfig file for package ucloud_iot_sdk
menuconfig PKG_USING_UCLOUD_IOT_SDK
    bool "ucloud_iot_sdk: Ucloud iot sdk for uiot-core platform."
    select RT_USING_SAL
    default n

if PKG_USING_UCLOUD_IOT_SDK

    config PKG_UCLOUD_IOT_SDK_PATH
        string
        default "/packages/iot/iot_cloud/ucloud_iot_sdk"

    menu "Ucloud Device Config"
        menuconfig PKG_USING_UCLOUD_IOT_SDK_CONFIG
            bool "Device Config"
            default y
            config PKG_USING_UCLOUD_IOT_SDK_PRODUCT_SN
                string "Config Product SN"
                default "produce_sn"

            config PKG_USING_UCLOUD_IOT_SDK_PRODUCT_SECRET
                string "Config Product Secret"
                default "product_secret"
                help
                    dynamic register device needed

            config PKG_USING_UCLOUD_IOT_SDK_DEVICE_SN
                string "Config Device SN"
                default "device_sn"

            config PKG_USING_UCLOUD_IOT_SDK_DEVICE_SECRET
                string "Config Device Secret"
                default "device_secret"
                help
                    static register device needed
    endmenu	

    config PKG_USING_UCLOUD_MQTT
        bool "Enable Mqtt Link uiot-core Platform"
        default n

    config PKG_USING_UCLOUD_MQTT_SAMPLE
        bool "Enable Ucloud Mqtt Sample"
        depends on PKG_USING_UCLOUD_MQTT
        default n

    config PKG_USING_UCLOUD_MQTT_DYNAMIC_AUTH_SAMPLE
        bool "Enable Ucloud Mqtt Dynamic Auth Sample"
        depends on PKG_USING_UCLOUD_MQTT
        default n

    config PKG_USING_UCLOUD_HTTP
        bool "Enable Http Link uiot-core Platform"
        select PKG_USING_UCLOUD_TLS
        default n

    config PKG_USING_UCLOUD_HTTP_PUBLISH_SAMPLE
        bool "Enable Ucloud Http Publish Sample"
        depends on PKG_USING_UCLOUD_HTTP
        default n

    config PKG_USING_UCLOUD_HTTP_UPLOAD_FILE_SAMPLE
        bool "Enable Ucloud Http Upload File Sample"
        depends on PKG_USING_UCLOUD_HTTP
        default n

    config PKG_USING_UCLOUD_SHADOW
        bool "Enable Shadow"
        depends on PKG_USING_UCLOUD_MQTT
        default n

    config PKG_USING_UCLOUD_SHADOW_SAMPLE
        bool "Enable Ucloud Shadow Sample"
        depends on PKG_USING_UCLOUD_SHADOW
        default n

    config PKG_USING_UCLOUD_DEV_MODEL
        bool "Enable Dev Model"
        depends on PKG_USING_UCLOUD_MQTT
        default n

    config PKG_USING_UCLOUD_DEV_MODEL_SAMPLE
        bool "Enable Ucloud Dev Model Sample"
        depends on PKG_USING_UCLOUD_DEV_MODEL
        default n

    config PKG_USING_UCLOUD_OTA
        bool "Enable Ota"
        depends on PKG_USING_UCLOUD_MQTT
        default n
        select PKG_USING_FAL

    config PKG_USING_UCLOUD_OTA_SAMPLE
        bool "Enable Ucloud Ota Sample"
        depends on PKG_USING_UCLOUD_OTA
        default n

    config PKG_USING_UCLOUD_TLS
        bool "Enable Tls"
        depends on PKG_USING_UCLOUD_MQTT || PKG_USING_UCLOUD_HTTP
        default n
        select PKG_USING_MBEDTLS

    config PKG_USING_UCLOUD_DEBUG
        bool "Enable Ucloud Debug"
        default n

    choice
        prompt "Version"
        default PKG_USING_UCLOUD_IOT_SDK_LATEST_VERSION
        help
            Select the package version

        config PKG_USING_UCLOUD_IOT_SDK_V101
            bool "v1.0.1"

        config PKG_USING_UCLOUD_IOT_SDK_LATEST_VERSION
            bool "latest"
    endchoice
          
    config PKG_UCLOUD_IOT_SDK_VER
        string
        default "v1.0.1"    if PKG_USING_UCLOUD_IOT_SDK_V101
        default "latest"    if PKG_USING_UCLOUD_IOT_SDK_LATEST_VERSION

endif
```

## iot/ipmsg/Kconfig
```kconfig
# Kconfig file for package ipmsg
menuconfig PKG_USING_IPMSG
    bool "ipmsg: A LAN instant messaging implement in RT-Thread"
    default n
    select RT_USING_LWIP

if PKG_USING_IPMSG

    config PKG_IPMSG_PATH
        string
        default "/packages/iot/ipmsg"

    config IPMSG_MSGRS_ENABLE
        bool "Enable text msg send/recv"
        default y

    config IPMSG_FILERECV_ENABLE
        bool "Enable file recv"
        default n

    config IPMSG_MSG_BUFSZ
        int "Set msg send/recv frame size"
        default 300

    choice
        prompt "Version"
        default PKG_USING_IPMSG_LATEST_VERSION
        help
            Select the package version

        config PKG_USING_IPMSG_V100
            bool "v1.0.0"

        config PKG_USING_IPMSG_LATEST_VERSION
            bool "latest"
    endchoice

    config PKG_IPMSG_VER
       string
       default "v1.0.0"    if PKG_USING_IPMSG_V100
       default "latest"    if PKG_USING_IPMSG_LATEST_VERSION

endif
```

## iot/kawaii-mqtt/Kconfig
```kconfig
# Kconfig file for package kawaii_mqtt
menuconfig PKG_USING_KAWAII_MQTT
    bool "kawaii-mqtt: a mqtt client based on the socket API, support QoS2, mbedtls."
    default n

if PKG_USING_KAWAII_MQTT

    config PKG_KAWAII_MQTT_PATH
        string
        default "/packages/iot/kawaii-mqtt"

    config KAWAII_MQTT_NETWORK_TYPE_TLS
        bool "enable mbedtls"
        default n

    if KAWAII_MQTT_NETWORK_TYPE_TLS
        config KAWAII_MQTT_TLS_HANDSHAKE_TIMEOUT
            int "mbedtls handshake timeout"
            default 5000
    endif

    config KAWAII_MQTT_NETSOCKET_USE_SAL
        bool "using SAL"
        default n

    config KAWAII_MQTT_LOG_IS_SALOF
        bool "enable salof"
        default y

    if KAWAII_MQTT_LOG_IS_SALOF
        config SALOF_USING_LOG
            bool "salof using log"
            default y

        if SALOF_USING_LOG
            config SALOF_USING_SALOF
                bool "using salof"
                default y

            if !SALOF_USING_IDLE_HOOK
                if SALOF_USING_SALOF
                    config SALOF_BUFF_SIZE
                        int "salof buff size"
                        default 512

                    config SALOF_FIFO_SIZE
                        int "salof fifo size"
                        default 2048

                    config SALOF_TASK_STACK_SIZE
                        int "salof task size"
                        default 2048

                    config SALOF_TASK_TICK
                        int "salof task tick"
                        default 50
                endif
            endif

            config SALOF_LOG_COLOR
                bool "using color"
                default n

            config SALOF_LOG_TS
                bool "using timestamp"
                default n

            config SALOF_LOG_TAR
                bool "using tar"
                default n
                config SALOF_USING_IDLE_HOOK
                    bool "using idle thread hook"
                    default n

            config SALOF_LOG_LEVEL
                    int "salof output log level"
                    default KAWAII_MQTT_LOG_LEVEL
        endif
    endif

    config KAWAII_MQTT_LOG_LEVEL
        int "select output log level"
        default 4
        help
            1 : KAWAII_MQTT_LOG_ERR_LEVEL
            2 : KAWAII_MQTT_LOG_WARN_LEVEL
            3 : KAWAII_MQTT_LOG_INFO_LEVEL
            4 : KAWAII_MQTT_LOG_DEBUG_LEVEL

    config KAWAII_MQTT_VERSION
        int "mqtt version, 4 is mqtt 3.1.1, 3 is mqtt 3.1"
        default 4

    config KAWAII_MQTT_KEEP_ALIVE_INTERVAL
        int "mqtt keep alive interver, unit: second"
        default 100

    config KAWAII_MQTT_THREAD_STACK_SIZE
        int "mqtt thread stack size"
        default 4096

    config KAWAII_MQTT_THREAD_PRIO
        int "mqtt thread priority"
        default 5

    config KAWAII_MQTT_THREAD_TICK
        int "mqtt thread tick"
        default 50

    config KAWAII_MQTT_MAX_PACKET_ID
        hex "mqtt max packet id"
        default 0xFFFE

    config KAWAII_MQTT_TOPIC_LEN_MAX
        int "mqtt max topic len"
        default 64

    config KAWAII_MQTT_ACK_HANDLER_NUM_MAX
        int "mqtt max handler number"
        default 64

    config KAWAII_MQTT_DEFAULT_BUF_SIZE
        int "mqtt default buffer size"
        default 1024

    config KAWAII_MQTT_DEFAULT_CMD_TIMEOUT
        int "mqtt default cmd timeout"
        default 4000

    config KAWAII_MQTT_MAX_CMD_TIMEOUT
        int "mqtt max cmd timeout"
        default 20000

    config KAWAII_MQTT_MIN_CMD_TIMEOUT
        int "mqtt min cmd timeout"
        default 1000

    config KAWAII_MQTT_RECONNECT_DEFAULT_DURATION
        int "mqtt default reconnect duratton"
        default 1000


    config PKG_USING_KAWAII_MQTT_TEST
        bool "enable kawaii mqtt test"
        default n

        if PKG_USING_KAWAII_MQTT_TEST
            config KAWAII_MQTT_HOST
                string "mqtt host"
                default "jiejie01.top"

            config KAWAII_MQTT_PORT
                string "mqtt port"
                default "1883"

            config KAWAII_MQTT_CLIENTID
                string "mqtt client id"
                default "rtthread001"

            config KAWAII_MQTT_USERNAME
                string "mqtt username"
                default "rt-thread"

            config KAWAII_MQTT_PASSWORD
                string "mqtt password"
                default "rt-thread"

            config KAWAII_MQTT_SUBTOPIC
                string "mqtt subscribe topic"
                default "rtt-sub"

            config KAWAII_MQTT_PUBTOPIC
                string "mqtt publish topic"
                default "rtt-pub"
        endif

    choice
        prompt "Version"
        default PKG_USING_KAWAII_MQTT_LATEST_VERSION
        help
            Select the package version

        config PKG_USING_KAWAII_MQTT_V100
            bool "v1.0.0"

        config PKG_USING_KAWAII_MQTT_V102
            bool "v1.0.2"

        config PKG_USING_KAWAII_MQTT_V110
            bool "v1.1.0"

        config PKG_USING_KAWAII_MQTT_LATEST_VERSION
            bool "latest"
    endchoice

    config PKG_KAWAII_MQTT_VER
       string
       default "v1.0.0"    if PKG_USING_KAWAII_MQTT_V100
       default "v1.0.2"    if PKG_USING_KAWAII_MQTT_V102
       default "v1.1.0"    if PKG_USING_KAWAII_MQTT_V110
       default "latest"    if PKG_USING_KAWAII_MQTT_LATEST_VERSION

endif
```
