## arduino/devicecontrol/Kconfig
```kconfig
menu "Device Control"

source "$PKGS_DIR/packages/arduino/devicecontrol/Adafruit-PCF8574/Kconfig"
source "$PKGS_DIR/packages/arduino/devicecontrol/Adafruit-PCA9685/Kconfig"
source "$PKGS_DIR/packages/arduino/devicecontrol/Adafruit-TPA2016/Kconfig"
source "$PKGS_DIR/packages/arduino/devicecontrol/Adafruit-DRV2605/Kconfig"
source "$PKGS_DIR/packages/arduino/devicecontrol/Adafruit-DS1841/Kconfig"
source "$PKGS_DIR/packages/arduino/devicecontrol/Adafruit-DS3502/Kconfig"
source "$PKGS_DIR/packages/arduino/devicecontrol/Seeed-PCF85063TP/Kconfig"

endmenu
```

## arduino/devicecontrol/Seeed-PCF85063TP/Kconfig
```kconfig
# Kconfig file for package Seeed-PCF85063TP
menuconfig PKG_USING_ARDUINO_SEEED_PCF85063TP
    bool "Seeed PCF85063TP: High Precision RTC"
    select PKG_USING_RTDUINO
    select RTDUINO_USING_WIRE
    default n

if PKG_USING_ARDUINO_SEEED_PCF85063TP

    config PKG_ARDUINO_SEEED_PCF85063TP_PATH
        string
        default "/packages/arduino/devicecontrol/Seeed-PCF85063TP"

    choice
        prompt "Version"
        default PKG_USING_ARDUINO_SEEED_PCF85063TP_LATEST_VERSION
        help
            Select the package Version

        config PKG_USING_ARDUINO_SEEED_PCF85063TP_LATEST_VERSION
            bool "latest"
    endchoice

    config PKG_ARDUINO_SEEED_PCF85063TP_VER
       string
       default "latest"    if PKG_USING_ARDUINO_SEEED_PCF85063TP_LATEST_VERSION

endif
```

## arduino/display/Adafruit-GFX-Library/Kconfig
```kconfig
# Kconfig file for package Adafruit-GFX-Library
menuconfig PKG_USING_ARDUINO_ADAFRUIT_GFX_LIBRARY
    bool "Adafruit-GFX-Library: Adafruit GFX graphics core library"
    select PKG_USING_RTDUINO
    select RTDUINO_USING_WIRE
    select RTDUINO_USING_SPI
    select PKG_USING_ARDUINO_ADAFRUIT_BUSIO
    default n

if PKG_USING_ARDUINO_ADAFRUIT_GFX_LIBRARY

    config PKG_ARDUINO_ADAFRUIT_GFX_LIBRARY_PATH
        string
        default "/packages/arduino/display/Adafruit-GFX-Library"

    choice
        prompt "Version"
        help
            Select the package version

        config PKG_USING_ARDUINO_ADAFRUIT_GFX_LIBRARY_LATEST_VERSION
            bool "latest"
    endchoice

    config PKG_ARDUINO_ADAFRUIT_GFX_LIBRARY_VER
       string
       default "latest"    if PKG_USING_ARDUINO_ADAFRUIT_GFX_LIBRARY_LATEST_VERSION

endif
```

## arduino/display/Adafruit-ILI9341/Kconfig
```kconfig
# Kconfig file for package Adafruit-ILI9341
menuconfig PKG_USING_ARDUINO_ADAFRUIT_ILI9341
    bool "Adafruit ILI9341: ILI9341 display Arduino driver"
    default n

if PKG_USING_ARDUINO_ADAFRUIT_ILI9341

    config PKG_ARDUINO_ADAFRUIT_ILI9341_PATH
        string
        default "/packages/arduino/display/Adafruit-ILI9341"

    choice
        prompt "Version"
        help
            Select the package version

        config PKG_USING_ARDUINO_ADAFRUIT_ILI9341_LATEST_VERSION
            bool "latest"
    endchoice

    config PKG_ARDUINO_ADAFRUIT_ILI9341_VER
       string
       default "latest"    if PKG_USING_ARDUINO_ADAFRUIT_ILI9341_LATEST_VERSION

endif
```

## arduino/display/Adafruit-SSD1306/Kconfig
```kconfig
# Kconfig file for package Adafruit-SSD1306
menuconfig PKG_USING_ARDUINO_ADAFRUIT_SSD1306
    bool "Adafruit SSD1306: SSD1306 monochrome 128x64 and 128x32 OLEDs driver"
    select PKG_USING_RTDUINO
    select PKG_USING_ARDUINO_ADAFRUIT_GFX_LIBRARY
    default n

if PKG_USING_ARDUINO_ADAFRUIT_SSD1306

    config PKG_ARDUINO_ADAFRUIT_SSD1306_PATH
        string
        default "/packages/arduino/display/Adafruit-SSD1306"

    choice
        prompt "Version"
        help
            Select the package version

        config PKG_USING_ARDUINO_ADAFRUIT_SSD1306_LATEST_VERSION
            bool "latest"
    endchoice

    config PKG_ARDUINO_ADAFRUIT_SSD1306_VER
       string
       default "latest"    if PKG_USING_ARDUINO_ADAFRUIT_SSD1306_LATEST_VERSION

endif
```

## arduino/display/Adafruit-ST7735/Kconfig
```kconfig
# Kconfig file for package Adafruit-ST7735
menuconfig PKG_USING_ARDUINO_ADAFRUIT_ST7735
    bool "Adafruit ST7735 and ST7789 SPI displays driver"
    select PKG_USING_RTDUINO
    select PKG_USING_ARDUINO_ADAFRUIT_GFX_LIBRARY
    default n

if PKG_USING_ARDUINO_ADAFRUIT_ST7735

    config PKG_ARDUINO_ADAFRUIT_ST7735_PATH
        string
        default "/packages/arduino/display/Adafruit-ST7735"

    choice
        prompt "Version"
        help
            Select the package version

        config PKG_USING_ARDUINO_ADAFRUIT_ST7735_LATEST_VERSION
            bool "latest"
    endchoice

    config PKG_ARDUINO_ADAFRUIT_ST7735_VER
       string
       default "latest"    if PKG_USING_ARDUINO_ADAFRUIT_ST7735_LATEST_VERSION

endif
```

## arduino/display/Kconfig
```kconfig
menu "Display"

source "$PKGS_DIR/packages/arduino/display/Adafruit-GFX-Library/Kconfig"
source "$PKGS_DIR/packages/arduino/display/U8g2_Arduino/Kconfig"
source "$PKGS_DIR/packages/arduino/display/TFT_eSPI/Kconfig"
source "$PKGS_DIR/packages/arduino/display/Adafruit-ST7735/Kconfig"
source "$PKGS_DIR/packages/arduino/display/Adafruit-SSD1306/Kconfig"
source "$PKGS_DIR/packages/arduino/display/Adafruit-ILI9341/Kconfig"
source "$PKGS_DIR/packages/arduino/display/Seeed-TM1637/Kconfig"

endmenu
```

## arduino/display/Seeed-TM1637/Kconfig
```kconfig
# Kconfig file for package Seeed-TM1637
menuconfig PKG_USING_SEEED_TM1637
    bool "Seeed TM1637: 4 digit display"
    default n

if PKG_USING_SEEED_TM1637

    config PKG_SEEED_TM1637_PATH
        string
        default "/packages/arduino/display/Seeed-TM1637"

    choice
        prompt "Version"
        default PKG_USING_SEEED_TM1637_LATEST_VERSION
        help
            Select the package version

        config PKG_USING_SEEED_TM1637_LATEST_VERSION
            bool "latest"
    endchoice

    config PKG_SEEED_TM1637_VER
       string
       default "latest"    if PKG_USING_SEEED_TM1637_LATEST_VERSION

endif
```

## arduino/display/TFT_eSPI/Kconfig
```kconfig
# Kconfig file for package TFT_eSPI
menuconfig PKG_USING_ARDUINO_TFT_ESPI
    bool "TFT_eSPI: TFT graphics library for Arduino processors with performance optimisation"
    select PKG_USING_RTDUINO
    select RTDUINO_USING_SPI
    default n

if PKG_USING_ARDUINO_TFT_ESPI

    config PKG_ARDUINO_TFT_ESPI_PATH
        string
        default "/packages/arduino/display/TFT_eSPI"

    choice
        prompt "Version"
        help
            Select the package version

        config PKG_USING_ARDUINO_TFT_ESPI_LATEST_VERSION
            bool "latest"
    endchoice

    config PKG_ARDUINO_TFT_ESPI_VER
       string
       default "latest"    if PKG_USING_ARDUINO_TFT_ESPI_LATEST_VERSION

endif
```

## arduino/display/U8g2_Arduino/Kconfig
```kconfig
# Kconfig file for package U8g2_Arduino
menuconfig PKG_USING_ARDUINO_U8G2
    bool "U8g2_Arduino: Arduino Monochrome Graphics Library"
    select PKG_USING_RTDUINO
    select RTDUINO_USING_WIRE
    select RTDUINO_USING_SPI
    default n

if PKG_USING_ARDUINO_U8G2

    config PKG_ARDUINO_U8G2_PATH
        string
        default "/packages/arduino/display/U8g2_Arduino"

    choice
        prompt "Version"
        default PKG_USING_ARDUINO_U8G2_LATEST_VERSION
        help
            Select the package version

        config PKG_USING_ARDUINO_U8G2_LATEST_VERSION
            bool "latest"
    endchoice

    config PKG_ARDUINO_U8G2_VER
       string
       default "latest"    if PKG_USING_ARDUINO_U8G2_LATEST_VERSION

endif
```

## arduino/display/U8glib_Arduino/Kconfig
```kconfig
# Kconfig file for package U8glib_Arduino
menuconfig PKG_USING_ARDUINO_U8GLIB_ARDUINO
    bool "U8glib: A graphics library with support for many different monochrome displays."
    default n

if PKG_USING_ARDUINO_U8GLIB_ARDUINO

    config PKG_ARDUINO_U8GLIB_ARDUINO_PATH
        string
        default "/packages/arduino/display/U8glib_Arduino"

    choice
        prompt "Version"
        help
            Select the package version

        config PKG_USING_ARDUINO_U8GLIB_ARDUINO_LATEST_VERSION
            bool "latest"

    endchoice

    config PKG_ARDUINO_U8GLIB_ARDUINO_VER
       string
       default "latest"    if PKG_USING_ARDUINO_U8GLIB_ARDUINO_LATEST_VERSION

endif
```

## arduino/other/Adafruit-MFRC630/Kconfig
```kconfig
# Kconfig file for package Adafruit-MFRC630
menuconfig PKG_USING_ARDUINO_ADAFRUIT_MFRC630
    bool "Adafruit MFRC630 RFID Front-End Breakout Board"
    select PKG_USING_RTDUINO
    select RTDUINO_USING_WIRE
    select RTDUINO_USING_SPI
    default n

if PKG_USING_ARDUINO_ADAFRUIT_MFRC630

    config PKG_ARDUINO_ADAFRUIT_MFRC630_PATH
        string
        default "/packages/arduino/other/Adafruit-MFRC630"

    choice
        prompt "Version"
        default PKG_USING_ARDUINO_ADAFRUIT_MFRC630_LATEST_VERSION
        help
            Select the package version

        config PKG_USING_ARDUINO_ADAFRUIT_MFRC630_LATEST_VERSION
            bool "latest"
    endchoice

    config PKG_ARDUINO_ADAFRUIT_MFRC630_VER
       string
       default "latest"    if PKG_USING_ARDUINO_ADAFRUIT_MFRC630_LATEST_VERSION

endif
```

## arduino/other/Adafruit-Si5351/Kconfig
```kconfig
# Kconfig file for package Adafruit-Si5351
menuconfig PKG_USING_ARDUINO_ADAFRUIT_SI5351
    bool "Adafruit Si5351 Clock Generator Breakout"
    select PKG_USING_RTDUINO
    select RTDUINO_USING_WIRE
    select PKG_USING_ARDUINO_ADAFRUIT_BUSIO
    default n

if PKG_USING_ARDUINO_ADAFRUIT_SI5351

    config PKG_ARDUINO_ADAFRUIT_SI5351_PATH
        string
        default "/packages/arduino/other/Adafruit-Si5351"

    choice
        prompt "Version"
        default PKG_USING_ARDUINO_ADAFRUIT_SI5351_LATEST_VERSION
        help
            Select the package version

        config PKG_USING_ARDUINO_ADAFRUIT_SI5351_LATEST_VERSION
            bool "latest"
    endchoice

    config PKG_ARDUINO_ADAFRUIT_SI5351_VER
       string
       default "latest"    if PKG_USING_ARDUINO_ADAFRUIT_SI5351_LATEST_VERSION

endif
```

## arduino/other/Kconfig
```kconfig
menu "Other"

rsource "Adafruit-MFRC630/Kconfig"
rsource "Adafruit-Si5351/Kconfig"

endmenu
```

## arduino/projects/Arduino-Sensor-Kit/Kconfig
```kconfig
# Kconfig file for package Arduino_Sensor_Kit
menuconfig PKG_USING_ARDUINO_SENSOR_KIT
    bool "Arduino Sensor Kit Driver Library"
    select PKG_USING_RTDUINO
    select PKG_USING_ARDUINO_SEEED_LIS3DHTR
    select PKG_USING_ARDUINO_SEEED_BMP280
    select PKG_USING_ARDUINO_U8G2
    default n

if PKG_USING_ARDUINO_SENSOR_KIT

    config PKG_ARDUINO_SENSOR_KIT_PATH
        string
        default "/packages/arduino/projects/Arduino-Sensor-Kit"

    config PKG_USING_ARDUINO_SENSOR_KIT_DEMOS
        bool "Enable Arduino Sensor Kit Demos"
        default n

    choice
        prompt "Choose the Demo"
        depends on PKG_USING_ARDUINO_SENSOR_KIT_DEMOS

        config PKG_USING_ARDUINO_SENSOR_KIT_DEMO1
            bool "Demo1: the single-thread demo"

        config PKG_USING_ARDUINO_SENSOR_KIT_DEMO2
            bool "Demo2: the multi-threads demo"

    endchoice

    choice
        prompt "Version"
        default PKG_USING_ARDUINO_SENSOR_KIT_LATEST_VERSION
        help
            Select the package version

        config PKG_USING_ARDUINO_SENSOR_KIT_LATEST_VERSION
            bool "latest"
    endchoice

    config PKG_ARDUINO_SENSOR_KIT_VER
       string
       default "latest"    if PKG_USING_ARDUINO_SENSOR_KIT_LATEST_VERSION

endif
```

## arduino/projects/Kconfig
```kconfig
menu "Projects and Demos"

source "$PKGS_DIR/packages/arduino/projects/MsgQ-C-CPP-demo/Kconfig"
source "$PKGS_DIR/packages/arduino/projects/sketch-loader-demo/Kconfig"
source "$PKGS_DIR/packages/arduino/projects/UltrasoundRadar/Kconfig"
source "$PKGS_DIR/packages/arduino/projects/RTduino-SensorFusion-Shield/Kconfig"
source "$PKGS_DIR/packages/arduino/projects/NineinOne-Sensor-Shield/Kconfig"
source "$PKGS_DIR/packages/arduino/projects/Arduino-Sensor-Kit/Kconfig"
source "$PKGS_DIR/packages/arduino/projects/matlab-support-package/Kconfig"

endmenu
```

## arduino/projects/MsgQ-C-CPP-demo/Kconfig
```kconfig
# Kconfig file for package MsgQ-C-CPP-demo
menuconfig PKG_USING_ARDUINO_MSGQ_C_CPP_DEMO
    bool "Message Queue demo: communicate between Arduino sketches and RT-Thread typcial C threads"
    select PKG_USING_RTDUINO
    select RTDUINO_SUPPORT_FLOAT_STRING
    default n

if PKG_USING_ARDUINO_MSGQ_C_CPP_DEMO

    config PKG_ARDUINO_MSGQ_C_CPP_DEMO_USING_AHTX0
        bool "Use Adafruit AHT10/AHT20 sensor data in the demo"
        select PKG_USING_ARDUINO_ADAFRUIT_AHTX0
        default n

    config PKG_ARDUINO_MSGQ_C_CPP_DEMO_PATH
        string
        default "/packages/arduino/projects/MsgQ-C-CPP-demo"

    choice
        prompt "Version"
        help
            Select the package version

        config PKG_USING_ARDUINO_MSGQ_C_CPP_DEMO_LATEST_VERSION
            bool "latest"
    endchoice

    config PKG_ARDUINO_MSGQ_C_CPP_DEMO_VER
       string
       default "latest"    if PKG_USING_ARDUINO_MSGQ_C_CPP_DEMO_LATEST_VERSION

endif
```

## arduino/projects/NineinOne-Sensor-Shield/Kconfig
```kconfig
# Kconfig file for package NineinOne-Sensor-Shield
menuconfig PKG_USING_ARDUINO_NINEINONE_SENSOR_SHIELD
    bool "9 in 1 Sensor Shield Driver Library"
    select PKG_USING_RTDUINO
    select PKG_USING_ARDUINO_ADAFRUIT_DHT
    default n

if PKG_USING_ARDUINO_NINEINONE_SENSOR_SHIELD

    config PKG_ARDUINO_NINEINONE_SENSOR_SHIELD_PATH
        string
        default "/packages/arduino/projects/NineinOne-Sensor-Shield"

    choice
        prompt "Version"
        help
            Select the package version

        config PKG_USING_ARDUINO_NINEINONE_SENSOR_SHIELD_LATEST_VERSION
            bool "latest"
    endchoice

    config PKG_ARDUINO_NINEINONE_SENSOR_SHIELD_VER
       string
       default "latest"    if PKG_USING_ARDUINO_NINEINONE_SENSOR_SHIELD_LATEST_VERSION

endif
```
