## peripherals/hal-sdk/mm32/mm32f5260x-hal-driver/Kconfig
```kconfig
# Kconfig file for package mm32f5260x-hal-driver
menuconfig PKG_USING_MM32F5260X_HAL_DRIVER
    bool "MM32F5260x HAL driver package"
    select PKG_USING_MM32F5260X_CMSIS
    default n

if PKG_USING_MM32F5260X_HAL_DRIVER

    config PKG_MM32F5260X_HAL_DRIVER_PATH
        string
        default "/packages/peripherals/hal-sdk/mm32/mm32f5260x-hal-driver"

    choice
        prompt "Version"
        help
            Select the package version

        config PKG_USING_MM32F5260X_HAL_DRIVER_LATEST_VERSION
            bool "latest"
    endchoice

    config PKG_MM32F5260X_HAL_DRIVER_VER
       string
       default "latest"    if PKG_USING_MM32F5260X_HAL_DRIVER_LATEST_VERSION

endif
```

## peripherals/hal-sdk/mm32/mm32l0xx-cmsis/Kconfig
```kconfig
# Kconfig file for package mm32l0xx-cmsis
menuconfig PKG_USING_MM32L0XX_CMSIS
    bool "MM32L0xx CMSIS package"
    select PKG_USING_CMSIS_CORE
    default n

if PKG_USING_MM32L0XX_CMSIS

    config PKG_MM32L0XX_CMSIS_PATH
        string
        default "/packages/peripherals/hal-sdk/mm32/mm32l0xx-cmsis"

    choice
        prompt "Version"
        help
            Select the package version

        config PKG_USING_MM32L0XX_CMSIS_LATEST_VERSION
            bool "latest"
    endchoice

    config PKG_MM32L0XX_CMSIS_VER
       string
       default "latest"    if PKG_USING_MM32L0XX_CMSIS_LATEST_VERSION

endif
```

## peripherals/hal-sdk/mm32/mm32l0xx-hal-driver/Kconfig
```kconfig
# Kconfig file for package mm32l0xx-hal-driver
menuconfig PKG_USING_MM32L0XX_HAL_DRIVER
    bool "MM32L0xx HAL driver package"
    select PKG_USING_MM32L0XX_CMSIS
    default n

if PKG_USING_MM32L0XX_HAL_DRIVER

    config PKG_MM32L0XX_HAL_DRIVER_PATH
        string
        default "/packages/peripherals/hal-sdk/mm32/mm32l0xx-hal-driver"

    choice
        prompt "Version"
        help
            Select the package version

        config PKG_USING_MM32L0XX_HAL_DRIVER_LATEST_VERSION
            bool "latest"
    endchoice

    config PKG_MM32L0XX_HAL_DRIVER_VER
       string
       default "latest"    if PKG_USING_MM32L0XX_HAL_DRIVER_LATEST_VERSION

endif
```

## peripherals/hal-sdk/mm32/mm32l3xx-cmsis/Kconfig
```kconfig
# Kconfig file for package mm32l3xx-cmsis
menuconfig PKG_USING_MM32L3XX_CMSIS
    bool "MM32L3xx CMSIS package"
    select PKG_USING_CMSIS_CORE
    default n

if PKG_USING_MM32L3XX_CMSIS

    config PKG_MM32L3XX_CMSIS_PATH
        string
        default "/packages/peripherals/hal-sdk/mm32/mm32l3xx-cmsis"

    choice
        prompt "Version"
        help
            Select the package version

        config PKG_USING_MM32L3XX_CMSIS_LATEST_VERSION
            bool "latest"
    endchoice

    config PKG_MM32L3XX_CMSIS_VER
       string
       default "latest"    if PKG_USING_MM32L3XX_CMSIS_LATEST_VERSION

endif
```

## peripherals/hal-sdk/mm32/mm32l3xx-hal-driver/Kconfig
```kconfig
# Kconfig file for package mm32l3xx-hal-driver
menuconfig PKG_USING_MM32L3XX_HAL_DRIVER
    bool "MM32L3xx HAL driver package"
    select PKG_USING_MM32L3XX_CMSIS
    default n

if PKG_USING_MM32L3XX_HAL_DRIVER

    config PKG_MM32L3XX_HAL_DRIVER_PATH
        string
        default "/packages/peripherals/hal-sdk/mm32/mm32l3xx-hal-driver"

    choice
        prompt "Version"
        help
            Select the package version

        config PKG_USING_MM32L3XX_HAL_DRIVER_LATEST_VERSION
            bool "latest"
    endchoice

    config PKG_MM32L3XX_HAL_DRIVER_VER
       string
       default "latest"    if PKG_USING_MM32L3XX_HAL_DRIVER_LATEST_VERSION

endif
```

## peripherals/hal-sdk/n32/Kconfig
```kconfig
menu "N32 Drivers"

# N32H7xx
source "$PKGS_DIR/packages/peripherals/hal-sdk/n32/n32h7xx_std_driver/Kconfig"
source "$PKGS_DIR/packages/peripherals/hal-sdk/n32/n32h7xx_cmsis_driver/Kconfig"

# N32H49x
source "$PKGS_DIR/packages/peripherals/hal-sdk/n32/n32h49x_std_driver/Kconfig"
source "$PKGS_DIR/packages/peripherals/hal-sdk/n32/n32h49x_cmsis_driver/Kconfig"

# N32H47_48x
source "$PKGS_DIR/packages/peripherals/hal-sdk/n32/n32h47x_48x_std_driver/Kconfig"
source "$PKGS_DIR/packages/peripherals/hal-sdk/n32/n32h47x_48x_cmsis_driver/Kconfig"

endmenu
```

## peripherals/hal-sdk/n32/n32h47x_48x_cmsis_driver/Kconfig
```kconfig
# Kconfig file for package n32h47x_48x_cmsis_driver
menuconfig PKG_USING_N32H47X_48X_CMSIS_DRIVER
    bool "N32H47x_48x CMSIS driver package"
	select PKG_USING_CMSIS_CORE
    default n

if PKG_USING_N32H47X_48X_CMSIS_DRIVER

    config PKG_N32H47X_48X_CMSIS_DRIVER_PATH
        string
		default "/packages/peripherals/hal-sdk/n32/n32h47x_48x_cmsis_driver"

    choice
        prompt "Version"
        help
            Select the package version

        config PKG_USING_N32H47X_48X_CMSIS_DRIVER_LATEST_VERSION
            bool "latest"
    endchoice

    config PKG_N32H47X_48X_CMSIS_DRIVER_VER
       string
       default "latest"    if PKG_USING_N32H47X_48X_CMSIS_DRIVER_LATEST_VERSION

endif
```
