## arduino/sensors/Adafruit-FXAS21002C/Kconfig
```kconfig
# Kconfig file for package Adafruit-FXAS21002C
menuconfig PKG_USING_ARDUINO_ADAFRUIT_FXAS21002C
    bool "Adafruit FXOS8700 3-Axis accelerometer and magnetometer, and the FXAS21002 3-axis gyroscope sensor"
    select PKG_USING_RTDUINO
    select RTDUINO_USING_WIRE
    select PKG_USING_ARDUINO_ADAFRUIT_SENSOR
    select PKG_USING_ARDUINO_ADAFRUIT_BUSIO
    default n

if PKG_USING_ARDUINO_ADAFRUIT_FXAS21002C

    config PKG_ARDUINO_ADAFRUIT_FXAS21002C_PATH
        string
        default "/packages/arduino/sensors/Adafruit-FXAS21002C"

    choice
        prompt "Version"
        default PKG_USING_ARDUINO_ADAFRUIT_FXAS21002C_LATEST_VERSION
        help
            Select the package version

        config PKG_USING_ARDUINO_ADAFRUIT_FXAS21002C_LATEST_VERSION
            bool "latest"
    endchoice

    config PKG_ARDUINO_ADAFRUIT_FXAS21002C_VER
       string
       default "latest"    if PKG_USING_ARDUINO_ADAFRUIT_FXAS21002C_LATEST_VERSION

endif
```

## arduino/sensors/Adafruit-FXOS8700/Kconfig
```kconfig
# Kconfig file for package Adafruit-FXOS8700
menuconfig PKG_USING_ARDUINO_ADAFRUIT_FXOS8700
    bool "Adafruit-FXOS8700: Accelerometer and Magnetometer sensor"
    select PKG_USING_RTDUINO
    select RTDUINO_USING_WIRE
    select PKG_USING_ARDUINO_ADAFRUIT_SENSOR
    select PKG_USING_ARDUINO_ADAFRUIT_BUSIO
    default n

if PKG_USING_ARDUINO_ADAFRUIT_FXOS8700

    config PKG_ARDUINO_ADAFRUIT_FXOS8700_PATH
        string
        default "/packages/arduino/sensors/Adafruit-FXOS8700"

    choice
        prompt "Version"
        default PKG_USING_ARDUINO_ADAFRUIT_FXOS8700_LATEST_VERSION
        help
            Select the package version

        config PKG_USING_ARDUINO_ADAFRUIT_FXOS8700_LATEST_VERSION
            bool "latest"
    endchoice

    config PKG_ARDUINO_ADAFRUIT_FXOS8700_VER
       string
       default "latest"    if PKG_USING_ARDUINO_ADAFRUIT_FXOS8700_LATEST_VERSION

endif
```

## arduino/sensors/Adafruit-HDC1000/Kconfig
```kconfig
# Kconfig file for package Adafruit-HDC1000
menuconfig PKG_USING_ARDUINO_ADAFRUIT_HDC1000
    bool "Adafruit HDC1000: Temperature and Humidity Sensor"
    select PKG_USING_RTDUINO
    select RTDUINO_USING_WIRE
    select PKG_USING_ARDUINO_ADAFRUIT_BUSIO
    default n

if PKG_USING_ARDUINO_ADAFRUIT_HDC1000

    config PKG_ARDUINO_ADAFRUIT_HDC1000_PATH
        string
        default "/packages/arduino/sensors/Adafruit-HDC1000"

    choice
        prompt "Version"
        default PKG_USING_ARDUINO_ADAFRUIT_HDC1000_LATEST_VERSION
        help
            Select the package version

        config PKG_USING_ARDUINO_ADAFRUIT_HDC1000_LATEST_VERSION
            bool "latest"
    endchoice

    config PKG_ARDUINO_ADAFRUIT_HDC1000_VER
       string
       default "latest"    if PKG_USING_ARDUINO_ADAFRUIT_HDC1000_LATEST_VERSION

endif
```

## arduino/sensors/Adafruit-HMC5883-Unified/Kconfig
```kconfig
# Kconfig file for package Adafruit-HMC5883-Unified
menuconfig PKG_USING_ARDUINO_ADAFRUIT_HMC5883_UNIFIED
    bool "Adafruit HMC5883 (Unified): 3-Axis Magnetometer"
    select PKG_USING_RTDUINO
    select RTDUINO_USING_WIRE
    select PKG_USING_ARDUINO_ADAFRUIT_SENSOR
    default n

if PKG_USING_ARDUINO_ADAFRUIT_HMC5883_UNIFIED

    config PKG_ARDUINO_ADAFRUIT_HMC5883_UNIFIED_PATH
        string
        default "/packages/arduino/sensors/Adafruit-HMC5883-Unified"

    choice
        prompt "Version"
        default PKG_USING_ARDUINO_ADAFRUIT_HMC5883_UNIFIED_LATEST_VERSION
        help
            Select the package version

        config PKG_USING_ARDUINO_ADAFRUIT_HMC5883_UNIFIED_LATEST_VERSION
            bool "latest"
    endchoice

    config PKG_ARDUINO_ADAFRUIT_HMC5883_UNIFIED_VER
       string
       default "latest"    if PKG_USING_ARDUINO_ADAFRUIT_HMC5883_UNIFIED_LATEST_VERSION

endif
```

## arduino/sensors/Adafruit-HTS221/Kconfig
```kconfig
# Kconfig file for package Adafruit-HTS221
menuconfig PKG_USING_ARDUINO_ADAFRUIT_HTS221
    bool "Adafruit HTS221: Humidity and Temperature Sensor"
    select PKG_USING_RTDUINO
    select RTDUINO_USING_WIRE
    select RTDUINO_USING_SPI
    select PKG_USING_ARDUINO_ADAFRUIT_SENSOR
    select PKG_USING_ARDUINO_ADAFRUIT_BUSIO
    default n

if PKG_USING_ARDUINO_ADAFRUIT_HTS221

    config PKG_ARDUINO_ADAFRUIT_HTS221_PATH
        string
        default "/packages/arduino/sensors/Adafruit-HTS221"

    choice
        prompt "Version"
        default PKG_USING_ARDUINO_ADAFRUIT_HTS221_LATEST_VERSION
        help
            Select the package version

        config PKG_USING_ARDUINO_ADAFRUIT_HTS221_LATEST_VERSION
            bool "latest"
    endchoice

    config PKG_ARDUINO_ADAFRUIT_HTS221_VER
       string
       default "latest"    if PKG_USING_ARDUINO_ADAFRUIT_HTS221_LATEST_VERSION

endif
```

## arduino/sensors/Adafruit-HTU21DF/Kconfig
```kconfig
# Kconfig file for package Adafruit-HTU21DF
menuconfig PKG_USING_ARDUINO_ADAFRUIT_HTU21DF
    bool "Adafruit HTU21DF: Temperature and Humidity Sensor"
    select PKG_USING_RTDUINO
    select RTDUINO_USING_WIRE
    select PKG_USING_ARDUINO_ADAFRUIT_BUSIO
    default n

if PKG_USING_ARDUINO_ADAFRUIT_HTU21DF

    config PKG_ARDUINO_ADAFRUIT_HTU21DF_PATH
        string
        default "/packages/arduino/sensors/Adafruit-HTU21DF"

    choice
        prompt "Version"
        default PKG_USING_ARDUINO_ADAFRUIT_HTU21DF_LATEST_VERSION
        help
            Select the package version

        config PKG_USING_ARDUINO_ADAFRUIT_HTU21DF_LATEST_VERSION
            bool "latest"
    endchoice

    config PKG_ARDUINO_ADAFRUIT_HTU21DF_VER
       string
       default "latest"    if PKG_USING_ARDUINO_ADAFRUIT_HTU21DF_LATEST_VERSION

endif
```

## arduino/sensors/Adafruit-HTU31D/Kconfig
```kconfig
# Kconfig file for package Adafruit-HTU31D
menuconfig PKG_USING_ARDUINO_ADAFRUIT_HTU31D
    bool "Adafruit HTU31D: Temperature and Humidity Sensor"
    select PKG_USING_RTDUINO
    select RTDUINO_USING_WIRE
    select PKG_USING_ARDUINO_ADAFRUIT_BUSIO
    select PKG_USING_ARDUINO_ADAFRUIT_SENSOR
    default n

if PKG_USING_ARDUINO_ADAFRUIT_HTU31D

    config PKG_ARDUINO_ADAFRUIT_HTU31D_PATH
        string
        default "/packages/arduino/sensors/Adafruit-HTU31D"

    choice
        prompt "Version"
        default PKG_USING_ARDUINO_ADAFRUIT_HTU31D_LATEST_VERSION
        help
            Select the package version

        config PKG_USING_ARDUINO_ADAFRUIT_HTU31D_LATEST_VERSION
            bool "latest"
    endchoice

    config PKG_ARDUINO_ADAFRUIT_HTU31D_VER
       string
       default "latest"    if PKG_USING_ARDUINO_ADAFRUIT_HTU31D_LATEST_VERSION

endif
```

## arduino/sensors/Adafruit-ICM20X/Kconfig
```kconfig
# Kconfig file for package Adafruit-ICM20X
menuconfig PKG_USING_ARDUINO_ADAFRUIT_ICM20X
    bool "Adafruit ICM20X: TDK Invensense ICM20649 and ICM20948 Motion Sensor"
    select PKG_USING_RTDUINO
    select RTDUINO_USING_WIRE
    select PKG_USING_ARDUINO_ADAFRUIT_SENSOR
    select PKG_USING_ARDUINO_ADAFRUIT_BUSIO
    default n

if PKG_USING_ARDUINO_ADAFRUIT_ICM20X

    config PKG_ARDUINO_ADAFRUIT_ICM20X_PATH
        string
        default "/packages/arduino/sensors/Adafruit-ICM20X"

    choice
        prompt "Version"
        default PKG_USING_ARDUINO_ADAFRUIT_ICM20X_LATEST_VERSION
        help
            Select the package version

        config PKG_USING_ARDUINO_ADAFRUIT_ICM20X_LATEST_VERSION
            bool "latest"
    endchoice

    config PKG_ARDUINO_ADAFRUIT_ICM20X_VER
       string
       default "latest"    if PKG_USING_ARDUINO_ADAFRUIT_ICM20X_LATEST_VERSION

endif
```

## arduino/sensors/Adafruit-INA219/Kconfig
```kconfig
# Kconfig file for package Adafruit-INA219
menuconfig PKG_USING_ARDUINO_ADAFRUIT_INA219
    bool "Adafruit INA219: DC current sensor"
    select PKG_USING_RTDUINO
    select RTDUINO_USING_WIRE
    select PKG_USING_ARDUINO_ADAFRUIT_BUSIO
    default n

if PKG_USING_ARDUINO_ADAFRUIT_INA219

    config PKG_ARDUINO_ADAFRUIT_INA219_PATH
        string
        default "/packages/arduino/sensors/Adafruit-INA219"

    choice
        prompt "Version"
        default PKG_USING_ARDUINO_ADAFRUIT_INA219_LATEST_VERSION
        help
            Select the package version

        config PKG_USING_ARDUINO_ADAFRUIT_INA219_LATEST_VERSION
            bool "latest"
    endchoice

    config PKG_ARDUINO_ADAFRUIT_INA219_VER
       string
       default "latest"    if PKG_USING_ARDUINO_ADAFRUIT_INA219_LATEST_VERSION

endif
```

## arduino/sensors/Adafruit-L3GD20/Kconfig
```kconfig
# Kconfig file for package Adafruit-L3GD20
menuconfig PKG_USING_ARDUINO_ADAFRUIT_L3GD20
    bool "Adafruit L3GD20: Triple-Axis Gyro Sensor"
    select PKG_USING_RTDUINO
    select RTDUINO_USING_WIRE
    select PKG_USING_ARDUINO_ADAFRUIT_SENSOR
    default n

if PKG_USING_ARDUINO_ADAFRUIT_L3GD20

    config PKG_ARDUINO_ADAFRUIT_L3GD20_PATH
        string
        default "/packages/arduino/sensors/Adafruit-L3GD20"

    choice
        prompt "Version"
        default PKG_USING_ARDUINO_ADAFRUIT_L3GD20_LATEST_VERSION
        help
            Select the package version

        config PKG_USING_ARDUINO_ADAFRUIT_L3GD20_LATEST_VERSION
            bool "latest"
    endchoice

    config PKG_ARDUINO_ADAFRUIT_L3GD20_VER
       string
       default "latest"    if PKG_USING_ARDUINO_ADAFRUIT_L3GD20_LATEST_VERSION

endif
```

## arduino/sensors/Adafruit-LC709203F/Kconfig
```kconfig
# Kconfig file for package Adafruit-LC709203F
menuconfig PKG_USING_ARDUINO_ADAFRUIT_LC709203F
    bool "Adafruit LC709203F: Fuel Gauge and Battery Monitor Sensor"
    select PKG_USING_RTDUINO
    select RTDUINO_USING_WIRE
    select PKG_USING_ARDUINO_ADAFRUIT_BUSIO
    default n

if PKG_USING_ARDUINO_ADAFRUIT_LC709203F

    config PKG_ARDUINO_ADAFRUIT_LC709203F_PATH
        string
        default "/packages/arduino/sensors/Adafruit-LC709203F"

    choice
        prompt "Version"
        default PKG_USING_ARDUINO_ADAFRUIT_LC709203F_LATEST_VERSION
        help
            Select the package version

        config PKG_USING_ARDUINO_ADAFRUIT_LC709203F_LATEST_VERSION
            bool "latest"
    endchoice

    config PKG_ARDUINO_ADAFRUIT_LC709203F_VER
       string
       default "latest"    if PKG_USING_ARDUINO_ADAFRUIT_LC709203F_LATEST_VERSION

endif
```

## arduino/sensors/Adafruit-LIS2MDL/Kconfig
```kconfig
# Kconfig file for package Adafruit-LIS2MDL
menuconfig PKG_USING_ARDUINO_ADAFRUIT_LIS2MDL
    bool "Adafruit LIS2MDL: Magnetometer Sensor"
    select PKG_USING_RTDUINO
    select RTDUINO_USING_WIRE
    select RTDUINO_USING_SPI
    select PKG_USING_ARDUINO_ADAFRUIT_SENSOR
    select PKG_USING_ARDUINO_ADAFRUIT_BUSIO
    default n

if PKG_USING_ARDUINO_ADAFRUIT_LIS2MDL

    config PKG_ARDUINO_ADAFRUIT_LIS2MDL_PATH
        string
        default "/packages/arduino/sensors/Adafruit-LIS2MDL"

    choice
        prompt "Version"
        default PKG_USING_ARDUINO_ADAFRUIT_LIS2MDL_LATEST_VERSION
        help
            Select the package version

        config PKG_USING_ARDUINO_ADAFRUIT_LIS2MDL_LATEST_VERSION
            bool "latest"
    endchoice

    config PKG_ARDUINO_ADAFRUIT_LIS2MDL_VER
       string
       default "latest"    if PKG_USING_ARDUINO_ADAFRUIT_LIS2MDL_LATEST_VERSION

endif
```

## arduino/sensors/Adafruit-LIS331/Kconfig
```kconfig
# Kconfig file for package Adafruit-LIS331
menuconfig PKG_USING_ARDUINO_ADAFRUIT_LIS331
    bool "Adafruit LIS331: 3-axis Accelerometers Sensor"
    select PKG_USING_RTDUINO
    select RTDUINO_USING_WIRE
    select RTDUINO_USING_SPI
    select PKG_USING_ARDUINO_ADAFRUIT_SENSOR
    select PKG_USING_ARDUINO_ADAFRUIT_BUSIO
    default n

if PKG_USING_ARDUINO_ADAFRUIT_LIS331

    config PKG_ARDUINO_ADAFRUIT_LIS331_PATH
        string
        default "/packages/arduino/sensors/Adafruit-LIS331"

    choice
        prompt "Version"
        default PKG_USING_ARDUINO_ADAFRUIT_LIS331_LATEST_VERSION
        help
            Select the package version

        config PKG_USING_ARDUINO_ADAFRUIT_LIS331_LATEST_VERSION
            bool "latest"
    endchoice

    config PKG_ARDUINO_ADAFRUIT_LIS331_VER
       string
       default "latest"    if PKG_USING_ARDUINO_ADAFRUIT_LIS331_LATEST_VERSION

endif
```

## arduino/sensors/Adafruit-LIS3DH/Kconfig
```kconfig
# Kconfig file for package Adafruit-LIS3DH
menuconfig PKG_USING_ARDUINO_ADAFRUIT_LIS3DH
    bool "Adafruit LIS3DH: Accelerometer Sensor"
    select PKG_USING_RTDUINO
    select RTDUINO_USING_WIRE
    select RTDUINO_USING_SPI
    select PKG_USING_ARDUINO_ADAFRUIT_SENSOR
    select PKG_USING_ARDUINO_ADAFRUIT_BUSIO
    default n

if PKG_USING_ARDUINO_ADAFRUIT_LIS3DH

    config PKG_ARDUINO_ADAFRUIT_LIS3DH_PATH
        string
        default "/packages/arduino/sensors/Adafruit-LIS3DH"

    choice
        prompt "Version"
        default PKG_USING_ARDUINO_ADAFRUIT_LIS3DH_LATEST_VERSION
        help
            Select the package version

        config PKG_USING_ARDUINO_ADAFRUIT_LIS3DH_LATEST_VERSION
            bool "latest"
    endchoice

    config PKG_ARDUINO_ADAFRUIT_LIS3DH_VER
       string
       default "latest"    if PKG_USING_ARDUINO_ADAFRUIT_LIS3DH_LATEST_VERSION

endif
```

## arduino/sensors/Adafruit-LPS2X/Kconfig
```kconfig
# Kconfig file for package Adafruit-LPS2X
menuconfig PKG_USING_ARDUINO_ADAFRUIT_LPS2X
    bool "Adafruit LPS2x: LPS22 & LPS25 Pressure Sensor Driver"
    select RTDUINO_USING_WIRE
    select PKG_USING_ARDUINO_ADAFRUIT_SENSOR
    select PKG_USING_ARDUINO_ADAFRUIT_BUSIO
    default n

if PKG_USING_ARDUINO_ADAFRUIT_LPS2X

    config PKG_ARDUINO_ADAFRUIT_LPS2X_PATH
        string
        default "/packages/arduino/sensors/Adafruit-LPS2X"

    choice
        prompt "Version"
        default PKG_USING_ARDUINO_ADAFRUIT_LPS2X_LATEST_VERSION
        help
            Select the package version

        config PKG_USING_ARDUINO_ADAFRUIT_LPS2X_LATEST_VERSION
            bool "latest"
    endchoice

    config PKG_ARDUINO_ADAFRUIT_LPS2X_VER
       string
       default "latest"    if PKG_USING_ARDUINO_ADAFRUIT_LPS2X_LATEST_VERSION

endif
```

## arduino/sensors/Adafruit-LPS35HW/Kconfig
```kconfig
# Kconfig file for package Adafruit-LPS35HW
menuconfig PKG_USING_ARDUINO_ADAFRUIT_LPS35HW
    bool "Adafruit LPS35HW/LPS33HW: Water Resistant Pressure Sensor"
    select PKG_USING_RTDUINO
    select RTDUINO_USING_WIRE
    select PKG_USING_ARDUINO_ADAFRUIT_BUSIO
    default n

if PKG_USING_ARDUINO_ADAFRUIT_LPS35HW

    config PKG_ARDUINO_ADAFRUIT_LPS35HW_PATH
        string
        default "/packages/arduino/sensors/Adafruit-LPS35HW"

    choice
        prompt "Version"
        default PKG_USING_ARDUINO_ADAFRUIT_LPS35HW_LATEST_VERSION
        help
            Select the package version

        config PKG_USING_ARDUINO_ADAFRUIT_LPS35HW_LATEST_VERSION
            bool "latest"
    endchoice

    config PKG_ARDUINO_ADAFRUIT_LPS35HW_VER
       string
       default "latest"    if PKG_USING_ARDUINO_ADAFRUIT_LPS35HW_LATEST_VERSION

endif
```

## arduino/sensors/Adafruit-LSM303-Accel/Kconfig
```kconfig
# Kconfig file for package Adafruit-LSM303-Accel
menuconfig PKG_USING_ARDUINO_ADAFRUIT_LSM303_ACCEL
    bool "Adafruit LSM303: Triple-axis Accelerometer and Magnetometer Sensor"
    select PKG_USING_RTDUINO
    select RTDUINO_USING_WIRE
    select PKG_USING_ARDUINO_ADAFRUIT_SENSOR
    select PKG_USING_ARDUINO_ADAFRUIT_BUSIO
    default n

if PKG_USING_ARDUINO_ADAFRUIT_LSM303_ACCEL

    config PKG_ARDUINO_ADAFRUIT_LSM303_ACCEL_PATH
        string
        default "/packages/arduino/sensors/Adafruit-LSM303-Accel"

    choice
        prompt "Version"
        default PKG_USING_ARDUINO_ADAFRUIT_LSM303_ACCEL_LATEST_VERSION
        help
            Select the package version

        config PKG_USING_ARDUINO_ADAFRUIT_LSM303_ACCEL_LATEST_VERSION
            bool "latest"
    endchoice

    config PKG_ARDUINO_ADAFRUIT_LSM303_ACCEL_VER
       string
       default "latest"    if PKG_USING_ARDUINO_ADAFRUIT_LSM303_ACCEL_LATEST_VERSION

endif
```
