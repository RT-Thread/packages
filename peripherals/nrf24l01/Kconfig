## peripherals/sensors/Kconfig
```kconfig
menu "sensors drivers"

source "$PKGS_DIR/packages/peripherals/sensors/lsm6dsm/Kconfig"
source "$PKGS_DIR/packages/peripherals/sensors/lsm6dsl/Kconfig"
source "$PKGS_DIR/packages/peripherals/sensors/lps22hb/Kconfig"
source "$PKGS_DIR/packages/peripherals/sensors/hts221/Kconfig"
source "$PKGS_DIR/packages/peripherals/sensors/lsm303agr/Kconfig"
source "$PKGS_DIR/packages/peripherals/sensors/bme280/Kconfig"
source "$PKGS_DIR/packages/peripherals/sensors/bme680/Kconfig"
source "$PKGS_DIR/packages/peripherals/sensors/bma400/Kconfig"
source "$PKGS_DIR/packages/peripherals/sensors/bmi160_bmx160/Kconfig"
source "$PKGS_DIR/packages/peripherals/sensors/spl0601/Kconfig"
source "$PKGS_DIR/packages/peripherals/sensors/ms5805/Kconfig"
source "$PKGS_DIR/packages/peripherals/sensors/da270/Kconfig"
source "$PKGS_DIR/packages/peripherals/sensors/df220/Kconfig"
source "$PKGS_DIR/packages/peripherals/sensors/hshcal001/Kconfig"
source "$PKGS_DIR/packages/peripherals/sensors/bh1750/Kconfig"
source "$PKGS_DIR/packages/peripherals/sensors/mpu6xxx/Kconfig"
source "$PKGS_DIR/packages/peripherals/sensors/aht10/Kconfig"
source "$PKGS_DIR/packages/peripherals/sensors/ap3216c/Kconfig"
source "$PKGS_DIR/packages/peripherals/sensors/tsl4531/Kconfig"
source "$PKGS_DIR/packages/peripherals/sensors/ds18b20/Kconfig"
source "$PKGS_DIR/packages/peripherals/sensors/dht11/Kconfig"
source "$PKGS_DIR/packages/peripherals/sensors/dhtxx/Kconfig"
source "$PKGS_DIR/packages/peripherals/sensors/gy271/Kconfig"
source "$PKGS_DIR/packages/peripherals/sensors/gp2y10/Kconfig"
source "$PKGS_DIR/packages/peripherals/sensors/sgp30/Kconfig"
source "$PKGS_DIR/packages/peripherals/sensors/hdc1000/Kconfig"
source "$PKGS_DIR/packages/peripherals/sensors/bmp180/Kconfig"
source "$PKGS_DIR/packages/peripherals/sensors/bmp280/Kconfig"
source "$PKGS_DIR/packages/peripherals/sensors/shtc1/Kconfig"
source "$PKGS_DIR/packages/peripherals/sensors/bmi088/Kconfig"
source "$PKGS_DIR/packages/peripherals/sensors/hmc5883/Kconfig"
source "$PKGS_DIR/packages/peripherals/sensors/max6675/Kconfig"
source "$PKGS_DIR/packages/peripherals/sensors/max31855/Kconfig"
source "$PKGS_DIR/packages/peripherals/sensors/tmp1075/Kconfig"
source "$PKGS_DIR/packages/peripherals/sensors/sr04/Kconfig"
source "$PKGS_DIR/packages/peripherals/sensors/ccs811/Kconfig"
source "$PKGS_DIR/packages/peripherals/sensors/pmsxx/Kconfig"
source "$PKGS_DIR/packages/peripherals/sensors/rt3020/Kconfig"
source "$PKGS_DIR/packages/peripherals/sensors/mlx90632/Kconfig"
source "$PKGS_DIR/packages/peripherals/sensors/mlx90382/Kconfig"
source "$PKGS_DIR/packages/peripherals/sensors/mlx90393/Kconfig"
source "$PKGS_DIR/packages/peripherals/sensors/mlx90392/Kconfig"
source "$PKGS_DIR/packages/peripherals/sensors/mlx90394/Kconfig"
source "$PKGS_DIR/packages/peripherals/sensors/mlx90397/Kconfig"
source "$PKGS_DIR/packages/peripherals/sensors/ms5611/Kconfig"
source "$PKGS_DIR/packages/peripherals/sensors/max31865/Kconfig"
source "$PKGS_DIR/packages/peripherals/sensors/vl53l0x/Kconfig"
source "$PKGS_DIR/packages/peripherals/sensors/ina260/Kconfig"
source "$PKGS_DIR/packages/peripherals/sensors/max30102/Kconfig"
source "$PKGS_DIR/packages/peripherals/sensors/ina226/Kconfig"
source "$PKGS_DIR/packages/peripherals/sensors/lis2dh12/Kconfig"
source "$PKGS_DIR/packages/peripherals/sensors/hs300x/Kconfig"
source "$PKGS_DIR/packages/peripherals/sensors/zmod4410/Kconfig"
source "$PKGS_DIR/packages/peripherals/sensors/isl29035/Kconfig"
source "$PKGS_DIR/packages/peripherals/sensors/mmc3680kj/Kconfig"
source "$PKGS_DIR/packages/peripherals/sensors/qmp6989/Kconfig"
source "$PKGS_DIR/packages/peripherals/sensors/balance/Kconfig"
source "$PKGS_DIR/packages/peripherals/sensors/sht2x/Kconfig"
source "$PKGS_DIR/packages/peripherals/sensors/sht3x/Kconfig"
source "$PKGS_DIR/packages/peripherals/sensors/sht4x/Kconfig"
source "$PKGS_DIR/packages/peripherals/sensors/ad7746/Kconfig"
source "$PKGS_DIR/packages/peripherals/sensors/adt74xx/Kconfig"
source "$PKGS_DIR/packages/peripherals/sensors/max17048/Kconfig"
source "$PKGS_DIR/packages/peripherals/sensors/as7341/Kconfig"
source "$PKGS_DIR/packages/peripherals/sensors/cw2015/Kconfig"
source "$PKGS_DIR/packages/peripherals/sensors/icm20608/Kconfig"
source "$PKGS_DIR/packages/peripherals/sensors/PAJ7620/Kconfig"
source "$PKGS_DIR/packages/peripherals/sensors/sths34pf80/Kconfig"
source "$PKGS_DIR/packages/peripherals/sensors/p3t1755/Kconfig"
source "$PKGS_DIR/packages/peripherals/sensors/qmi8658/Kconfig"

endmenu
```
