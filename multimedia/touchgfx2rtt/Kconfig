## multimedia/touchgfx2rtt/Kconfig
```kconfig
# Kconfig file for package touchgfx2rtt
menuconfig PKG_USING_TOUCHGFX2RTT
    bool "touchgfx: a touchgfx package for rt-thread."
    default n

if PKG_USING_TOUCHGFX2RTT

    config PKG_TOUCHGFX2RTT_PATH
        string
        default "/packages/multimedia/touchgfx2rtt"

    choice
        prompt "Version"
        default PKG_USING_TOUCHGFX2RTT_LATEST_VERSION
        help
            Select the package version

        config PKG_USING_TOUCHGFX2RTT_LATEST_VERSION
            bool "latest"
    endchoice

    config PKG_TOUCHGFX2RTT_VER
       string
       default "v1.0.0"    if PKG_USING_TOUCHGFX2RTT_V100
       default "latest"    if PKG_USING_TOUCHGFX2RTT_LATEST_VERSION
endif
```

## multimedia/u8g2/Kconfig
```kconfig
menu "u8g2: a monochrome graphic library"

if RT_VER_NUM >= 0x40003
source "$PKGS_DIR/packages/multimedia/u8g2/u8g2-official/Kconfig"
endif

source "$PKGS_DIR/packages/multimedia/u8g2/u8g2/Kconfig"

endmenu
```

## multimedia/ugui/Kconfig
```kconfig
# Kconfig file for package ugui
menuconfig PKG_USING_UGUI
    bool "uGUI:Open source graphics library ugui ported to rtthread."
    default n

if PKG_USING_UGUI

    config PKG_UGUI_PATH
        string
        default "/packages/multimedia/ugui"

    choice
        prompt "Version"
        default PKG_USING_UGUI_LATEST_VERSION
        help
            Select the package version

        config PKG_USING_UGUI_LATEST_VERSION
            bool "latest"
    endchoice

    config PKG_UGUI_VER
       string
       default "latest"    if PKG_USING_UGUI_LATEST_VERSION

endif
```

## multimedia/wavplayer/Kconfig
```kconfig
# Kconfig file for package wavplayer
menuconfig PKG_USING_WAVPLAYER
    bool "WavPlayer: Minimal music player for wav file play and record"
    default n

if PKG_USING_WAVPLAYER

    config PKG_WAVPLAYER_PATH
        select PKG_USING_OPTPARSE
        string
        default "/packages/multimedia/wavplayer"

    config PKG_WP_USING_PLAY
        bool "Enable support for play"
        default y
    
    if PKG_WP_USING_PLAY
    
        config PKG_WP_PLAY_DEVICE
            string "The play device name"
        default "sound0"
    endif

    config PKG_WP_USING_RECORD
        bool "Enable support for record"
        default n

    if PKG_WP_USING_RECORD
    
        config PKG_WP_RECORD_DEVICE
            string "The record device name"
        default "sound0"
    endif

    choice
        prompt "Version"
        default PKG_USING_WAVPLAYER_LATEST_VERSION
        help
            Select the package version

        config PKG_USING_WAVPLAYER_V010
            bool "v0.1.0"

        config PKG_USING_WAVPLAYER_LATEST_VERSION
            bool "latest"
    endchoice
          
    config PKG_WAVPLAYER_VER
       string
       default "v0.1.0"    if PKG_USING_WAVPLAYER_V010
       default "latest"    if PKG_USING_WAVPLAYER_LATEST_VERSION

endif
```

## peripherals/ADS1146/Kconfig
```kconfig
# Kconfig file for package ADS1146
menuconfig PKG_USING_ADS1146
    bool "Please add description of ADS1146 in English."
    default n

if PKG_USING_ADS1146

    config PKG_ADS1146_PATH
        string
        default "/packages/peripherals/ADS1146"

    choice
        prompt "Version"
        help
            Select the package version

        config PKG_USING_ADS1146_V25924
            bool "v25.9.24"

        config PKG_USING_ADS1146_LATEST_VERSION
            bool "latest"
    endchoice

    config PKG_ADS1146_VER
       string
       default "v25.9.24"    if PKG_USING_ADS1146_V25924
       default "latest"    if PKG_USING_ADS1146_LATEST_VERSION

endif
```

## peripherals/Kconfig
```kconfig
menu "peripheral libraries and drivers"

source "$PKGS_DIR/packages/peripherals/hal-sdk/Kconfig"
source "$PKGS_DIR/packages/peripherals/sensors/Kconfig"
source "$PKGS_DIR/packages/peripherals/touch/Kconfig"
source "$PKGS_DIR/packages/peripherals/realtek_ameba/Kconfig"
source "$PKGS_DIR/packages/peripherals/button/Kconfig"
source "$PKGS_DIR/packages/peripherals/pcf8574/Kconfig"
source "$PKGS_DIR/packages/peripherals/sx12xx/Kconfig"
source "$PKGS_DIR/packages/peripherals/SignalLed/Kconfig"
source "$PKGS_DIR/packages/peripherals/LedBlink/Kconfig"
source "$PKGS_DIR/packages/peripherals/littled/Kconfig"
source "$PKGS_DIR/packages/peripherals/lkdGui/Kconfig"
source "$PKGS_DIR/packages/peripherals/wm_libraries/Kconfig"
source "$PKGS_DIR/packages/peripherals/infrared/Kconfig"
source "$PKGS_DIR/packages/peripherals/multi_infrared/Kconfig"
source "$PKGS_DIR/packages/peripherals/agile_button/Kconfig"
source "$PKGS_DIR/packages/peripherals/agile_led/Kconfig"
source "$PKGS_DIR/packages/peripherals/at24cxx/Kconfig"
source "$PKGS_DIR/packages/peripherals/MotionDriver2RTT/Kconfig"
source "$PKGS_DIR/packages/peripherals/pca9685/Kconfig"
source "$PKGS_DIR/packages/peripherals/ili9341/Kconfig"
source "$PKGS_DIR/packages/peripherals/i2c-tools/Kconfig"
source "$PKGS_DIR/packages/peripherals/nrf24l01/Kconfig"
source "$PKGS_DIR/packages/peripherals/rplidar/Kconfig"
source "$PKGS_DIR/packages/peripherals/as608/Kconfig"
source "$PKGS_DIR/packages/peripherals/rc522/Kconfig"
source "$PKGS_DIR/packages/peripherals/ws2812b/Kconfig"
source "$PKGS_DIR/packages/peripherals/rtc/Kconfig"
source "$PKGS_DIR/packages/peripherals/multi_rtimer/Kconfig"
source "$PKGS_DIR/packages/peripherals/max7219/Kconfig"
source "$PKGS_DIR/packages/peripherals/beep/Kconfig"
source "$PKGS_DIR/packages/peripherals/easyblink/Kconfig"
source "$PKGS_DIR/packages/peripherals/pms_series/Kconfig"
source "$PKGS_DIR/packages/peripherals/can_ymodem/Kconfig"
source "$PKGS_DIR/packages/peripherals/lora_radio_driver/Kconfig"
source "$PKGS_DIR/packages/peripherals/quick_led/Kconfig"
source "$PKGS_DIR/packages/peripherals/agile_console/Kconfig"
source "$PKGS_DIR/packages/peripherals/ld3320/Kconfig"
source "$PKGS_DIR/packages/peripherals/wk2124/Kconfig"
source "$PKGS_DIR/packages/peripherals/ly68l6400/Kconfig"
source "$PKGS_DIR/packages/peripherals/dm9051/Kconfig"
source "$PKGS_DIR/packages/peripherals/ssd1306/Kconfig"
source "$PKGS_DIR/packages/peripherals/qkey/Kconfig"
source "$PKGS_DIR/packages/peripherals/rs485/Kconfig"
source "$PKGS_DIR/packages/peripherals/rs232/Kconfig"
source "$PKGS_DIR/packages/peripherals/nes/Kconfig"
source "$PKGS_DIR/packages/peripherals/vsensor/Kconfig"
source "$PKGS_DIR/packages/peripherals/vdevice/Kconfig"
source "$PKGS_DIR/packages/peripherals/sgm706/Kconfig"
source "$PKGS_DIR/packages/peripherals/rda58xx/Kconfig"
source "$PKGS_DIR/packages/peripherals/libnfc/Kconfig"
source "$PKGS_DIR/packages/peripherals/mfoc/Kconfig"
source "$PKGS_DIR/packages/peripherals/tmc51xx/Kconfig"
source "$PKGS_DIR/packages/peripherals/tca9534/Kconfig"
source "$PKGS_DIR/packages/peripherals/kobuki/Kconfig"
source "$PKGS_DIR/packages/peripherals/rosserial/Kconfig"
source "$PKGS_DIR/packages/peripherals/micro_ros/Kconfig"
source "$PKGS_DIR/packages/peripherals/mcp23008/Kconfig"
source "$PKGS_DIR/packages/peripherals/Misaka_AT24CXX/Kconfig"
source "$PKGS_DIR/packages/peripherals/Misaka_RGB_Bling/Kconfig"
source "$PKGS_DIR/packages/peripherals/lora_gw_driver_lib/Kconfig"
source "$PKGS_DIR/packages/peripherals/lora_modem_driver/Kconfig"
source "$PKGS_DIR/packages/peripherals/soft_serial/Kconfig"
source "$PKGS_DIR/packages/peripherals/mb85rs16/Kconfig"
source "$PKGS_DIR/packages/peripherals/rfm300/Kconfig"
source "$PKGS_DIR/packages/peripherals/io_input_filter/Kconfig"
source "$PKGS_DIR/packages/peripherals/lrf-nv7lidar/Kconfig"
source "$PKGS_DIR/packages/peripherals/aip650/Kconfig"
source "$PKGS_DIR/packages/peripherals/fingerprint/Kconfig"
source "$PKGS_DIR/packages/peripherals/bt_ecb02c/Kconfig"
source "$PKGS_DIR/packages/peripherals/uat/Kconfig"
source "$PKGS_DIR/packages/peripherals/st7789/Kconfig"
source "$PKGS_DIR/packages/peripherals/vs1003/Kconfig"
source "$PKGS_DIR/packages/peripherals/x9555/Kconfig"
source "$PKGS_DIR/packages/peripherals/System_Run_LED/Kconfig"
source "$PKGS_DIR/packages/peripherals/bt_mx01/Kconfig"
source "$PKGS_DIR/packages/peripherals/RgPower/Kconfig"
source "$PKGS_DIR/packages/peripherals/bt_mx02/Kconfig"
source "$PKGS_DIR/packages/peripherals/gc9a01/Kconfig"
source "$PKGS_DIR/packages/peripherals/ikun-485/Kconfig"
source "$PKGS_DIR/packages/peripherals/Servo_sg90/Kconfig"
source "$PKGS_DIR/packages/peripherals/sean_ws2812b/Kconfig"
source "$PKGS_DIR/packages/peripherals/ic74hc165/Kconfig"
source "$PKGS_DIR/packages/peripherals/ist8310/Kconfig"
source "$PKGS_DIR/packages/peripherals/ST7789_SPI/Kconfig"
source "$PKGS_DIR/packages/peripherals/rtt_isotp-c/Kconfig"
source "$PKGS_DIR/packages/peripherals/ikunLed/Kconfig"

if RT_VER_NUM > 0x40101
source "$PKGS_DIR/packages/peripherals/spi-tools/Kconfig"
endif

endmenu
```

## peripherals/LedBlink/Kconfig
```kconfig
# Kconfig file for package LedBlink
menuconfig PKG_USING_LEDBLINK
    bool "Please add description of LedBlink in English."
    default n

if PKG_USING_LEDBLINK

    config PKG_LEDBLINK_PATH
        string
        default "/packages/peripherals/LedBlink"

    choice
        prompt "Version"
        default PKG_USING_LEDBLINK_LATEST_VERSION
        help
            Select the package version

        config PKG_USING_LEDBLINK_V100
            bool "v1.0.0"

        config PKG_USING_LEDBLINK_LATEST_VERSION
            bool "latest"
    endchoice
          
    config PKG_LEDBLINK_VER
       string
       default "v1.0.0"    if PKG_USING_LEDBLINK_V100
       default "latest"    if PKG_USING_LEDBLINK_LATEST_VERSION

endif
```

## peripherals/Misaka_AT24CXX/Kconfig
```kconfig
# Kconfig file for package Misaka_AT24CXX
menuconfig PKG_USING_MISAKA_AT24CXX
    bool "Misaka-Network for AT24CXX EEPROM"
    default n

if PKG_USING_MISAKA_AT24CXX

    config PKG_USING_MISAKA_AT24CXX_DEMO
        bool "Use demo"
        default n

    config PKG_MISAKA_AT24CXX_PATH
        string
        default "/packages/peripherals/Misaka_AT24CXX"

    choice
        prompt "Version"
        default PKG_USING_MISAKA_AT24CXX_LATEST_VERSION
        help
            Select the package version

        config PKG_USING_MISAKA_AT24CXX_V100
            bool "1.0.0"

        config PKG_USING_MISAKA_AT24CXX_LATEST_VERSION
            bool "latest"
    endchoice

    config PKG_MISAKA_AT24CXX_VER
       string
       default "1.0.0"    if PKG_USING_MISAKA_AT24CXX_V100
       default "latest"    if PKG_USING_MISAKA_AT24CXX_LATEST_VERSION

endif
```

## peripherals/Misaka_RGB_Bling/Kconfig
```kconfig
# Kconfig file for package Misaka_RGB_Bling
menuconfig PKG_USING_MISAKA_RGB_BLING
    bool "Misaka-Network for RGB LED Bling."
    default n

if PKG_USING_MISAKA_RGB_BLING

    config PKG_USING_MISAKA_RGB_BLING_DEMO
        bool "Use demo"
        default n

    config PKG_MISAKA_RGB_BLING_PATH
        string
        default "/packages/peripherals/Misaka_RGB_Bling"

    choice
        prompt "Version"
        default PKG_USING_MISAKA_RGB_BLING_V100
        help
            Select the package version

        config PKG_USING_MISAKA_RGB_BLING_V100
            bool "1.0.0"
    endchoice

    config PKG_MISAKA_RGB_BLING_VER
       string
       default "1.0.0"    if PKG_USING_MISAKA_RGB_BLING_V100

endif
```

## peripherals/MotionDriver2RTT/Kconfig
```kconfig
# Kconfig file for package MotionDriver2RTT
menuconfig PKG_USING_MOTIONDRIVER2RTT
    bool "MotionDriver2RTT: A package porting MotionDriver to RTT"
    default n

if PKG_USING_MOTIONDRIVER2RTT

    config PKG_MOTIONDRIVER2RTT_PATH
        string
        default "/packages/peripherals/MotionDriver2RTT"

    config MotionDriver2RTT_USING_EXAMPLE
        bool "Enable MotionDriver2RTT sample"
        default n

    choice
        prompt "Version"
        default PKG_USING_MOTIONDRIVER2RTT_LATEST_VERSION
        help
            Select the package version

        config PKG_USING_MOTIONDRIVER2RTT_V100
            bool "v1.0.0"

        config PKG_USING_MOTIONDRIVER2RTT_LATEST_VERSION
            bool "latest"
    endchoice

    config PKG_MOTIONDRIVER2RTT_VER
       string
       default "v1.0.0"    if PKG_USING_MOTIONDRIVER2RTT_V100
       default "latest"    if PKG_USING_MOTIONDRIVER2RTT_LATEST_VERSION

endif
```

## peripherals/RgPower/Kconfig
```kconfig
# Kconfig file for package RgPower
menuconfig PKG_USING_RGPOWER
    bool "Use RgPower"
    default n

if PKG_USING_RGPOWER

    config PKG_RGPOWER_PATH
        string 
        default "/packages/peripherals/RgPower"

    config RGPOWER_USEING_LOG
        bool "open debug log"
        default n
        help
            enable rgpower debug log

    config RGPOWER_POWER_OFF_PIN_NUM
        int "This value is the gpio num for power off"
        default 22
        help
            power_off gpio num

    config RGPOWER_CHARGE_PIN_NUM
        int "This value is the gpio num for charge status"
        default 5
        help
            charge gpio num

    config RGPOWER_CHARGE_GPIO_STATUS
        int "This value is the gpio charge status"
        default 1
        help
            The pin level state in the charging state

    config RGPOWER_ADC_DEV_NAME
        string "adc device name"
        default "adc3"
        help
            using adc device name

    config RGPOWER_ADC_DEV_CHANNEL
        int "This value is adc channel"
        default 11
        help
            using adc device channel

    config RGPOWER_REFER_VOLTAGE
        int "This value is adc refere voltage (mv)"
        default 3300
        help
            using adc reference voltage

    config RGPOWER_CONVERT_BITS_MAX
        int "This value is adc bits max value"
        default 4096
        help
            using adc full scale size

    config RGPOWER_SCALE_FACTOR
        int "This value is voltage scale factor"
        default 3
        help
            The scaling factor of voltage

    config RGPOWER_100_VOLTAGE
        int "This value is voltage (mv) for 100%"
        default 4200
        help
            Maximum battery voltage , The unit is mv

    config RGPOWER_0_VOLTAGE
        int "This value is voltage (mv) for 0%"
        default 3500
        help
            Minimum battery voltage , The unit is mv

    choice
        prompt "Version"
        default PKG_USING_RGPOWER_LATEST_VERSION
        help
            Select the package version

        config PKG_USING_RGPOWER_V100
            bool "v1.0.0"

        config PKG_USING_RGPOWER_LATEST_VERSION
            bool "latest"
    endchoice

    config PKG_RGPOWER_VER
       string
       default "v1.0.0"    if PKG_USING_RGPOWER_V100
       default "latest"    if PKG_USING_RGPOWER_LATEST_VERSION

endif
```
