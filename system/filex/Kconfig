## system/filex/Kconfig
```kconfig
# Kconfig file for package filex
menuconfig PKG_USING_FILEX
    bool "filex file system for RT-Thread"
    default n

if PKG_USING_FILEX

    config PKG_FILEX_PATH
        string
        default "/packages/system/filex"

    config PKG_USING_FILEX_DEMO_MEM
        bool "Enable filex memery demo for rtthread"
        default n

    config PKG_USING_FILEX_DEMO_BLK
        bool "Enable filex block device demo for rtthread"
        default n

    choice
        prompt "Version"
        default PKG_USING_FILEX_LATEST_VERSION
        help
            Select the package version

        config PKG_USING_FILEX_LATEST_VERSION
            bool "latest"
    endchoice

    config PKG_FILEX_VER
       string
       default "latest"    if PKG_USING_FILEX_LATEST_VERSION

endif
```

## system/flash_blob/Kconfig
```kconfig
# Kconfig file for package flash_blob
menuconfig PKG_USING_FLASH_BLOB
    bool "flash_blob: Tool for quickly generating flash driver files."
    default n

if PKG_USING_FLASH_BLOB

    config PKG_FLASH_BLOB_PATH
        string
        default "/packages/system/flash_blob"

    choice
        prompt "Version"
        default PKG_USING_FLASH_BLOB_LATEST_VERSION
        help
            Select the package version

        config PKG_USING_FLASH_BLOB_V100
            bool "v1.0.0"

        config PKG_USING_FLASH_BLOB_LATEST_VERSION
            bool "latest"
    endchoice

    config PKG_FLASH_BLOB_VER
       string
       default "v1.0.0"    if PKG_USING_FLASH_BLOB_V100
       default "latest"    if PKG_USING_FLASH_BLOB_LATEST_VERSION

endif
```

## system/gui_engine/Kconfig
```kconfig
menuconfig PKG_USING_GUIENGINE
    bool "Enable GUI Engine"
    default n

if PKG_USING_GUIENGINE

config PKG_GUIENGINE_PATH
    string
    default "/packages/system/gui_engine"

choice
    prompt "Version"
    help
        Select the GUI Engine version

    config PKG_USING_GUIENGINE_LATEST_VERSION
        bool "latest"

    config PKG_USING_GUIENGINE_V200
        bool "v2.0.0"
endchoice

config PKG_GUIENGINE_VER
    string
    default "v2.0.0" if PKG_USING_GUIENGINE_V200
    default "latest" if PKG_USING_GUIENGINE_LATEST_VERSION

config GUIENGINE_NAME_MAX
    int "The maximal size of name in GUI engine"
    default 16

config GUIENGINE_USING_TTF
    bool "Support TrueType font"
    default n

config GUIENGINE_TTF_UTF8
    depends on GUIENGINE_USING_TTF
    bool "Support display UTF-8 format string by TrueType font"
    default n

config GUIENG_USING_FNT_FILE
    bool "Support fnt font"
    default y

config GUIENGINE_USING_FONT16
    bool "Support 16 height font"
    default y

config GUIENGINE_USING_FONT12
    bool "Support 12 height font"
    default y

config GUIENGINE_USING_FONTHZ
    bool "Support Chinese font"
    default n

config GUIENGINE_USING_HZ_FILE
    depends on GUIENGINE_USING_FONTHZ
    bool "Place Chinese font on file system"
    default y

config GUIENGINE_IMAGE_XPM
    bool "Support XPM image format"
    default n

config GUIENGINE_USING_JPG
    bool "Support JPG image format"
    default n

if GUIENGINE_USING_JPG
    choice
        prompt "JPEG image format"
        default GUIENGINE_IMAGE_TJPGD

        config GUIENGINE_IMAGE_TJPGD
            bool "with TJpgDec(Tiny JPEG Decompressor)"

        config GUIENGINE_IMAGE_JPEG
            bool "with Libjpeg"
    endchoice
endif

config GUIENGINE_USING_PNG
    bool "Support PNG image format"
    default y

if GUIENGINE_USING_PNG
    choice
        prompt "PNG image format"
        default GUIENGINE_IMAGE_LODEPNG

        config GUIENGINE_IMAGE_LODEPNG
            bool "with LodePNG"

        config GUIENGINE_IMAGE_PNG
            bool "with LibPNG"
    endchoice
endif

config GUIENGINE_IMAGE_BMP
    bool "Support BMP image format"
    default n

config GUIENGINE_IMAGE_CONTAINER
    bool "Use image container"
    default y

config GUIENGINE_USING_DEMO
    bool "Enable the example of GUI Engine"
    default n

endif
```

## system/heartbeat/Kconfig
```kconfig
# Kconfig file for package heartbeat
menuconfig PKG_USING_HEARTBEAT
    bool "heartbeat: A heartbeat package."
    default n

if PKG_USING_HEARTBEAT

    config PKG_HEARTBEAT_PATH
        string
        default "/packages/system/heartbeat"

    config PKG_HEARTBEAT_LED_PIN
        int "heartbeat led pin"
        default -1
        help
            Set the number of pin

    config PKG_HEARTBEAT_LED_ACTIVE_LOGIC
        int "Active level for the heartbeat enable pin (0 = low, 1 = high)"
        range 0 1
        default 0

    choice
        prompt "Version"
        default PKG_USING_HEARTBEAT_LATEST_VERSION
        help
            Select the this package version

        config PKG_USING_HEARTBEAT_LATEST_VERSION
            bool "latest"
    endchoice

    config PKG_HEARTBEAT_VER
        string
        default "latest" if PKG_USING_HEARTBEAT_LATEST_VERSION

endif
```

## system/jffs2/Kconfig
```kconfig
# Kconfig file for package jffs2
menuconfig PKG_USING_DFS_JFFS2
    bool "JFFS2: Journalling Flash File System V2."
    select RT_USING_DFS      if RT_VER_NUM < 0x40100
    select RT_USING_LIBC     if RT_VER_NUM < 0x40100
    select RT_USING_POSIX    if RT_VER_NUM < 0x40100
    select RT_USING_POSIX_FS if RT_VER_NUM >= 0x40100
    select RT_USING_MTD_NOR
    default n

if PKG_USING_DFS_JFFS2

    config PKG_JFFS2_PATH
        string
        default "/packages/system/jffs2"

    config RT_USING_DFS_JFFS2
        bool
        default y

    choice
        prompt "Version"
        default PKG_USING_DFS_JFFS2_LATEST_VERSION
        help
            Select the package version

        config PKG_USING_DFS_JFFS2_LATEST_VERSION
            bool "latest"
    endchoice

    config PKG_JFFS2_VER
       string
       default "latest"    if PKG_USING_DFS_JFFS2_LATEST_VERSION

endif
```

## system/kmulti_rtimer/Kconfig
```kconfig
# Kconfig file for package kmulti_rtimer
menuconfig PKG_USING_KMULTI_RTIMER
    bool "a multi timer for rt-thread."
    default n

if PKG_USING_KMULTI_RTIMER

    config PKG_KMULTI_RTIMER_HWTIMER_DEV_NAME
        string "The hwtimer device name for multi rtimer"
        default "hwtimer1"

    config PKG_USING_KMULTI_RTIMER_DEMO
        bool "Use demo"
        default n

    config PKG_KMULTI_RTIMER_PATH
        string
        default "/packages/system/kmulti_rtimer"

    choice
        prompt "Version"
        default PKG_USING_KMULTI_RTIMER_LATEST_VERSION
        help
            Select the package version

        config PKG_USING_KMULTI_RTIMER_LATEST_VERSION
            bool "latest"
    endchoice

    config PKG_KMULTI_RTIMER_VER
       string
       default "latest"    if PKG_USING_KMULTI_RTIMER_LATEST_VERSION

endif
```

## system/levelx/Kconfig
```kconfig
# Kconfig file for package levelx
menuconfig PKG_USING_LEVELX
    bool "levelx:Threadx's wear-leveling component for rtthread."
    default n

if PKG_USING_LEVELX

    config PKG_LEVELX_PATH
        string
        default "/packages/system/levelx"

    menuconfig PKG_USING_LEVEL_NOR
        bool
        prompt "Enable levelx support for nor flash"
        default y
    if PKG_USING_LEVEL_NOR
        config PKG_USING_LEVEL_DEMO_MEM
            bool
            prompt "Enable levelx nor demo"
            default n
    endif

    menuconfig PKG_USING_LEVEL_NAND
        bool
        prompt "Enable levelx support for nand flash"
        default y    
    choice
        prompt "Version"
        default PKG_USING_LEVELX_LATEST_VERSION
        help
            Select the package version
        config PKG_USING_LEVELX_LATEST_VERSION
            bool "latest"
    endchoice

    config PKG_LEVELX_VER
       string
       default "latest"    if PKG_USING_LEVELX_LATEST_VERSION

endif
```

## system/littlefs/Kconfig
```kconfig
# Kconfig file for package littlefs
menuconfig PKG_USING_LITTLEFS
    bool "Littlefs: A high-integrity embedded file system"
    select RT_USING_MTD_NOR
    default n

if PKG_USING_LITTLEFS

    config PKG_LITTLEFS_PATH
        string
        default "/packages/system/littlefs"

    choice
        prompt "Version"
        default PKG_USING_LITTLEFS_V250  if RT_VER_NUM < 0x50000
        default PKG_USING_LITTLEFS_LATEST_VERSION
        help
            Select the package version

        config PKG_USING_LITTLEFS_V090
            bool "v0.9.0"

        config PKG_USING_LITTLEFS_V170
            bool "v1.7.0"

        config PKG_USING_LITTLEFS_V172
            bool "v1.7.2"

        config PKG_USING_LITTLEFS_V201
            bool "v2.0.1"

        config PKG_USING_LITTLEFS_V205
            bool "v2.0.5"

        config PKG_USING_LITTLEFS_V214
            bool "v2.1.4"

        config PKG_USING_LITTLEFS_V220
            bool "v2.2.0"

        config PKG_USING_LITTLEFS_V221
            bool "v2.2.1"

        config PKG_USING_LITTLEFS_V230
            bool "v2.3.0"

        config PKG_USING_LITTLEFS_V250
            bool "v2.5.0"

        config PKG_USING_LITTLEFS_V293
            bool "v2.9.3"

        config PKG_USING_LITTLEFS_V2112
            bool "v2.11.2"

        config PKG_USING_LITTLEFS_LATEST_VERSION
            bool "latest"
    endchoice

    config LFS_READ_SIZE
        int "disk read size"
        default 256

    config LFS_PROG_SIZE
        int "disk write size"
        default 256

    config LFS_BLOCK_SIZE
        int "disk block size"
        default 4096

    config LFS_YES_TRACE
        bool "Enable LittleFS trace logs"
        default n
        help
            Enable verbose trace logging from LittleFS. This is very noisy
            and may impact performance.

    config LFS_NO_DEBUG
        bool "Disable LittleFS debug logs"
        default y
        help
            Disable debug-level logging from LittleFS.

    config LFS_NO_WARN
        bool "Disable LittleFS warning logs"
        default n
        help
            Disable warning-level logging from LittleFS.

    config LFS_NO_ERROR
        bool "Disable LittleFS error logs"
        default n
        help
            Disable error-level logging from LittleFS.

    config LFS_NO_ASSERT
        bool "Disable LittleFS runtime asserts"
        default n
        help
            Disable runtime assertions inside LittleFS. This reduces safety
            checks and is not recommended for debug builds.

    config LFS_NO_INTRINSICS
        bool "Disable LittleFS compiler intrinsics"
        default n
        help
            Use generic C implementations instead of compiler intrinsics.
            Useful for debugging or toolchains without builtin support.

    config LFS_NO_MALLOC
        bool "Disable LittleFS dynamic allocation"
        default n
        help
            Disallow dynamic allocation inside LittleFS. When enabled,
            operations that require allocation may fail with LFS_ERR_NOMEM.

    if PKG_USING_LITTLEFS_V090 || PKG_USING_LITTLEFS_V170 || PKG_USING_LITTLEFS_V172
        config LFS_LOOKAHEAD
            int "lfs lookahead size"
            default 128
    endif

    if !(PKG_USING_LITTLEFS_V090 || PKG_USING_LITTLEFS_V170 || PKG_USING_LITTLEFS_V172)
        config LFS_CACHE_SIZE
            int "lfs r/w cache size"
            default LFS_PROG_SIZE
        if (PKG_USING_LITTLEFS_V201 || PKG_USING_LITTLEFS_V205)
        config LFS_BLOCK_CYCLES
            int "lfs enable wear leveling. 0 is disable."
            default 0
        endif
        if !(PKG_USING_LITTLEFS_V201 || PKG_USING_LITTLEFS_V205)
        config LFS_BLOCK_CYCLES
            int "lfs enable wear leveling. -1 is disable."
            default -1
        endif

        config DFS_LFS_READONLY
            bool "lfs enable readonly system"
            default 0
            if DFS_LFS_READONLY
            config LFS_READONLY
                bool
                default y
            endif

        config LFS_THREADSAFE
            bool
            default y

        config LFS_LOOKAHEAD_MAX
            int "lfs lookahead size"
            default 128
    endif

    config RT_DEF_LFS_DRIVERS
        int "lfs drivers count"
        default 1

    config PKG_LITTLEFS_VER
       string
       default "v0.9.0" if PKG_USING_LITTLEFS_V090
       default "v1.7.0" if PKG_USING_LITTLEFS_V170
       default "v1.7.2" if PKG_USING_LITTLEFS_V172
       default "v2.0.1" if PKG_USING_LITTLEFS_V201
       default "v2.0.5" if PKG_USING_LITTLEFS_V205
       default "v2.1.4" if PKG_USING_LITTLEFS_V214
       default "v2.2.0" if PKG_USING_LITTLEFS_V220
       default "v2.2.1" if PKG_USING_LITTLEFS_V221
       default "v2.3.0" if PKG_USING_LITTLEFS_V230
       default "v2.5.0" if PKG_USING_LITTLEFS_V250
       default "v2.9.3" if PKG_USING_LITTLEFS_V293
       default "v2.11.2" if PKG_USING_LITTLEFS_V2112
       default "latest" if PKG_USING_LITTLEFS_LATEST_VERSION

endif
```

## system/lpm/Kconfig
```kconfig
# Kconfig file for package lpm
menuconfig PKG_USING_LPM
    bool "lpm: Logical partition management. Manage storage device and partition."
    select RT_USING_LIBC if RT_VER_NUM < 0x40100
    default n

if PKG_USING_LPM

    config PKG_LPM_PATH
        string
        default "/packages/system/lpm"

    choice
        prompt "version"
        default PKG_USING_LPM_V00101
        help
            Select the version

        config PKG_USING_LPM_V00101
            bool "v0.1.1"

        config PKG_USING_LPM_LATEST_VERSION
            bool "latest"
    endchoice

    config PKG_LPM_VER
       string
       default "latest"    if PKG_USING_LPM_LATEST_VERSION
       default "v0.1.1"    if PKG_USING_LPM_V00101

    config PKG_LPM_VER_NUM
        hex
        default 0x00101    if PKG_USING_LPM_V00101

endif
```

## system/lwext4/Kconfig
```kconfig
menuconfig PKG_USING_LWEXT4
    bool "lwext4: an excellent choice of ext2/3/4 filesystem for microcontrollers."
    default n

if PKG_USING_LWEXT4

    config PKG_LWEXT4_PATH
        string
        default "/packages/system/lwext4"

    config RT_USING_DFS_LWEXT4
        bool
        default y

    choice
        prompt "lwext4 version"
        default PKG_USING_LWEXT4_V200 if RT_USING_SMART
        help
            Select the lwext4 version

        if (RT_USING_SMART && RT_VER_NUM > 0x50100)
            config PKG_USING_LWEXT4_V200
                bool "v2.0.0-dfsv2"
        endif

        config PKG_USING_LWEXT4_LATEST_VERSION
            bool "latest"

        config PKG_USING_LWEXT4_V110
            bool "v1.1.0"
    endchoice

    config PKG_LWEXT4_VER
       string
       default "v2.0.0-dfsv2" if PKG_USING_LWEXT4_V200
       default "v1.1.0" if PKG_USING_LWEXT4_V110
       default "latest" if PKG_USING_LWEXT4_LATEST_VERSION

endif
```

## system/mcuboot/Kconfig
```kconfig
# Kconfig file for package mcuboot
menuconfig PKG_USING_MCUBOOT
    bool "A common infrastructure for bootloader, system flash layout."
    default n

if PKG_USING_MCUBOOT

    config PKG_MCUBOOT_PATH
        string
        default "/packages/system/mcuboot"

    choice
        prompt "Version"
        default PKG_USING_MCUBOOT_LATEST_VERSION
        help
            Select the package version

        config PKG_USING_MCUBOOT_V180
            bool "v1.8.0"

        config PKG_USING_MCUBOOT_LATEST_VERSION
            bool "latest"
    endchoice

    config PKG_MCUBOOT_VER
       string
       default "v1.8.0"    if PKG_USING_MCUBOOT_V180
       default "latest"    if PKG_USING_MCUBOOT_LATEST_VERSION

    menuconfig MCUBOOT_FLASH_DEVICE_USE
    bool "MCUboot flash device choose"
    default y
    if MCUBOOT_FLASH_DEVICE_USE
        config MCUBOOT_FLASH_DEVICE_W25Q
            bool "w25qxx qspi flash as mcuboot device"
            default y
    endif
    config MCUBOOT_FLASH_DEVICE_ID
        int "flash device id"
        default 1
    config MCUBOOT_FLASH_SECTOR_SIZE
        int "flash erase sector size"
        default 4096
    config MCUBOOT_IMAGE_SLOT_SECTOR_COUNTS
        int "sectors counts of image slot"
        default 64
endif
```
