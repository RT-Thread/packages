## system/syswatch/Kconfig
```kconfig
# Kconfig file for package syswatch

menuconfig PKG_USING_SYSWATCH
    bool "syswatch : A component used to ensure the long-term normal running of the system"
    select RT_USING_HOOK
    select RT_USING_WDT
    default n

if PKG_USING_SYSWATCH

    config PKG_SYSWATCH_PATH
        string
        default "/packages/system/syswatch"

    config SYSWATCH_USING_TEST
        bool "using test sample"
        default n

    choice
        prompt "The mode of resolve exception thread"
        default SYSWATCH_EXCEPT_RESOLVE_MODE_2
        help
            Select the mode of resolve exception thread

        config SYSWATCH_EXCEPT_RESOLVE_MODE_0
            bool "0.system reset"
            
        config SYSWATCH_EXCEPT_RESOLVE_MODE_1
            bool "1.kill exception thread"
            
        config SYSWATCH_EXCEPT_RESOLVE_MODE_2
            bool "2.resume exception thread"
    endchoice
            
    config SYSWATCH_EXCEPT_RESOLVE_MODE
        int
        default 0 if SYSWATCH_EXCEPT_RESOLVE_MODE_0
        default 1 if SYSWATCH_EXCEPT_RESOLVE_MODE_1
        default 2 if SYSWATCH_EXCEPT_RESOLVE_MODE_2

    config SYSWATCH_EXCEPT_TIMEOUT
        int "Timeout of determine thread exception, unit : s"
        default 60

    config SYSWATCH_EXCEPT_CONFIRM_TMO
        int "Timeout of confirm exception thread, unit : s"
        default 15   

    config SYSWATCH_EXCEPT_RESUME_DLY
        int "Delay time of resume exception thread, unit : s"
        default 15   

    config SYSWATCH_THREAD_PRIO
        int "The priority of syswatch thread"
        default 0   

    config SYSWATCH_THREAD_STK_SIZE
        int "The stack size of syswatch thread"
        default 512   

    config SYSWATCH_THREAD_NAME
        string "The name of syswatch thread"
        default "syswatch"   

    config SYSWATCH_WDT_NAME
        string "The name of watchdog device"
        default "wdt"   

    config SYSWATCH_WDT_TIMEOUT
        int "Timeout of watchdog device"
        default 5   

    choice
        prompt "Version"
        default PKG_USING_SYSWATCH_LATEST_VERSION
        help
            Select the package version

        config PKG_USING_SYSWATCH_LATEST_VERSION
            bool "latest"
            
        #config PKG_USING_SYSWATCH_V010
        #    bool "v0.1.0"
        
    endchoice

    config PKG_SYSWATCH_VER
       string
       default "latest" if PKG_USING_SYSWATCH_LATEST_VERSION
       #default "v0.1.0" if PKG_USING_SYSWATCH_V010

endif
```

## system/thread_manager/Kconfig
```kconfig
# Kconfig file for package thread_manager
menuconfig PKG_USING_THREAD_MANAGER
    bool "Thread manager (task registry, message dispatch, manager thread)"
    default n
    select PKG_USING_EVENT_LOOP
    select RT_USING_SEMAPHORE
    select RT_USING_MUTEX
    select RT_USING_EVENT
    select RT_USING_MAILBOX
    help
        Core threading framework for RT-Thread: thread_msg_registry, TASK_ID
        lookup, manager thread / thread_spawn_all_registered, and related APIs.
        Thread IDs, stack sizes and priorities are defined in inc/thread_config.h
        (edit that file for your application).
        Delayed events (thread_evt_send_delayed_*) use packages/event_loop.

if PKG_USING_THREAD_MANAGER

    config PKG_THREAD_MANAGER_PATH
        string
        default "/packages/system/thread_manager"

    config THREAD_SYSTEM_READY
        bool "Publish system-ready event after startup sync"
        default y
        help
          After all registered tasks complete thread_mgr_sys_start_sync_end,
          the manager publishes a global rt_event bit. Tasks call
          thread_sysready_wait() to block until the system is fully up.
          The event bit is never cleared so late callers return immediately.

    config THREAD_MANAGER_USING_SAMPLES
        bool "Build samples (thread_test / thread_test1 / thread_test2)"
        default y
        help
          Compiles packages/thread_manager/samples/*.c (demo threads and
          cross-subscription demo between sample threads). Disable to save Flash.

    choice
        prompt "Version"
        default PKG_USING_THREAD_MANAGER_V100
        help
            Select the package version

        config PKG_USING_THREAD_MANAGER_V100
            bool "v1.0.0"

        config PKG_USING_THREAD_MANAGER_LATEST_VERSION
            bool "latest"
    endchoice

    config PKG_THREAD_MANAGER_VER
       string
       default "v1.0.0"    if PKG_USING_THREAD_MANAGER_V100
       default "latest"    if PKG_USING_THREAD_MANAGER_LATEST_VERSION

endif
```

## system/thread_pool/Kconfig
```kconfig
# Kconfig file for package thread_pool
menuconfig PKG_USING_THREAD_POOL
    bool "thread_pool: A thread pool base on RT-Thread"
    default n

if PKG_USING_THREAD_POOL

    config PKG_THREAD_POOL_PATH
        string
        default "/packages/system/thread_pool"

    config THREAD_POOL_USING_SAMPLES
        bool "Enable samples"
        default n

    choice
        prompt "Version"
        default PKG_USING_THREAD_POOL_LATEST_VERSION
        help
            Select the package version

        config PKG_USING_THREAD_POOL_V401
            bool "v4.0.1"

        config PKG_USING_THREAD_POOL_LATEST_VERSION
            bool "latest"
    endchoice

    config PKG_THREAD_POOL_VER
       string
       default "v4.0.1"    if PKG_USING_THREAD_POOL_V401
       default "latest"    if PKG_USING_THREAD_POOL_LATEST_VERSION

endif
```

## system/tlsf/Kconfig
```kconfig
# Kconfig file for package tlsf
menuconfig PKG_USING_TLSF
    bool "TLSF: A dynamic memory allocation algorithm with predictable execution time and low fragmentation."
    default n

if PKG_USING_TLSF

    config PKG_TLSF_PATH
        string
        default "/packages/system/tlsf"

    config PKG_TLSF_USING_ALIGN
        bool "Enable TLSF align"
        default n

    choice
        prompt "Version"
        default PKG_USING_TLSF_LATEST_VERSION
        help
            Select the package version

        config PKG_USING_TLSF_V100
            bool "v1.0.0"

        config PKG_USING_TLSF_LATEST_VERSION
            bool "latest"
    endchoice

    config PKG_TLSF_VER
       string
       default "latest"    if PKG_USING_TLSF_LATEST_VERSION
       default "v1.0.0"    if PKG_USING_TLSF_V100

endif
```

## system/touch/Kconfig
```kconfig
# Kconfig file for package touch
menuconfig PKG_USING_TOUCH
    bool "touch: A touch device framework based on RT-Thread"
    default n

if PKG_USING_TOUCH
    config PKG_TOUCH_PATH
        string
        default "/packages/system/touch"

    choice
        prompt "Version"
        default PKG_USING_TOUCH_LATEST_VERSION
        help
            Select the package version

        config PKG_USING_TOUCH_LATEST_VERSION
            bool "latest"
    endchoice    
    
    menu "Select Touch IC"

        config FT3X07
            bool "ft3x07"

    endmenu   
   
    config PKG_TOUCH_SAMPLE_HZ
        int "Set the touch screen sample rate"
        default 50   

    config PKG_TOUCH_I2C_NAME
        string "Set the IIC bus device name"
        default "i2c1"   

    config PKG_TOUCH_VER
       string
       default "v1.0.0"    if PKG_USING_TOUCH_V100
       default "latest"    if PKG_USING_TOUCH_LATEST_VERSION

endif
```

## system/tz-database/Kconfig
```kconfig
# Kconfig file for package tz-database
menuconfig PKG_USING_TZ_DATABASE
    bool "tz: time zone database and code"
    default n

if PKG_USING_TZ_DATABASE

    config PKG_TZ_DATABASE_PATH
        string
        default "/packages/system/tz-database"

    choice
        prompt "Version"
        help
            Select the package version

        config PKG_USING_TZ_DATABASE_LATEST_VERSION
            bool "latest"
    endchoice

    config PKG_TZ_DATABASE_VER
       string
       default "latest"    if PKG_USING_TZ_DATABASE_LATEST_VERSION

endif
```

## system/uCOSIII_Wrapper/Kconfig
```kconfig
# Kconfig file for package uCOSIII_Wrapper
menuconfig PKG_USING_UCOSIII_WRAPPER
    bool "uCOS-III Wrapper: uCOS-III APIs wrapper"
    default n
    select RT_USING_TIMER_SOFT
    select RT_USING_IDLE_HOOK
    help
        A wrapper which can make codes developed by uCOS-III APIs can directly run on RT-Thread

if PKG_USING_UCOSIII_WRAPPER

    config PKG_UCOSIII_WRAPPER_PATH
        string
        default "/packages/system/uCOSIII_Wrapper"

    config PKG_USING_UCOSIII_WRAPPER_AUTOINIT
        bool "Enable uCOS-III wrapper automatically init"
        default n
        help
            The wrapper supports uCOS-III standard startup procedure. Alternatively,
            if you want to run uCOS-III apps directly and ignore the startup procedure, 
            you can choose this option.
            
    choice
        prompt "Version"
        default PKG_USING_UCOSIII_WRAPPER_LATEST_VERSION
        help
            Select the package version

        config PKG_USING_UCOSIII_WRAPPER_LATEST_VERSION
            bool "latest"
    endchoice
          
    config PKG_UCOSIII_WRAPPER_VER
       string
       default "latest"    if PKG_USING_UCOSIII_WRAPPER_LATEST_VERSION

endif
```

## system/uC_CLK/Kconfig
```kconfig
# Kconfig file for package uC_CLK
menuconfig PKG_USING_UC_CLK
    bool "uC/Clk for RT-Thread"
    default n
    select PKG_USING_UCOSIII_WRAPPER

if PKG_USING_UC_CLK

    config PKG_UC_CLK_PATH
        string
        default "/packages/system/uC_CLK"

    choice
        prompt "Version"
        default PKG_USING_UC_CLK_LATEST_VERSION
        help
            Select the package version

        config PKG_USING_UC_CLK_V100
            bool "v1.0.0"

        config PKG_USING_UC_CLK_LATEST_VERSION
            bool "latest"
    endchoice
          
    config PKG_UC_CLK_VER
       string
       default "v1.0.0"    if PKG_USING_UC_CLK_V100
       default "latest"    if PKG_USING_UC_CLK_LATEST_VERSION

endif
```

## system/uffs/Kconfig
```kconfig
# Kconfig file for package uffs
menuconfig PKG_USING_DFS_UFFS
    bool "UFFS: Ultra-low-cost Flash File System."
    select RT_USING_DFS      if RT_VER_NUM < 0x40100
    select RT_USING_POSIX_FS if RT_VER_NUM >= 0x40100
    select RT_USING_MTD_NAND
    default n

if PKG_USING_DFS_UFFS

    config PKG_UFFS_PATH
        string
        default "/packages/system/uffs"

    config RT_USING_DFS_UFFS
        bool
        default y

    choice
        prompt "UFFS ECC mode"
        default RT_UFFS_ECC_MODE_1

        config RT_UFFS_ECC_MODE_0
            bool "0: Do not use ECC"

        config RT_UFFS_ECC_MODE_1
            bool "1: UFFS calculate the ECC"

        config RT_UFFS_ECC_MODE_2
            bool "2: Flash driver(or by hardware) calculate the ECC"

        config RT_UFFS_ECC_MODE_3
            bool "3: Hardware calculate the ECC and automatically write to spare."
    endchoice

    config RT_UFFS_ECC_MODE
        int
        default 0 if RT_UFFS_ECC_MODE_0
        default 1 if RT_UFFS_ECC_MODE_1
        default 2 if RT_UFFS_ECC_MODE_2
        default 3 if RT_UFFS_ECC_MODE_3


    choice
        prompt "Version"
        default PKG_USING_DFS_UFFS_LATEST_VERSION
        help
            Select the package version

        config PKG_USING_DFS_UFFS_LATEST_VERSION
            bool "latest"
    endchoice

    config PKG_UFFS_VER
       string
       default "latest"    if PKG_USING_DFS_UFFS_LATEST_VERSION

endif
```

## system/usb_stack/Kconfig
```kconfig
# Kconfig file for package usb_stack
menuconfig PKG_USING_USB_STACK
    bool "USB Stack: tiny and portable USB stack for embedded system with USB IP"
    default n

if PKG_USING_USB_STACK

menu "USB Stack Options"

    config PKG_USB_STACK_USING_HS
    bool
    prompt "Enable usb high speed mode"
    default n
    
    config PKG_USB_STACK_USING_DEVICE
        bool
        prompt "Enable usb device mode"
        default n
        
    config PKG_USB_STACK_USING_CDC
        bool
        prompt "Enable usb cdc acm device"
        default n
        depends on PKG_USB_STACK_USING_DEVICE
        
    config PKG_USB_STACK_USING_HID
        bool
        prompt "Enable usb hid device"
        default n
        depends on PKG_USB_STACK_USING_DEVICE
        
    config PKG_USB_STACK_USING_DFU
        bool
        prompt "Enable usb dfu device"
        default n
        depends on PKG_USB_STACK_USING_DEVICE
        
    config PKG_USB_STACK_USING_MSC
        bool
        prompt "Enable usb msc device"
        default n
        depends on PKG_USB_STACK_USING_DEVICE  
        
    config PKG_USB_STACK_USING_HUB
        bool
        prompt "Enable usb hub device"
        default n
        depends on PKG_USB_STACK_USING_DEVICE   
        
    config PKG_USB_STACK_USING_AUDIO
        bool
        prompt "Enable usb audio device"
        default n
        depends on PKG_USB_STACK_USING_DEVICE  
        
    config PKG_USB_STACK_USING_VIDEO
        bool
        prompt "Enable usb video device"
        default n
        depends on PKG_USB_STACK_USING_DEVICE        

endmenu

    config PKG_USB_STACK_PATH
        string
        default "/packages/system/usb_stack"

    choice
        prompt "Version"
        default PKG_USING_USB_STACK_LATEST_VERSION
        help
            Select the package version

        config PKG_USING_USB_STACK_LATEST_VERSION
            bool "latest"
    endchoice
          
    config PKG_USB_STACK_VER
       string
       default "latest"    if PKG_USING_USB_STACK_LATEST_VERSION

endif
```

## system/wcwidth/Kconfig
```kconfig
# Kconfig file for package wcwidth
menuconfig PKG_USING_WCWIDTH
    bool "wcwidth: wcwidth() function"
    default n

if PKG_USING_WCWIDTH

    config PKG_WCWIDTH_PATH
        string
        default "/packages/system/wcwidth"

    choice
        prompt "Version"
        default PKG_USING_WCWIDTH_LATEST_VERSION
        help
            Select the package version

        config PKG_USING_WCWIDTH_LATEST_VERSION
            bool "latest"
    endchoice

    config PKG_WCWIDTH_VER
       string
       default "latest"    if PKG_USING_WCWIDTH_LATEST_VERSION

endif
```
