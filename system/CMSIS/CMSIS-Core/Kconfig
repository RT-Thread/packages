## system/Micrium/uC_Common/Kconfig
```kconfig
# Kconfig file for package uC_Common
menuconfig PKG_USING_UC_COMMON
    bool "uC/Common for RT-Thread"
    default n
    select PKG_USING_UCOSIII_WRAPPER

if PKG_USING_UC_COMMON

    config PKG_UC_COMMON_PATH
        string
        default "/packages/system/Micrium/uC_Common"

    choice
        prompt "Version"
        default PKG_USING_UC_COMMON_LATEST_VERSION
        help
            Select the package version

        config PKG_USING_UC_COMMON_V100
            bool "v1.0.0"

        config PKG_USING_UC_COMMON_LATEST_VERSION
            bool "latest"
    endchoice

    config PKG_UC_COMMON_VER
       string
       default "v1.0.0"    if PKG_USING_UC_COMMON_V100
       default "latest"    if PKG_USING_UC_COMMON_LATEST_VERSION

endif
```

## system/Micrium/uC_Modbus/Kconfig
```kconfig
# Kconfig file for package uC_Modbus
menuconfig PKG_USING_UC_MODBUS
    bool "uC/Modbus for RT-Thread"
    default n
    select PKG_USING_UCOSIII_WRAPPER

if PKG_USING_UC_MODBUS

    config PKG_UC_MODBUS_PATH
        string
        default "/packages/system/Micrium/uC_Modbus"

    config PKG_USING_UC_MODBUS_TASK_PRIO
        int "The priority level value of uC/Modbus task"
        default 10

    config PKG_USING_UC_MODBUS_TASK_STK_SIZE
        int "The stack size of uC/Modbus task (sizeof(CPU_STK))"
        default 128

    choice
        prompt "Version"
        default PKG_USING_UC_MODBUS_LATEST_VERSION
        help
            Select the package version

        config PKG_USING_UC_MODBUS_V100
            bool "v1.0.0"

        config PKG_USING_UC_MODBUS_LATEST_VERSION
            bool "latest"
    endchoice

    config PKG_UC_MODBUS_VER
       string
       default "v1.0.0"    if PKG_USING_UC_MODBUS_V100
       default "latest"    if PKG_USING_UC_MODBUS_LATEST_VERSION

endif
```

## system/POSIX/Kconfig
```kconfig
menu "POSIX extension functions"

source "$PKGS_DIR/packages/system/POSIX/getline/Kconfig"
source "$PKGS_DIR/packages/system/POSIX/wcwidth/Kconfig"
source "$PKGS_DIR/packages/system/POSIX/itoa/Kconfig"
source "$PKGS_DIR/packages/system/POSIX/strings/Kconfig"
source "$PKGS_DIR/packages/system/POSIX/ctypes/Kconfig"

endmenu
```
