## iot/atsrv_socket/Kconfig
```kconfig
menuconfig PKG_USING_ATSRV_SOCKET
    bool "AT Server Socket: AT server with socket commands."
    default n
    select RT_USING_AT
    select AT_USING_SERVER


if PKG_USING_ATSRV_SOCKET

    config PKG_ATSRV_SOCKET_PATH
        string
        default "/packages/iot/atsrv_socket"

    config AT_SERVER_DEVICE
        string "Server device name"

    config ATSRV_SOCKET_ENABLE_BASE
        bool
        prompt "Enable base AT command"
        default y
        select ATSRV_SOCKET_ENABLE_CMD_AT
        select ATSRV_SOCKET_ENABLE_CMD_ATZ
        select ATSRV_SOCKET_ENABLE_CMD_RST
        select ATSRV_SOCKET_ENABLE_CMD_ATE
        select ATSRV_SOCKET_ENABLE_CMD_ATL
        select ATSRV_SOCKET_ENABLE_CMD_UART

    config ATSRV_SOCKET_ENABLE_CMD_AT
        bool
        prompt "AT: AT test"
        default y
        depends on ATSRV_SOCKET_ENABLE_BASE

    config ATSRV_SOCKET_ENABLE_CMD_ATZ
        bool
        prompt "ATZ: recover to factory setting"
        default y
        depends on ATSRV_SOCKET_ENABLE_BASE

    config ATSRV_SOCKET_ENABLE_CMD_RST
        bool
        prompt "AT+RST: reboot"
        default y
        depends on ATSRV_SOCKET_ENABLE_BASE

    config ATSRV_SOCKET_ENABLE_CMD_ATE
        bool
        prompt "ATE: enable/disable echo"
        default y
        depends on ATSRV_SOCKET_ENABLE_BASE

    config ATSRV_SOCKET_ENABLE_CMD_ATL
        bool
        prompt "AT&L: list all command"
        default y
        depends on ATSRV_SOCKET_ENABLE_BASE

    config ATSRV_SOCKET_ENABLE_CMD_UART
        bool
        prompt "AT+UART: UART configuration"
        default y
        depends on ATSRV_SOCKET_ENABLE_BASE

    config ATSRV_SOCKET_ENABLE_CMD_GMR
        bool
        prompt "AT+GMR: show the version of AT"
        default n
        depends on ATSRV_SOCKET_ENABLE_BASE

    config ATSRV_SOCKET_ENABLE_CMD_SYSRAM
        bool
        prompt "AT+SYSRAM: list free memery"
        default n
        depends on ATSRV_SOCKET_ENABLE_BASE

    config ATSRV_SOCKET_ENABLE_OTA
        bool
        prompt "Enable OTA AT command"
        default n

    config ATSRV_SOCKET_ENABLE_CMD_OTA
        bool
        prompt "AT+OTA: update firmware use OTA"
        default y
        depends on ATSRV_SOCKET_ENABLE_OTA

    config ATSRV_SOCKET_ENABLE_WLAN
        bool
        prompt "Enable WLAN AT command"
        default n
        select RT_USING_SAL
        select RT_USING_LIBC if RT_VER_NUM < 0x40100
        select RT_USING_WIFI

    config ATSRV_SOCKET_ENABLE_CMD_CWMODE
        bool
        prompt "AT+CWMODE: mode select"
        default y
        depends on ATSRV_SOCKET_ENABLE_WLAN

    config ATSRV_SOCKET_ENABLE_CMD_CWLAP
        bool
        prompt "AT+CWLAP: scan and list AP"
        default y
        depends on ATSRV_SOCKET_ENABLE_WLAN

    config ATSRV_SOCKET_ENABLE_CMD_CWJAP
        bool
        prompt "AT+CWJAP: connect to AP"
        default y
        depends on ATSRV_SOCKET_ENABLE_WLAN

    config ATSRV_SOCKET_ENABLE_CMD_CWQAP
        bool
        prompt "AT+CWQAP: disconnect from AP"
        default y
        depends on ATSRV_SOCKET_ENABLE_WLAN

    config ATSRV_SOCKET_ENABLE_TCPIP
        bool
        prompt "Enable TCP/IP AT command"
        default n
        select RT_USING_SAL
        select RT_USING_LIBC if RT_VER_NUM < 0x40100
        select RT_USING_WIFI

    config ATSRV_SOCKET_ENABLE_CMD_CIPSTATUS
        bool
        prompt "AT+CIPSTATUS: show network status"
        default y
        depends on ATSRV_SOCKET_ENABLE_TCPIP

    config ATSRV_SOCKET_ENABLE_CMD_CIPMUX
        bool
        prompt "AT+CIPMUX: connect mode setting"
        default y
        depends on ATSRV_SOCKET_ENABLE_TCPIP

    config ATSRV_SOCKET_ENABLE_CMD_PING
        bool
        prompt "AT+PING: PING"
        default y
        depends on ATSRV_SOCKET_ENABLE_TCPIP

    config ATSRV_SOCKET_ENABLE_CMD_CIPDOMAIN
        bool
        prompt "AT+CIPDOMAIN: DNS resolution"
        default y
        depends on ATSRV_SOCKET_ENABLE_TCPIP

    config ATSRV_SOCKET_ENABLE_CMD_CIPSTART
        bool
        prompt "AT+CIPSTART: establish TCP/UDP connection"
        default y
        depends on ATSRV_SOCKET_ENABLE_TCPIP

    config ATSRV_SOCKET_ENABLE_CMD_CIPCLOSE
        bool
        prompt "AT+CIPCLOSE: close connection"
        default y
        depends on ATSRV_SOCKET_ENABLE_TCPIP

    config ATSRV_SOCKET_ENABLE_CMD_CIPSEND
        bool
        prompt "AT+CIPSEND: send data to network"
        default y
        depends on ATSRV_SOCKET_ENABLE_TCPIP

    choice
        prompt "Version"
        default PKG_USING_ATSRV_SOCKET_V100

        help
            Select the atsrv_socket version

        config PKG_USING_ATSRV_SOCKET_V100
            bool "v1.0.0"

        config PKG_USING_ATSRV_SOCKET_LATEST_VERSION
            bool "latest"

    endchoice

    config PKG_ATSRV_SOCKET_VER
    string
    default "v1.0.0" if PKG_USING_ATSRV_SOCKET_V100
    default "latest" if PKG_USING_ATSRV_SOCKET_LATEST_VERSION

endif
```

## iot/bc28_mqtt/Kconfig
```kconfig
# Kconfig file for package bc28_mqtt
menuconfig PKG_USING_BC28_MQTT
    bool "BC28 MQTT: connect to Aliyun with Quectel BC28 model"
    default n
    select RT_USING_AT
    select AT_USING_CLIENT

if PKG_USING_BC28_MQTT

    config PKG_BC28_MQTT_PATH
        string
        default "/packages/iot/bc28_mqtt"

    config PKG_USING_BC28_AT_CLIENT_DEV_NAME
        string "AT client device name"
        default "uart3"

    choice
        prompt "Select baud rate"
        default PKG_USING_BC28_MQTT_BAUD_RATE_9600

        config PKG_USING_BC28_MQTT_BAUD_RATE_4800
            bool "4800"

        config PKG_USING_BC28_MQTT_BAUD_RATE_9600
            bool "9600"

        config PKG_USING_BC28_MQTT_BAUD_RATE_115200
            bool "115200"
    endchoice

    config PKG_USING_BC28_MQTT_BAUD_RATE
       int
       default 4800      if PKG_USING_BC28_MQTT_BAUD_RATE_4800
       default 9600      if PKG_USING_BC28_MQTT_BAUD_RATE_9600
       default 115200    if PKG_USING_BC28_MQTT_BAUD_RATE_115200

    choice
        prompt "Select operating band"
        default PKG_USING_BC28_MQTT_OP_BAND_8

        config PKG_USING_BC28_MQTT_OP_BAND_1
            bool "B1 @H-FDD: 2100MHz"

        config PKG_USING_BC28_MQTT_OP_BAND_3
            bool "B3 @H-FDD: 1800MHz"

        config PKG_USING_BC28_MQTT_OP_BAND_5
            bool "B5 @H-FDD: 850MHz"

        config PKG_USING_BC28_MQTT_OP_BAND_8
            bool "B8 @H-FDD: 900MHz"

        config PKG_USING_BC28_MQTT_OP_BAND_20
            bool "B20 @H-FDD: 800MHz"

        config PKG_USING_BC28_MQTT_OP_BAND_28
            bool "B28 @H-FDD: 700MHz"
    endchoice

    config PKG_USING_BC28_MQTT_OP_BAND
       int
       default 1     if PKG_USING_BC28_MQTT_OP_BAND_1
       default 3     if PKG_USING_BC28_MQTT_OP_BAND_3
       default 5     if PKG_USING_BC28_MQTT_OP_BAND_5
       default 8     if PKG_USING_BC28_MQTT_OP_BAND_8
       default 20    if PKG_USING_BC28_MQTT_OP_BAND_20
       default 28    if PKG_USING_BC28_MQTT_OP_BAND_28

    config PKG_USING_BC28_RESET_PIN
        int "Reset pin"
        default 5

    config PKG_USING_BC28_ADC0_PIN
        int "ADC pin"
        default -1

    config PKG_USING_BC28_MQTT_PRODUCT_KEY
        string "Product Key"
        default ""

    config PKG_USING_BC28_MQTT_DEVICE_NAME
        string "Device Name"
        default ""

    config PKG_USING_BC28_MQTT_DEVICE_SECRET
        string "Device Secret"
        default ""

    config PKG_USING_BC28_MQTT_KEEP_ALIVE
        int "Keep-alive time in seconds"
        range 0 3600
        default 300

    config PKG_USING_BC28_MQTT_DEBUG
        bool "Enable debug log output"
        default n

    config PKG_USING_BC28_MQTT_SAMPLE
        bool "Enable bc28_mqtt sample"
        default n
        select PKG_USING_CJSON

    choice
        prompt "Version"
        default PKG_USING_BC28_MQTT_LATEST_VERSION
        help
            Select the package version

        config PKG_USING_BC28_MQTT_V110
            bool "v1.1.0"

        config PKG_USING_BC28_MQTT_V100
            bool "v1.0.0"

        config PKG_USING_BC28_MQTT_V001
            bool "v0.0.1"

        config PKG_USING_BC28_MQTT_LATEST_VERSION
            bool "latest"
    endchoice

    config PKG_BC28_MQTT_VER
       string
       default "v1.1.0"    if PKG_USING_BC28_MQTT_V110
       default "v1.0.0"    if PKG_USING_BC28_MQTT_V100
       default "v0.0.1"    if PKG_USING_BC28_MQTT_V001
       default "latest"    if PKG_USING_BC28_MQTT_LATEST_VERSION

endif
```

## iot/bsal/Kconfig
```kconfig
# Kconfig file for package bsal
menuconfig PKG_USING_BSAL
    bool "BSAL: The Bluetooth Stack Abstract Layer"
    default n

if PKG_USING_BSAL

    config PKG_BSAL_PATH
        string
        default "/packages/iot/bsal"

    menu "Role support"

        config PKG_BSAL_ROLE_PERIPHERAL
            bool "Peripheral Role support"
            select PKG_BSAL_ROLE_BROADCASTER
            default y
        help
            Select this for LE Peripheral role support.

        config PKG_BSAL_ROLE_CENTRAL
            bool "Central Role support"
            select PKG_BSAL_ROLE_OBSERVER
            default n
        help
            Select this for LE Central role support.

        config PKG_BSAL_ROLE_BROADCASTER
            bool "Broadcaster Role support"
            default y
            help
                Select this for LE Broadcaster role support.

        config PKG_BSAL_ROLE_OBSERVER
            bool "Observer Role support"
            default n
            help
                Select this for LE Observer role support.
    endmenu

    choice
        prompt "Peripheral Samples"
        default PKG_BSAL_SAMPLE_BAS_ONLY
        help
            select the BSAL peripheral samples

        config PKG_BSAL_SAMPLE_BAS_ONLY
            select PKG_BSAL_SRV_BAS
            bool "battery service"

        config PKG_BSAL_SAMPLE_BAS_BLUFI_COMBINE
            select PKG_BSAL_SRV_BAS
            select PKG_BSAL_SRV_BLUFI
            bool "battery service and blufi service"

        config PKG_BSAL_SAMPLE_NUS_ONLY
            select PKG_BSAL_SRV_NUS
            bool "nordic uart service"

        config PKG_BSAL_SAMPLE_LBS_ONLY
            select PKG_BSAL_SRV_LBS
            bool "nordic led button service"

        config PKG_BSAL_SAMPLE_HRS_ONLY
            select PKG_BSAL_SRV_HRS
            bool "heart rate service"

    endchoice

    if PKG_BSAL_ROLE_PERIPHERAL
        menu "Profile support"

            config PKG_BSAL_SRV_BAS
                bool "Battery service support"
                default n
                help
                    Select Battery service profile.

            config PKG_BSAL_SRV_BLUFI
                bool "Blufi Service support"
                default n
                help
                    Select Battery service profile.

            config PKG_BSAL_SRV_NUS
                bool "Nordic Uart Service support"
                default n
                help
                    Select Nordic Uart service profile.

            config PKG_BSAL_SRV_LBS
                bool "Nordic Led Button Service support"
                default n
                help
                    Select Nordic Led Button service profile.

            config PKG_BSAL_SRV_DIS
                bool "Device Information Service support"
                default n
                help
                    Select device information service profile.

            config PKG_BSAL_SRV_HRS
                bool "Heart Rate Service support"
                default n
                help
                    Select heart rate service profile.

        endmenu
    endif

    choice
        prompt "Stack"
        default PKG_BSAL_NIMBLE_STACK
        help
            select the BSAL STACK

        config PKG_BSAL_NIMBLE_STACK
            bool "Use the nimble stack"


        config PKG_BSAL_RTK_STACK
            bool "Use the realtek stack"

        config PKG_BSAL_EMPTY_STACK
            bool "Use the EMPTY stack"

    endchoice

    config PKG_BSAL_STACK_NAME
        string
        default "nimble"      if PKG_BSAL_NIMBLE_STACK
        default "realtek"     if PKG_BSAL_RTK_STACK
        default "empty_stack" if PKG_BSAL_EMPTY_STACK

    choice
        prompt "Version"
        default PKG_USING_BSAL_LATEST_VERSION
        help
            Select the package version

        config PKG_USING_BSAL_LATEST_VERSION
            bool "latest"
    endchoice

    config PKG_BSAL_VER
        string
        default "latest"    if PKG_USING_BSAL_LATEST_VERSION

endif
```

## iot/bt_cyw43012/Kconfig
```kconfig
menuconfig PKG_USING_BT_CYW43012
    bool "CYW43012 BT driver for rt-thread"
    select PKG_USING_FREERTOS_WRAPPER
    default n

if PKG_USING_BT_CYW43012

    config BT_SAMPLE_ENABLE_FOR_IFX
        bool "enable hello sample"
        default true

    config PKG_BT_CYW43012_PATH
        string
        default "/packages/iot/bt_cyw43012"

    choice
        prompt "version"
        default PKG_USING_BT_CYW43012_V001
        help
            Select the CYW43012 BT version

        config PKG_USING_BT_CYW43012_LATEST_VERSION
            bool "latest"

        config PKG_USING_BT_CYW43012_V002
            bool "v0.0.2"
        config PKG_USING_BT_CYW43012_V001
            bool "v0.0.1"
    endchoice

    config PKG_BT_CYW43012_VER
        string
        default "v0.0.2" if PKG_USING_BT_CYW43012_V002
        default "v0.0.1" if PKG_USING_BT_CYW43012_V001
        default "latest" if PKG_USING_BT_CYW43012_LATEST_VERSION

endif
```
