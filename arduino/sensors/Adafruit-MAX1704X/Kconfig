## arduino/sensors/Adafruit-MPRLS/Kconfig
```kconfig
# Kconfig file for package Adafruit-MPRLS
menuconfig PKG_USING_ARDUINO_ADAFRUIT_MPRLS
    bool "Adafruit MPRLS: Pressure Sensor"
    select PKG_USING_RTDUINO
    select RTDUINO_USING_WIRE
    select PKG_USING_ARDUINO_ADAFRUIT_SENSOR
    select PKG_USING_ARDUINO_ADAFRUIT_BUSIO
    default n

if PKG_USING_ARDUINO_ADAFRUIT_MPRLS

    config PKG_ARDUINO_ADAFRUIT_MPRLS_PATH
        string
        default "/packages/arduino/sensors/Adafruit-MPRLS"

    choice
        prompt "Version"
        default PKG_USING_ARDUINO_ADAFRUIT_MPRLS_LATEST_VERSION
        help
            Select the package version

        config PKG_USING_ARDUINO_ADAFRUIT_MPRLS_LATEST_VERSION
            bool "latest"
    endchoice

    config PKG_ARDUINO_ADAFRUIT_MPRLS_VER
       string
       default "latest"    if PKG_USING_ARDUINO_ADAFRUIT_MPRLS_LATEST_VERSION

endif
```

## arduino/sensors/Adafruit-MPU6050/Kconfig
```kconfig
# Kconfig file for package Adafruit-MPU6050
menuconfig PKG_USING_ARDUINO_ADAFRUIT_MPU6050
    bool "Adafruit MPU6050: 6-DoF Accel and Gyro Sensor"
    select PKG_USING_RTDUINO
    select RTDUINO_USING_WIRE
    select PKG_USING_ARDUINO_ADAFRUIT_SENSOR
    select PKG_USING_ARDUINO_ADAFRUIT_BUSIO
    default n

if PKG_USING_ARDUINO_ADAFRUIT_MPU6050

    config PKG_ARDUINO_ADAFRUIT_MPU6050_PATH
        string
        default "/packages/arduino/sensors/Adafruit-MPU6050"

    choice
        prompt "Version"
        default PKG_USING_ARDUINO_ADAFRUIT_MPU6050_LATEST_VERSION
        help
            Select the package version

        config PKG_USING_ARDUINO_ADAFRUIT_MPU6050_LATEST_VERSION
            bool "latest"
    endchoice

    config PKG_ARDUINO_ADAFRUIT_MPU6050_VER
       string
       default "latest"    if PKG_USING_ARDUINO_ADAFRUIT_MPU6050_LATEST_VERSION

endif
```

## arduino/sensors/Adafruit-MS8607/Kconfig
```kconfig
# Kconfig file for package Adafruit-MS8607
menuconfig PKG_USING_ARDUINO_ADAFRUIT_MS8607
    bool "Adafruit MS8607: Pressure Humidity Temperature PHT Sensor"
    select PKG_USING_RTDUINO
    select RTDUINO_USING_WIRE
    select PKG_USING_ARDUINO_ADAFRUIT_SENSOR
    select PKG_USING_ARDUINO_ADAFRUIT_BUSIO
    default n

if PKG_USING_ARDUINO_ADAFRUIT_MS8607

    config PKG_ARDUINO_ADAFRUIT_MS8607_PATH
        string
        default "/packages/arduino/sensors/Adafruit-MS8607"

    choice
        prompt "Version"
        default PKG_USING_ARDUINO_ADAFRUIT_MS8607_LATEST_VERSION
        help
            Select the package version

        config PKG_USING_ARDUINO_ADAFRUIT_MS8607_LATEST_VERSION
            bool "latest"
    endchoice

    config PKG_ARDUINO_ADAFRUIT_MS8607_VER
       string
       default "latest"    if PKG_USING_ARDUINO_ADAFRUIT_MS8607_LATEST_VERSION

endif
```

## arduino/sensors/Adafruit-MSA301/Kconfig
```kconfig
# Kconfig file for package Adafruit-MSA301
menuconfig PKG_USING_ARDUINO_ADAFRUIT_MSA301
    bool "Adafruit MSA301: Triple Axis Accelerometer"
    select PKG_USING_RTDUINO
    select RTDUINO_USING_WIRE
    select PKG_USING_ARDUINO_ADAFRUIT_SENSOR
    select PKG_USING_ARDUINO_ADAFRUIT_BUSIO
    default n

if PKG_USING_ARDUINO_ADAFRUIT_MSA301

    config PKG_ADAFRUIT_MSA301_PATH
        string
        default "/packages/arduino/sensors/Adafruit-MSA301"

    choice
        prompt "Version"
        default PKG_USING_ARDUINO_ADAFRUIT_MSA301_LATEST_VERSION
        help
            Select the package version

        config PKG_USING_ARDUINO_ADAFRUIT_MSA301_LATEST_VERSION
            bool "latest"
    endchoice

    config PKG_ADAFRUIT_MSA301_VER
       string
       default "latest"    if PKG_USING_ARDUINO_ADAFRUIT_MSA301_LATEST_VERSION

endif
```

## arduino/sensors/Adafruit-NAU7802/Kconfig
```kconfig
# Kconfig file for package Adafruit-NAU7802
menuconfig PKG_USING_ARDUINO_ADAFRUIT_NAU7802
    bool "Adafruit NAU7802: I2C 24-bit ADC sensor"
    select PKG_USING_RTDUINO
    select RTDUINO_USING_WIRE
    select PKG_USING_ARDUINO_ADAFRUIT_BUSIO
    default n

if PKG_USING_ARDUINO_ADAFRUIT_NAU7802

    config PKG_ARDUINO_ADAFRUIT_NAU7802_PATH
        string
        default "/packages/arduino/sensors/Adafruit-NAU7802"

    choice
        prompt "Version"
        default PKG_USING_ARDUINO_ADAFRUIT_NAU7802_LATEST_VERSION
        help
            Select the package version

        config PKG_USING_ARDUINO_ADAFRUIT_NAU7802_LATEST_VERSION
            bool "latest"
    endchoice

    config PKG_ARDUINO_ADAFRUIT_NAU7802_VER
       string
       default "latest"    if PKG_USING_ARDUINO_ADAFRUIT_NAU7802_LATEST_VERSION

endif
```

## arduino/sensors/Adafruit-OV7670/Kconfig
```kconfig
# Kconfig file for package Adafruit-OV7670
menuconfig PKG_USING_ADAFRUIT_OV7670
    bool "Adafruit OV7670: camera sensor"
    select PKG_USING_RTDUINO
    select RTDUINO_USING_WIRE
    default n

if PKG_USING_ADAFRUIT_OV7670

    config PKG_ADAFRUIT_OV7670_PATH
        string
        default "/packages/peripherals/sensors/Adafruit-OV7670"

    choice
        prompt "Version"
        default PKG_USING_ADAFRUIT_OV7670_LATEST_VERSION
        help
            Select the package version

        config PKG_USING_ADAFRUIT_OV7670_LATEST_VERSION
            bool "latest"
    endchoice

    config PKG_ADAFRUIT_OV7670_VER
       string
       default "latest"    if PKG_USING_ADAFRUIT_OV7670_LATEST_VERSION

endif
```

## arduino/sensors/Adafruit-PCF8591/Kconfig
```kconfig
# Kconfig file for package Adafruit-PCF8591
menuconfig PKG_USING_ARDUINO_ADAFRUIT_PCF8591
    bool "Adafruit PCF8591: Basic 4 x ADC + DAC"
    select PKG_USING_RTDUINO
    select RTDUINO_USING_WIRE
    select PKG_USING_ARDUINO_ADAFRUIT_BUSIO
    default n

if PKG_USING_ARDUINO_ADAFRUIT_PCF8591

    config PKG_ARDUINO_ADAFRUIT_PCF8591_PATH
        string
        default "/packages/arduino/sensors/Adafruit-PCF8591"

    choice
        prompt "Version"
        default PKG_USING_ARDUINO_ADAFRUIT_PCF8591_LATEST_VERSION
        help
            Select the package version

        config PKG_USING_ARDUINO_ADAFRUIT_PCF8591_LATEST_VERSION
            bool "latest"
    endchoice

    config PKG_ARDUINO_ADAFRUIT_PCF8591_VER
       string
       default "latest"    if PKG_USING_ARDUINO_ADAFRUIT_PCF8591_LATEST_VERSION

endif
```

## arduino/sensors/Adafruit-PCT2075/Kconfig
```kconfig
# Kconfig file for package Adafruit-PCT2075
menuconfig PKG_USING_ARDUINO_ADAFRUIT_PCT2075
    bool "Adafruit PCT2075: temperature sensor"
    select PKG_USING_RTDUINO
    select RTDUINO_USING_WIRE
    select PKG_USING_ARDUINO_ADAFRUIT_BUSIO
    default n

if PKG_USING_ARDUINO_ADAFRUIT_PCT2075

    config PKG_ARDUINO_ADAFRUIT_PCT2075_PATH
        string
        default "/packages/arduino/sensors/Adafruit-PCT2075"

    choice
        prompt "Version"
        default PKG_USING_ARDUINO_ADAFRUIT_PCT2075_LATEST_VERSION
        help
            Select the package version

        config PKG_USING_ARDUINO_ADAFRUIT_PCT2075_LATEST_VERSION
            bool "latest"
    endchoice

    config PKG_ARDUINO_ADAFRUIT_PCT2075_VER
       string
       default "latest"    if PKG_USING_ARDUINO_ADAFRUIT_PCT2075_LATEST_VERSION

endif
```
