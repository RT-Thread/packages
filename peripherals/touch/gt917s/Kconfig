## security/libsodium/Kconfig
```kconfig
# Kconfig file for package libsodium
menuconfig PKG_USING_LIBSODIUM
    bool "libsodium: A modern and easy-to-use crypto library (NOT Recommended for MCU. Use libhydrogen instead)."
    default n

if PKG_USING_LIBSODIUM

    config PKG_LIBSODIUM_PATH
        string
        default "/packages/security/libsodium"

    menu "Examples"
        config LIBSODIUM_USING_EXAMPLE_SHA256
            bool "sha256: a cli tool that calculates the SHA-256 hash."
            help
                sha256: a cli tool that calculates the SHA-256 hash.
            default n
        config LIBSODIUM_USING_EXAMPLE_SHA512
            bool "sha512: a cli tool that calculates the SHA-512 hash."
            help
                sha512: a cli tool that calculates the SHA-256 hash.
            default n
        config LIBSODIUM_USING_EXAMPLE_GENERIC_HASH
            bool "generic_hash: a cli tool that calculates the generic hash."
            help
                generic_hash: a cli tool that calculates the generic hash.
            default n
        config LIBSODIUM_USING_EXAMPLE_SHORT_HASH
            bool "short_hash: a cli tool that calculates the short hash."
            help
                short_hash: a cli tool that calculates the short hash.
            default n
    endmenu

    menu "Testing (It's suggested to pass all required tests first)"
        config LIBSODIUM_USING_TESTING_CORE
            bool "hash test : Testing core"
            help
                Testing core
            default n
        config LIBSODIUM_USING_TESTING_GENERIC_HASH
            bool "hash test : Testing generic hash"
            help
                Testing generic hash
            default n
        config LIBSODIUM_USING_TESTING_SHORT_HASH
            bool "hash test : Testing short hash"
            help
                Testing short hash
            default n
        config LIBSODIUM_USING_TESTING_HASH
            bool "hash test : Testing sha256 and sha512"
            help
                Testing sha256 and sha512
            default n
    endmenu

    choice
        prompt "Version"
        default PKG_USING_LIBSODIUM_LATEST_VERSION
        help
            Select the package version

        config PKG_USING_LIBSODIUM_LATEST_VERSION
            bool "latest"
    endchoice

    config PKG_LIBSODIUM_VER
       string
       default "latest"    if PKG_USING_LIBSODIUM_LATEST_VERSION

endif
```

## security/mbedtls/Kconfig
```kconfig
menuconfig PKG_USING_MBEDTLS
    bool "mbedtls: An portable and flexible SSL/TLS library"
    default n
    select RT_USING_RTC
    select RT_USING_SAL             if RT_VER_NUM < 0x40100
    select SAL_USING_POSIX          if RT_VER_NUM < 0x40100
    select RT_USING_POSIX_FS        if RT_VER_NUM >= 0x40100
    select RT_USING_POSIX_SOCKET    if RT_VER_NUM >= 0x40100
    imply SAL_USING_TLS             if RT_USING_SAL

if PKG_USING_MBEDTLS

    menu "Select Root Certificate"

        config PKG_USING_MBEDTLS_USE_ALL_CERTS
            bool "Using all default CA(Use preset CA certificates. Take up more memory)"
            select PKG_USING_MBEDTLS_THAWTE_ROOT_CA
            select PKG_USING_MBEDTLS_VERSIGN_PBULIC_ROOT_CA
            select PKG_USING_MBEDTLS_VERSIGN_UNIVERSAL_ROOT_CA
            select PKG_USING_MBEDTLS_GEOTRUST_ROOT_CA
            select PKG_USING_MBEDTLS_DIGICERT_ROOT_CA
            select PKG_USING_MBEDTLS_GODADDY_ROOT_CA
            select PKG_USING_MBEDTLS_COMODOR_ROOT_CA
            select PKG_USING_MBEDTLS_DST_ROOT_CA
            select PKG_USING_MBEDTLS_CLOBALSIGN_ROOT_CA
            select PKG_USING_MBEDTLS_ENTRUST_ROOT_CA
            select PKG_USING_MBEDTLS_CERTUM_TRUSTED_NETWORK_ROOT_CA

        config PKG_USING_MBEDTLS_USER_CERTS
            bool "Using user CA(copy your Root CA file to \"certs\" directory)"

        # 1 THAWTE_ROOT_CA.cer
        config PKG_USING_MBEDTLS_THAWTE_ROOT_CA
            bool "Using thawte Primary Root CA"

        # 2 VERSIGN_PUBLIC_ROOT_CA.cer
        config PKG_USING_MBEDTLS_VERSIGN_PBULIC_ROOT_CA
            bool "Using VeriSign Class 3 Public Primary Certification Authority - G5 CA"

        # 3 VERSIGN_UNIVERSAL_ROOT_CA.cer
        config PKG_USING_MBEDTLS_VERSIGN_UNIVERSAL_ROOT_CA
            bool "Using VeriSign Universal Root Certification Authority CA"

        # 4 GEOTRUST_ROOT_CA.cer
        config PKG_USING_MBEDTLS_GEOTRUST_ROOT_CA
            bool "Using GeoTrust Global CA"

        # 5 DIGICERT_ROOT_CA.cer
        config PKG_USING_MBEDTLS_DIGICERT_ROOT_CA
            bool "Using DigiCert Global Root CA"

        # 6 GODADDY_ROOT_CA.cer
        config PKG_USING_MBEDTLS_GODADDY_ROOT_CA
            bool "Using Go Daddy Root Certificate Authority - G2 CA"

        # 7 COMODOR_ROOT_CA.cer
        config PKG_USING_MBEDTLS_COMODOR_ROOT_CA
            bool "Using COMODO RSA Certification Authority CA"

        # 8 DIGITAL_SIGNATURE_TRUST_ROOT_CA.cer
        config PKG_USING_MBEDTLS_DST_ROOT_CA
            bool "Using Digital Signature Trust Root CA"

        # 9 CLOBALSIGN_ROOT_CA.cer
        config PKG_USING_MBEDTLS_CLOBALSIGN_ROOT_CA
            bool "Using GlobalSign Root CA"

        # 10 ENTRUST_ROOT_CA.cer
        config PKG_USING_MBEDTLS_ENTRUST_ROOT_CA
            bool "Using Entrust Root Certification Authority - G2 CA"

        # 11 AMAZON_ROOT_CA.cer
        config PKG_USING_MBEDTLS_AMAZON_ROOT_CA
            bool "Using Amazon Root CA"

        # 12 CERTUM_TRUSTED_NETWORK_ROOT_CA.cer
        config PKG_USING_MBEDTLS_CERTUM_TRUSTED_NETWORK_ROOT_CA
            bool "Using Certum Trusted Network CA"

    endmenu

    config MBEDTLS_AES_ROM_TABLES
        bool "Store the AES tables in ROM"
        default y

    config MBEDTLS_ECP_WINDOW_SIZE
        int "Maximum window size used"
        range 2 6
        default 2

    config MBEDTLS_SSL_MAX_CONTENT_LEN
        int "Maxium fragment length in bytes"
        default 3584

    config PKG_USING_MBEDTLS_EXAMPLE
        bool "Enable a mbedtls client example"
        select PKG_USING_MBEDTLS_CERTUM_TRUSTED_NETWORK_ROOT_CA
        default n

    if PKG_USING_MBEDTLS_V2710
        config MBEDTLS_MPI_MAX_SIZE
            int "Maximum number of bytes for usable MPIs"
            default 1024

        config MBEDTLS_CTR_DRBG_KEYSIZE
            int "The key size used by the cipher"
            default 32
    endif

    config PKG_USING_MBEDTLS_DEBUG
        bool "Enable Debug log output"
        default n

    config PKG_MBEDTLS_PATH
        string
        default "/packages/security/mbedtls"

    choice
        prompt "version"
        default PKG_USING_MBEDTLS_V2281
        help
            Select the mbedtls version

        config PKG_USING_MBEDTLS_V2281
            bool "v2.28.1"

        config PKG_USING_MBEDTLS_V27102
            bool "v2.7.10.2"

        config PKG_USING_MBEDTLS_V27101
            bool "v2.7.10.1"

        config PKG_USING_MBEDTLS_V2710
            bool "v2.7.10"

        config PKG_USING_MBEDTLS_V261
            bool "v2.6.1"

        config PKG_USING_MBEDTLS_V260
            bool "v2.6.0"

        config PKG_USING_MBEDTLS_LATEST_VERSION
            bool "latest"
    endchoice

    config PKG_MBEDTLS_VER
        string
        default "latest"    if PKG_USING_MBEDTLS_LATEST_VERSION
        default "v2.28.1" if PKG_USING_MBEDTLS_V2281
        default "v2.7.10.2" if PKG_USING_MBEDTLS_V27102
        default "v2.7.10.1" if PKG_USING_MBEDTLS_V27101
        default "v2.7.10"   if PKG_USING_MBEDTLS_V2710
        default "v2.6.1"    if PKG_USING_MBEDTLS_V261
        default "v2.6.0"    if PKG_USING_MBEDTLS_V260

endif
```

## security/tinycrypt/Kconfig
```kconfig
menuconfig PKG_USING_TINYCRYPT
    bool "TinyCrypt: A tiny and configurable crypt library"
    default n

if PKG_USING_TINYCRYPT

    config PKG_TINYCRYPT_PATH
        string
        default "/packages/security/tinycrypt"

    choice
        prompt "Version"
        default PKG_USING_TINYCRYPT_LATEST_VERSION
        help
            Select the TinyCrypt version

        config PKG_USING_TINYCRYPT_V100
            bool "v1.0.0"

        config PKG_USING_TINYCRYPT_LATEST_VERSION
            bool "latest"
    endchoice

    config PKG_TINYCRYPT_VER
        string
        default "v1.0.0" if PKG_USING_TINYCRYPT_V100
        default "latest" if PKG_USING_TINYCRYPT_LATEST_VERSION

    config TINY_CRYPT_MD5
        bool "MD5"
        default y

    config TINY_CRYPT_BASE64
        bool "base64"
        default y

    config TINY_CRYPT_AES
        bool "AES"
        default y

    if TINY_CRYPT_AES
        config TINY_CRYPT_AES_ROM_TABLES
            bool "AES table in ROM"
            default y
        config TINYCRYPT_USING_AES_SAMPLE
            bool "Enable aes sample"
            default n
    endif

    config TINY_CRYPT_SHA1
        bool "SHA1"
        default y

    config TINY_CRYPT_SHA256
        bool "SHA256"
        default y

endif
```

## security/trusted-firmware-m/Kconfig
```kconfig
menuconfig PKG_USING_TFM
    bool "TFM: Trusted firmware for M class"
    default n

if PKG_USING_TFM

    config PKG_TFM_PATH
        string
        default "/packages/security/trusted-firmware-m"

    choice
        prompt "Version"
        default PKG_USING_TFM_NXP_LPC55_V1_BETA
        help
            Select the TFM version

        config PKG_USING_TFM_NXP_LPC55_V1_BETA
            bool "nxp-lpc55-v1.0-beta"

        config PKG_USING_TFM_LATEST_VERSION
            bool "latest"
    endchoice

    config PKG_TFM_VER
    string
    default "nxp-lpc55-v1.0-beta" if PKG_USING_TFM_NXP_LPC55_V1_BETA
    default "latest" if PKG_USING_TFM_LATEST_VERSION

endif
```

## security/yd_crypto/Kconfig
```kconfig
menuconfig PKG_USING_YD_CRYPTO
    bool "yd_crypto: Encryption and decryption algorithm library for microcontroller."
    default n

if PKG_USING_YD_CRYPTO

    config PKG_YD_CRYPTO_PATH
        string
        default "/packages/security/yd_crypto"

    choice
        prompt "Version"
        default PKG_USING_YD_CRYPTO_V1101
        help
            Select the package version

        config PKG_USING_YD_CRYPTO_V1101
            bool "v1.1.01"

        config PKG_USING_YD_CRYPTO_LATEST_VERSION
            bool "latest"
    endchoice

    config PKG_YD_CRYPTO_VER
       string
       default "v1.1.01"    if PKG_USING_YD_CRYPTO_V1101
       default "latest"    if PKG_USING_YD_CRYPTO_LATEST_VERSION

endif
```

## signalprocess/APID/Kconfig
```kconfig
# Kconfig file for package APID
menuconfig PKG_USING_APID
    bool "Please add description of APID in English."
    default n

if PKG_USING_APID

    config PKG_APID_PATH
        string
        default "/packages/signalprocess/APID"

    choice
        prompt "Version"
        help
            Select the package version

        config PKG_USING_APID_LATEST_VERSION
            bool "latest"
    endchoice

    config PKG_APID_VER
       string
       default "latest"    if PKG_USING_APID_LATEST_VERSION

endif
```

## signalprocess/CMSIS-DSP/Kconfig
```kconfig
# Kconfig file for package CMSIS-DSP
menuconfig PKG_USING_CMSIS_DSP
    bool "CMSIS-DSP: embedded compute library for Cortex-M and Cortex-A"
    depends on ARCH_ARM_CORTEX_M || ARCH_ARM_CORTEX_A
    default n

if PKG_USING_CMSIS_DSP

    config PKG_CMSIS_DSP_PATH
        string
        default "/packages/signalprocess/CMSIS-DSP"

    config PKG_CMSIS_DSP_BASIC_MATH_FUNCTIONS
        bool "basic math functions"
        default y

    config PKG_CMSIS_DSP_BAYES_FUNCTIONS
        bool "Bayes classifier functions"
        default n

    config PKG_CMSIS_DSP_COMMON_TABLES
        bool "Common tables"
        default n

    config PKG_CMSIS_DSP_COMPLEX_MATH_FUNCTIONS
        bool "Complex math functions"
        default n

    config PKG_CMSIS_DSP_CONTROLLER_FUNCTIONS
        bool "Motor control functions"
        default n

    config PKG_CMSIS_DSP_DISTANCE_FUNCTIONS
        bool "Distance functions"
        default n

    config PKG_CMSIS_DSP_FAST_MATH_FUNCTIONS
        bool "Fast math functions"
        default n

    config PKG_CMSIS_DSP_FILTERING_FUNCTIONS
        bool "Filtering functions"
        default n

    config PKG_CMSIS_DSP_INTERPOLATION_FUNCTIONS
        bool "Interpolation functions"
        default n

    config PKG_CMSIS_DSP_MATRIX_FUNCTIONS
        bool "Matrix functions"
        default n

    config PKG_CMSIS_DSP_QUATERNION_MATH_FUNCTIONS
        bool "Quaternion functions"
        default n

    config PKG_CMSIS_DSP_STATISTICS_FUNCTIONS
        bool "Statistical functions"
        default n

    config PKG_CMSIS_DSP_SUPPORT_FUNCTIONS
        bool "Support functions"
        default n

    config PKG_CMSIS_DSP_SVM_FUNCTIONS
        bool "Support Vector Machine functions (SVM)"
        default n

    config PKG_CMSIS_DSP_TRANSFORM_FUNCTIONS
        bool "Transform functions"
        default n

    choice
        prompt "Version"
        help
            Select the package version

        config PKG_USING_CMSIS_DSP_LATEST_VERSION
            bool "latest"
    endchoice

    config PKG_CMSIS_DSP_VER
       string
       default "latest"    if PKG_USING_CMSIS_DSP_LATEST_VERSION

endif
```

## signalprocess/DigitalCtrl/Kconfig
```kconfig
# Kconfig file for package DigitalCtrl
menuconfig PKG_USING_DIGITALCTRL
    bool "DigitalCtrl: Digital closed-loop control algorithm library"
    default n
    help
        DigitalCtrl is a digital control algorithm library designed to
        simplify the programming of digital closed-loop controllers
        based on microcontrollers, DSPs, and processors, and to provide
        closed-loop controller algorithms with optimized performance and
        space optimization.

if PKG_USING_DIGITALCTRL

    config DIGITALCTRL_USING_DOUBLE
        bool "Use double precision floating point calculations"
        default n

    config PKG_DIGITALCTRL_PATH
        string
        default "/packages/signalprocess/DigitalCtrl"

    choice
        prompt "version"
        default PKG_USING_DIGITALCTRL_LATEST_VERSION
        help
            Select the DigitalCtrl version

        config PKG_USING_DIGITALCTRL_LATEST_VERSION
            bool "latest"
    endchoice

    config PKG_DIGITALCTRL_VER
        string
        default "latest" if PKG_USING_DIGITALCTRL_LATEST_VERSION

endif
```

## signalprocess/Kconfig
```kconfig
menu "Signal Processing and Control Algorithm Packages"

rsource "APID/Kconfig"
rsource "fire_pid_curve/Kconfig"
rsource "qpid/Kconfig"
rsource "ukal/Kconfig"
rsource "DigitalCtrl/Kconfig"
rsource "kissfft/Kconfig"
rsource "CMSIS-DSP/Kconfig"

endmenu
```

## signalprocess/fire_pid_curve/Kconfig
```kconfig
# Kconfig file for package fire_pid_curve
menuconfig PKG_USING_FIRE_PID_CURVE
    bool "fire PID communication protocol debugging assistant."
    default n

if PKG_USING_FIRE_PID_CURVE

    config PKG_FIRE_PID_CURVE_PATH
        string
        default "/packages/signalprocess/fire_pid_curve"

    choice
        prompt "Version"
        default PKG_USING_FIRE_PID_CURVE_LATEST_VERSION
        help
            Select the package version

        config PKG_USING_FIRE_PID_CURVE_V100
            bool "v1.0.0"

        config PKG_USING_FIRE_PID_CURVE_LATEST_VERSION
            bool "latest"
    endchoice

    config PKG_FIRE_PID_CURVE_VER
       string
       default "v1.0.0"    if PKG_USING_FIRE_PID_CURVE_V100
       default "latest"    if PKG_USING_FIRE_PID_CURVE_LATEST_VERSION

endif
```
